;
; File Name: cyfitterrv.inc
; 
; PSoC Creator  4.2
;
; Description:
; 
;
;-------------------------------------------------------------------------------
; Copyright (c) 2007-2018 Cypress Semiconductor.  All rights reserved.
; You may use this file only in accordance with the license, terms, conditions, 
; disclaimers, and limitations in the end user license agreement accompanying 
; the software package with which this file was provided.
;-------------------------------------------------------------------------------

    IF :LNOT::DEF:INCLUDED_CYFITTERRV_INC
INCLUDED_CYFITTERRV_INC EQU 1
    GET cydevicerv.inc
    GET cydevicerv_trm.inc

; key
key__0__INTTYPE EQU CYREG_PICU0_INTTYPE7
key__0__MASK EQU 0x80
key__0__PC EQU CYREG_PRT0_PC7
key__0__PORT EQU 0
key__0__SHIFT EQU 7
key__AG EQU CYREG_PRT0_AG
key__AMUX EQU CYREG_PRT0_AMUX
key__BIE EQU CYREG_PRT0_BIE
key__BIT_MASK EQU CYREG_PRT0_BIT_MASK
key__BYP EQU CYREG_PRT0_BYP
key__CTL EQU CYREG_PRT0_CTL
key__DM0 EQU CYREG_PRT0_DM0
key__DM1 EQU CYREG_PRT0_DM1
key__DM2 EQU CYREG_PRT0_DM2
key__DR EQU CYREG_PRT0_DR
key__INP_DIS EQU CYREG_PRT0_INP_DIS
key__INTTYPE_BASE EQU CYDEV_PICU_INTTYPE_PICU0_BASE
key__LCD_COM_SEG EQU CYREG_PRT0_LCD_COM_SEG
key__LCD_EN EQU CYREG_PRT0_LCD_EN
key__MASK EQU 0x80
key__PORT EQU 0
key__PRT EQU CYREG_PRT0_PRT
key__PRTDSI__CAPS_SEL EQU CYREG_PRT0_CAPS_SEL
key__PRTDSI__DBL_SYNC_IN EQU CYREG_PRT0_DBL_SYNC_IN
key__PRTDSI__OE_SEL0 EQU CYREG_PRT0_OE_SEL0
key__PRTDSI__OE_SEL1 EQU CYREG_PRT0_OE_SEL1
key__PRTDSI__OUT_SEL0 EQU CYREG_PRT0_OUT_SEL0
key__PRTDSI__OUT_SEL1 EQU CYREG_PRT0_OUT_SEL1
key__PRTDSI__SYNC_OUT EQU CYREG_PRT0_SYNC_OUT
key__PS EQU CYREG_PRT0_PS
key__SHIFT EQU 7
key__SLW EQU CYREG_PRT0_SLW

; LCDD
LCDD_LCDPort__0__INTTYPE EQU CYREG_PICU2_INTTYPE0
LCDD_LCDPort__0__MASK EQU 0x01
LCDD_LCDPort__0__PC EQU CYREG_PRT2_PC0
LCDD_LCDPort__0__PORT EQU 2
LCDD_LCDPort__0__SHIFT EQU 0
LCDD_LCDPort__1__INTTYPE EQU CYREG_PICU2_INTTYPE1
LCDD_LCDPort__1__MASK EQU 0x02
LCDD_LCDPort__1__PC EQU CYREG_PRT2_PC1
LCDD_LCDPort__1__PORT EQU 2
LCDD_LCDPort__1__SHIFT EQU 1
LCDD_LCDPort__2__INTTYPE EQU CYREG_PICU2_INTTYPE2
LCDD_LCDPort__2__MASK EQU 0x04
LCDD_LCDPort__2__PC EQU CYREG_PRT2_PC2
LCDD_LCDPort__2__PORT EQU 2
LCDD_LCDPort__2__SHIFT EQU 2
LCDD_LCDPort__3__INTTYPE EQU CYREG_PICU2_INTTYPE3
LCDD_LCDPort__3__MASK EQU 0x08
LCDD_LCDPort__3__PC EQU CYREG_PRT2_PC3
LCDD_LCDPort__3__PORT EQU 2
LCDD_LCDPort__3__SHIFT EQU 3
LCDD_LCDPort__4__INTTYPE EQU CYREG_PICU2_INTTYPE4
LCDD_LCDPort__4__MASK EQU 0x10
LCDD_LCDPort__4__PC EQU CYREG_PRT2_PC4
LCDD_LCDPort__4__PORT EQU 2
LCDD_LCDPort__4__SHIFT EQU 4
LCDD_LCDPort__5__INTTYPE EQU CYREG_PICU2_INTTYPE5
LCDD_LCDPort__5__MASK EQU 0x20
LCDD_LCDPort__5__PC EQU CYREG_PRT2_PC5
LCDD_LCDPort__5__PORT EQU 2
LCDD_LCDPort__5__SHIFT EQU 5
LCDD_LCDPort__6__INTTYPE EQU CYREG_PICU2_INTTYPE6
LCDD_LCDPort__6__MASK EQU 0x40
LCDD_LCDPort__6__PC EQU CYREG_PRT2_PC6
LCDD_LCDPort__6__PORT EQU 2
LCDD_LCDPort__6__SHIFT EQU 6
LCDD_LCDPort__AG EQU CYREG_PRT2_AG
LCDD_LCDPort__AMUX EQU CYREG_PRT2_AMUX
LCDD_LCDPort__BIE EQU CYREG_PRT2_BIE
LCDD_LCDPort__BIT_MASK EQU CYREG_PRT2_BIT_MASK
LCDD_LCDPort__BYP EQU CYREG_PRT2_BYP
LCDD_LCDPort__CTL EQU CYREG_PRT2_CTL
LCDD_LCDPort__DM0 EQU CYREG_PRT2_DM0
LCDD_LCDPort__DM1 EQU CYREG_PRT2_DM1
LCDD_LCDPort__DM2 EQU CYREG_PRT2_DM2
LCDD_LCDPort__DR EQU CYREG_PRT2_DR
LCDD_LCDPort__INP_DIS EQU CYREG_PRT2_INP_DIS
LCDD_LCDPort__INTTYPE_BASE EQU CYDEV_PICU_INTTYPE_PICU2_BASE
LCDD_LCDPort__LCD_COM_SEG EQU CYREG_PRT2_LCD_COM_SEG
LCDD_LCDPort__LCD_EN EQU CYREG_PRT2_LCD_EN
LCDD_LCDPort__MASK EQU 0x7F
LCDD_LCDPort__PORT EQU 2
LCDD_LCDPort__PRT EQU CYREG_PRT2_PRT
LCDD_LCDPort__PRTDSI__CAPS_SEL EQU CYREG_PRT2_CAPS_SEL
LCDD_LCDPort__PRTDSI__DBL_SYNC_IN EQU CYREG_PRT2_DBL_SYNC_IN
LCDD_LCDPort__PRTDSI__OE_SEL0 EQU CYREG_PRT2_OE_SEL0
LCDD_LCDPort__PRTDSI__OE_SEL1 EQU CYREG_PRT2_OE_SEL1
LCDD_LCDPort__PRTDSI__OUT_SEL0 EQU CYREG_PRT2_OUT_SEL0
LCDD_LCDPort__PRTDSI__OUT_SEL1 EQU CYREG_PRT2_OUT_SEL1
LCDD_LCDPort__PRTDSI__SYNC_OUT EQU CYREG_PRT2_SYNC_OUT
LCDD_LCDPort__PS EQU CYREG_PRT2_PS
LCDD_LCDPort__SHIFT EQU 0
LCDD_LCDPort__SLW EQU CYREG_PRT2_SLW

; Rx_1
Rx_1__0__INTTYPE EQU CYREG_PICU12_INTTYPE6
Rx_1__0__MASK EQU 0x40
Rx_1__0__PC EQU CYREG_PRT12_PC6
Rx_1__0__PORT EQU 12
Rx_1__0__SHIFT EQU 6
Rx_1__AG EQU CYREG_PRT12_AG
Rx_1__BIE EQU CYREG_PRT12_BIE
Rx_1__BIT_MASK EQU CYREG_PRT12_BIT_MASK
Rx_1__BYP EQU CYREG_PRT12_BYP
Rx_1__DM0 EQU CYREG_PRT12_DM0
Rx_1__DM1 EQU CYREG_PRT12_DM1
Rx_1__DM2 EQU CYREG_PRT12_DM2
Rx_1__DR EQU CYREG_PRT12_DR
Rx_1__INP_DIS EQU CYREG_PRT12_INP_DIS
Rx_1__INTTYPE_BASE EQU CYDEV_PICU_INTTYPE_PICU12_BASE
Rx_1__MASK EQU 0x40
Rx_1__PORT EQU 12
Rx_1__PRT EQU CYREG_PRT12_PRT
Rx_1__PRTDSI__DBL_SYNC_IN EQU CYREG_PRT12_DBL_SYNC_IN
Rx_1__PRTDSI__OE_SEL0 EQU CYREG_PRT12_OE_SEL0
Rx_1__PRTDSI__OE_SEL1 EQU CYREG_PRT12_OE_SEL1
Rx_1__PRTDSI__OUT_SEL0 EQU CYREG_PRT12_OUT_SEL0
Rx_1__PRTDSI__OUT_SEL1 EQU CYREG_PRT12_OUT_SEL1
Rx_1__PRTDSI__SYNC_OUT EQU CYREG_PRT12_SYNC_OUT
Rx_1__PS EQU CYREG_PRT12_PS
Rx_1__SHIFT EQU 6
Rx_1__SIO_CFG EQU CYREG_PRT12_SIO_CFG
Rx_1__SIO_DIFF EQU CYREG_PRT12_SIO_DIFF
Rx_1__SIO_HYST_EN EQU CYREG_PRT12_SIO_HYST_EN
Rx_1__SIO_REG_HIFREQ EQU CYREG_PRT12_SIO_REG_HIFREQ
Rx_1__SLW EQU CYREG_PRT12_SLW

; Tx_1
Tx_1__0__INTTYPE EQU CYREG_PICU12_INTTYPE7
Tx_1__0__MASK EQU 0x80
Tx_1__0__PC EQU CYREG_PRT12_PC7
Tx_1__0__PORT EQU 12
Tx_1__0__SHIFT EQU 7
Tx_1__AG EQU CYREG_PRT12_AG
Tx_1__BIE EQU CYREG_PRT12_BIE
Tx_1__BIT_MASK EQU CYREG_PRT12_BIT_MASK
Tx_1__BYP EQU CYREG_PRT12_BYP
Tx_1__DM0 EQU CYREG_PRT12_DM0
Tx_1__DM1 EQU CYREG_PRT12_DM1
Tx_1__DM2 EQU CYREG_PRT12_DM2
Tx_1__DR EQU CYREG_PRT12_DR
Tx_1__INP_DIS EQU CYREG_PRT12_INP_DIS
Tx_1__INTTYPE_BASE EQU CYDEV_PICU_INTTYPE_PICU12_BASE
Tx_1__MASK EQU 0x80
Tx_1__PORT EQU 12
Tx_1__PRT EQU CYREG_PRT12_PRT
Tx_1__PRTDSI__DBL_SYNC_IN EQU CYREG_PRT12_DBL_SYNC_IN
Tx_1__PRTDSI__OE_SEL0 EQU CYREG_PRT12_OE_SEL0
Tx_1__PRTDSI__OE_SEL1 EQU CYREG_PRT12_OE_SEL1
Tx_1__PRTDSI__OUT_SEL0 EQU CYREG_PRT12_OUT_SEL0
Tx_1__PRTDSI__OUT_SEL1 EQU CYREG_PRT12_OUT_SEL1
Tx_1__PRTDSI__SYNC_OUT EQU CYREG_PRT12_SYNC_OUT
Tx_1__PS EQU CYREG_PRT12_PS
Tx_1__SHIFT EQU 7
Tx_1__SIO_CFG EQU CYREG_PRT12_SIO_CFG
Tx_1__SIO_DIFF EQU CYREG_PRT12_SIO_DIFF
Tx_1__SIO_HYST_EN EQU CYREG_PRT12_SIO_HYST_EN
Tx_1__SIO_REG_HIFREQ EQU CYREG_PRT12_SIO_REG_HIFREQ
Tx_1__SLW EQU CYREG_PRT12_SLW

; VDAC
VDAC_viDAC8__CR0 EQU CYREG_DAC3_CR0
VDAC_viDAC8__CR1 EQU CYREG_DAC3_CR1
VDAC_viDAC8__D EQU CYREG_DAC3_D
VDAC_viDAC8__PM_ACT_CFG EQU CYREG_PM_ACT_CFG8
VDAC_viDAC8__PM_ACT_MSK EQU 0x08
VDAC_viDAC8__PM_STBY_CFG EQU CYREG_PM_STBY_CFG8
VDAC_viDAC8__PM_STBY_MSK EQU 0x08
VDAC_viDAC8__STROBE EQU CYREG_DAC3_STROBE
VDAC_viDAC8__SW0 EQU CYREG_DAC3_SW0
VDAC_viDAC8__SW2 EQU CYREG_DAC3_SW2
VDAC_viDAC8__SW3 EQU CYREG_DAC3_SW3
VDAC_viDAC8__SW4 EQU CYREG_DAC3_SW4
VDAC_viDAC8__TR EQU CYREG_DAC3_TR
VDAC_viDAC8__TRIM__M1 EQU CYREG_FLSHID_CUST_TABLES_DAC3_M1
VDAC_viDAC8__TRIM__M2 EQU CYREG_FLSHID_CUST_TABLES_DAC3_M2
VDAC_viDAC8__TRIM__M3 EQU CYREG_FLSHID_CUST_TABLES_DAC3_M3
VDAC_viDAC8__TRIM__M4 EQU CYREG_FLSHID_CUST_TABLES_DAC3_M4
VDAC_viDAC8__TRIM__M5 EQU CYREG_FLSHID_CUST_TABLES_DAC3_M5
VDAC_viDAC8__TRIM__M6 EQU CYREG_FLSHID_CUST_TABLES_DAC3_M6
VDAC_viDAC8__TRIM__M7 EQU CYREG_FLSHID_CUST_TABLES_DAC3_M7
VDAC_viDAC8__TRIM__M8 EQU CYREG_FLSHID_CUST_TABLES_DAC3_M8
VDAC_viDAC8__TST EQU CYREG_DAC3_TST

; bleRx
bleRx__0__INTTYPE EQU CYREG_PICU1_INTTYPE6
bleRx__0__MASK EQU 0x40
bleRx__0__PC EQU CYREG_PRT1_PC6
bleRx__0__PORT EQU 1
bleRx__0__SHIFT EQU 6
bleRx__AG EQU CYREG_PRT1_AG
bleRx__AMUX EQU CYREG_PRT1_AMUX
bleRx__BIE EQU CYREG_PRT1_BIE
bleRx__BIT_MASK EQU CYREG_PRT1_BIT_MASK
bleRx__BYP EQU CYREG_PRT1_BYP
bleRx__CTL EQU CYREG_PRT1_CTL
bleRx__DM0 EQU CYREG_PRT1_DM0
bleRx__DM1 EQU CYREG_PRT1_DM1
bleRx__DM2 EQU CYREG_PRT1_DM2
bleRx__DR EQU CYREG_PRT1_DR
bleRx__INP_DIS EQU CYREG_PRT1_INP_DIS
bleRx__INTTYPE_BASE EQU CYDEV_PICU_INTTYPE_PICU1_BASE
bleRx__LCD_COM_SEG EQU CYREG_PRT1_LCD_COM_SEG
bleRx__LCD_EN EQU CYREG_PRT1_LCD_EN
bleRx__MASK EQU 0x40
bleRx__PORT EQU 1
bleRx__PRT EQU CYREG_PRT1_PRT
bleRx__PRTDSI__CAPS_SEL EQU CYREG_PRT1_CAPS_SEL
bleRx__PRTDSI__DBL_SYNC_IN EQU CYREG_PRT1_DBL_SYNC_IN
bleRx__PRTDSI__OE_SEL0 EQU CYREG_PRT1_OE_SEL0
bleRx__PRTDSI__OE_SEL1 EQU CYREG_PRT1_OE_SEL1
bleRx__PRTDSI__OUT_SEL0 EQU CYREG_PRT1_OUT_SEL0
bleRx__PRTDSI__OUT_SEL1 EQU CYREG_PRT1_OUT_SEL1
bleRx__PRTDSI__SYNC_OUT EQU CYREG_PRT1_SYNC_OUT
bleRx__PS EQU CYREG_PRT1_PS
bleRx__SHIFT EQU 6
bleRx__SLW EQU CYREG_PRT1_SLW

; bleTx
bleTx__0__INTTYPE EQU CYREG_PICU12_INTTYPE2
bleTx__0__MASK EQU 0x04
bleTx__0__PC EQU CYREG_PRT12_PC2
bleTx__0__PORT EQU 12
bleTx__0__SHIFT EQU 2
bleTx__AG EQU CYREG_PRT12_AG
bleTx__BIE EQU CYREG_PRT12_BIE
bleTx__BIT_MASK EQU CYREG_PRT12_BIT_MASK
bleTx__BYP EQU CYREG_PRT12_BYP
bleTx__DM0 EQU CYREG_PRT12_DM0
bleTx__DM1 EQU CYREG_PRT12_DM1
bleTx__DM2 EQU CYREG_PRT12_DM2
bleTx__DR EQU CYREG_PRT12_DR
bleTx__INP_DIS EQU CYREG_PRT12_INP_DIS
bleTx__INTTYPE_BASE EQU CYDEV_PICU_INTTYPE_PICU12_BASE
bleTx__MASK EQU 0x04
bleTx__PORT EQU 12
bleTx__PRT EQU CYREG_PRT12_PRT
bleTx__PRTDSI__DBL_SYNC_IN EQU CYREG_PRT12_DBL_SYNC_IN
bleTx__PRTDSI__OE_SEL0 EQU CYREG_PRT12_OE_SEL0
bleTx__PRTDSI__OE_SEL1 EQU CYREG_PRT12_OE_SEL1
bleTx__PRTDSI__OUT_SEL0 EQU CYREG_PRT12_OUT_SEL0
bleTx__PRTDSI__OUT_SEL1 EQU CYREG_PRT12_OUT_SEL1
bleTx__PRTDSI__SYNC_OUT EQU CYREG_PRT12_SYNC_OUT
bleTx__PS EQU CYREG_PRT12_PS
bleTx__SHIFT EQU 2
bleTx__SIO_CFG EQU CYREG_PRT12_SIO_CFG
bleTx__SIO_DIFF EQU CYREG_PRT12_SIO_DIFF
bleTx__SIO_HYST_EN EQU CYREG_PRT12_SIO_HYST_EN
bleTx__SIO_REG_HIFREQ EQU CYREG_PRT12_SIO_REG_HIFREQ
bleTx__SLW EQU CYREG_PRT12_SLW

; Opamp_1
Opamp_1_ABuf__CR EQU CYREG_OPAMP3_CR
Opamp_1_ABuf__MX EQU CYREG_OPAMP3_MX
Opamp_1_ABuf__NPUMP_OPAMP_TR0 EQU CYREG_NPUMP_OPAMP_TR0
Opamp_1_ABuf__PM_ACT_CFG EQU CYREG_PM_ACT_CFG4
Opamp_1_ABuf__PM_ACT_MSK EQU 0x08
Opamp_1_ABuf__PM_STBY_CFG EQU CYREG_PM_STBY_CFG4
Opamp_1_ABuf__PM_STBY_MSK EQU 0x08
Opamp_1_ABuf__RSVD EQU CYREG_OPAMP3_RSVD
Opamp_1_ABuf__SW EQU CYREG_OPAMP3_SW
Opamp_1_ABuf__TR0 EQU CYREG_OPAMP3_TR0
Opamp_1_ABuf__TR1 EQU CYREG_OPAMP3_TR1

; bleUart1
bleUart1_BUART_sRX_RxBitCounter__16BIT_CONTROL_AUX_CTL_REG EQU CYREG_B1_UDB09_10_ACTL
bleUart1_BUART_sRX_RxBitCounter__16BIT_CONTROL_CONTROL_REG EQU CYREG_B1_UDB09_10_CTL
bleUart1_BUART_sRX_RxBitCounter__16BIT_CONTROL_COUNT_REG EQU CYREG_B1_UDB09_10_CTL
bleUart1_BUART_sRX_RxBitCounter__16BIT_COUNT_CONTROL_REG EQU CYREG_B1_UDB09_10_CTL
bleUart1_BUART_sRX_RxBitCounter__16BIT_COUNT_COUNT_REG EQU CYREG_B1_UDB09_10_CTL
bleUart1_BUART_sRX_RxBitCounter__16BIT_MASK_MASK_REG EQU CYREG_B1_UDB09_10_MSK
bleUart1_BUART_sRX_RxBitCounter__16BIT_MASK_PERIOD_REG EQU CYREG_B1_UDB09_10_MSK
bleUart1_BUART_sRX_RxBitCounter__16BIT_PERIOD_MASK_REG EQU CYREG_B1_UDB09_10_MSK
bleUart1_BUART_sRX_RxBitCounter__16BIT_PERIOD_PERIOD_REG EQU CYREG_B1_UDB09_10_MSK
bleUart1_BUART_sRX_RxBitCounter__CONTROL_AUX_CTL_REG EQU CYREG_B1_UDB09_ACTL
bleUart1_BUART_sRX_RxBitCounter__CONTROL_REG EQU CYREG_B1_UDB09_CTL
bleUart1_BUART_sRX_RxBitCounter__CONTROL_ST_REG EQU CYREG_B1_UDB09_ST_CTL
bleUart1_BUART_sRX_RxBitCounter__COUNT_REG EQU CYREG_B1_UDB09_CTL
bleUart1_BUART_sRX_RxBitCounter__COUNT_ST_REG EQU CYREG_B1_UDB09_ST_CTL
bleUart1_BUART_sRX_RxBitCounter__MASK_CTL_AUX_CTL_REG EQU CYREG_B1_UDB09_MSK_ACTL
bleUart1_BUART_sRX_RxBitCounter__PER_CTL_AUX_CTL_REG EQU CYREG_B1_UDB09_MSK_ACTL
bleUart1_BUART_sRX_RxBitCounter__PERIOD_REG EQU CYREG_B1_UDB09_MSK
bleUart1_BUART_sRX_RxBitCounter_ST__16BIT_STATUS_AUX_CTL_REG EQU CYREG_B1_UDB09_10_ACTL
bleUart1_BUART_sRX_RxBitCounter_ST__16BIT_STATUS_REG EQU CYREG_B1_UDB09_10_ST
bleUart1_BUART_sRX_RxBitCounter_ST__MASK_REG EQU CYREG_B1_UDB09_MSK
bleUart1_BUART_sRX_RxBitCounter_ST__MASK_ST_AUX_CTL_REG EQU CYREG_B1_UDB09_MSK_ACTL
bleUart1_BUART_sRX_RxBitCounter_ST__PER_ST_AUX_CTL_REG EQU CYREG_B1_UDB09_MSK_ACTL
bleUart1_BUART_sRX_RxBitCounter_ST__STATUS_AUX_CTL_REG EQU CYREG_B1_UDB09_ACTL
bleUart1_BUART_sRX_RxBitCounter_ST__STATUS_CNT_REG EQU CYREG_B1_UDB09_ST_CTL
bleUart1_BUART_sRX_RxBitCounter_ST__STATUS_CONTROL_REG EQU CYREG_B1_UDB09_ST_CTL
bleUart1_BUART_sRX_RxBitCounter_ST__STATUS_REG EQU CYREG_B1_UDB09_ST
bleUart1_BUART_sRX_RxShifter_u0__16BIT_A0_REG EQU CYREG_B1_UDB09_10_A0
bleUart1_BUART_sRX_RxShifter_u0__16BIT_A1_REG EQU CYREG_B1_UDB09_10_A1
bleUart1_BUART_sRX_RxShifter_u0__16BIT_D0_REG EQU CYREG_B1_UDB09_10_D0
bleUart1_BUART_sRX_RxShifter_u0__16BIT_D1_REG EQU CYREG_B1_UDB09_10_D1
bleUart1_BUART_sRX_RxShifter_u0__16BIT_DP_AUX_CTL_REG EQU CYREG_B1_UDB09_10_ACTL
bleUart1_BUART_sRX_RxShifter_u0__16BIT_F0_REG EQU CYREG_B1_UDB09_10_F0
bleUart1_BUART_sRX_RxShifter_u0__16BIT_F1_REG EQU CYREG_B1_UDB09_10_F1
bleUart1_BUART_sRX_RxShifter_u0__A0_A1_REG EQU CYREG_B1_UDB09_A0_A1
bleUart1_BUART_sRX_RxShifter_u0__A0_REG EQU CYREG_B1_UDB09_A0
bleUart1_BUART_sRX_RxShifter_u0__A1_REG EQU CYREG_B1_UDB09_A1
bleUart1_BUART_sRX_RxShifter_u0__D0_D1_REG EQU CYREG_B1_UDB09_D0_D1
bleUart1_BUART_sRX_RxShifter_u0__D0_REG EQU CYREG_B1_UDB09_D0
bleUart1_BUART_sRX_RxShifter_u0__D1_REG EQU CYREG_B1_UDB09_D1
bleUart1_BUART_sRX_RxShifter_u0__DP_AUX_CTL_REG EQU CYREG_B1_UDB09_ACTL
bleUart1_BUART_sRX_RxShifter_u0__F0_F1_REG EQU CYREG_B1_UDB09_F0_F1
bleUart1_BUART_sRX_RxShifter_u0__F0_REG EQU CYREG_B1_UDB09_F0
bleUart1_BUART_sRX_RxShifter_u0__F1_REG EQU CYREG_B1_UDB09_F1
bleUart1_BUART_sRX_RxShifter_u0__MSK_DP_AUX_CTL_REG EQU CYREG_B1_UDB09_MSK_ACTL
bleUart1_BUART_sRX_RxShifter_u0__PER_DP_AUX_CTL_REG EQU CYREG_B1_UDB09_MSK_ACTL
bleUart1_BUART_sRX_RxSts__16BIT_STATUS_AUX_CTL_REG EQU CYREG_B1_UDB08_09_ACTL
bleUart1_BUART_sRX_RxSts__16BIT_STATUS_REG EQU CYREG_B1_UDB08_09_ST
bleUart1_BUART_sRX_RxSts__3__MASK EQU 0x08
bleUart1_BUART_sRX_RxSts__3__POS EQU 3
bleUart1_BUART_sRX_RxSts__4__MASK EQU 0x10
bleUart1_BUART_sRX_RxSts__4__POS EQU 4
bleUart1_BUART_sRX_RxSts__5__MASK EQU 0x20
bleUart1_BUART_sRX_RxSts__5__POS EQU 5
bleUart1_BUART_sRX_RxSts__MASK EQU 0x38
bleUart1_BUART_sRX_RxSts__MASK_REG EQU CYREG_B1_UDB08_MSK
bleUart1_BUART_sRX_RxSts__STATUS_AUX_CTL_REG EQU CYREG_B1_UDB08_ACTL
bleUart1_BUART_sRX_RxSts__STATUS_REG EQU CYREG_B1_UDB08_ST
bleUart1_BUART_sTX_sCLOCK_TxBitClkGen__16BIT_A0_REG EQU CYREG_B0_UDB09_10_A0
bleUart1_BUART_sTX_sCLOCK_TxBitClkGen__16BIT_A1_REG EQU CYREG_B0_UDB09_10_A1
bleUart1_BUART_sTX_sCLOCK_TxBitClkGen__16BIT_D0_REG EQU CYREG_B0_UDB09_10_D0
bleUart1_BUART_sTX_sCLOCK_TxBitClkGen__16BIT_D1_REG EQU CYREG_B0_UDB09_10_D1
bleUart1_BUART_sTX_sCLOCK_TxBitClkGen__16BIT_DP_AUX_CTL_REG EQU CYREG_B0_UDB09_10_ACTL
bleUart1_BUART_sTX_sCLOCK_TxBitClkGen__16BIT_F0_REG EQU CYREG_B0_UDB09_10_F0
bleUart1_BUART_sTX_sCLOCK_TxBitClkGen__16BIT_F1_REG EQU CYREG_B0_UDB09_10_F1
bleUart1_BUART_sTX_sCLOCK_TxBitClkGen__A0_A1_REG EQU CYREG_B0_UDB09_A0_A1
bleUart1_BUART_sTX_sCLOCK_TxBitClkGen__A0_REG EQU CYREG_B0_UDB09_A0
bleUart1_BUART_sTX_sCLOCK_TxBitClkGen__A1_REG EQU CYREG_B0_UDB09_A1
bleUart1_BUART_sTX_sCLOCK_TxBitClkGen__D0_D1_REG EQU CYREG_B0_UDB09_D0_D1
bleUart1_BUART_sTX_sCLOCK_TxBitClkGen__D0_REG EQU CYREG_B0_UDB09_D0
bleUart1_BUART_sTX_sCLOCK_TxBitClkGen__D1_REG EQU CYREG_B0_UDB09_D1
bleUart1_BUART_sTX_sCLOCK_TxBitClkGen__DP_AUX_CTL_REG EQU CYREG_B0_UDB09_ACTL
bleUart1_BUART_sTX_sCLOCK_TxBitClkGen__F0_F1_REG EQU CYREG_B0_UDB09_F0_F1
bleUart1_BUART_sTX_sCLOCK_TxBitClkGen__F0_REG EQU CYREG_B0_UDB09_F0
bleUart1_BUART_sTX_sCLOCK_TxBitClkGen__F1_REG EQU CYREG_B0_UDB09_F1
bleUart1_BUART_sTX_TxShifter_u0__16BIT_A0_REG EQU CYREG_B0_UDB10_11_A0
bleUart1_BUART_sTX_TxShifter_u0__16BIT_A1_REG EQU CYREG_B0_UDB10_11_A1
bleUart1_BUART_sTX_TxShifter_u0__16BIT_D0_REG EQU CYREG_B0_UDB10_11_D0
bleUart1_BUART_sTX_TxShifter_u0__16BIT_D1_REG EQU CYREG_B0_UDB10_11_D1
bleUart1_BUART_sTX_TxShifter_u0__16BIT_DP_AUX_CTL_REG EQU CYREG_B0_UDB10_11_ACTL
bleUart1_BUART_sTX_TxShifter_u0__16BIT_F0_REG EQU CYREG_B0_UDB10_11_F0
bleUart1_BUART_sTX_TxShifter_u0__16BIT_F1_REG EQU CYREG_B0_UDB10_11_F1
bleUart1_BUART_sTX_TxShifter_u0__A0_A1_REG EQU CYREG_B0_UDB10_A0_A1
bleUart1_BUART_sTX_TxShifter_u0__A0_REG EQU CYREG_B0_UDB10_A0
bleUart1_BUART_sTX_TxShifter_u0__A1_REG EQU CYREG_B0_UDB10_A1
bleUart1_BUART_sTX_TxShifter_u0__D0_D1_REG EQU CYREG_B0_UDB10_D0_D1
bleUart1_BUART_sTX_TxShifter_u0__D0_REG EQU CYREG_B0_UDB10_D0
bleUart1_BUART_sTX_TxShifter_u0__D1_REG EQU CYREG_B0_UDB10_D1
bleUart1_BUART_sTX_TxShifter_u0__DP_AUX_CTL_REG EQU CYREG_B0_UDB10_ACTL
bleUart1_BUART_sTX_TxShifter_u0__F0_F1_REG EQU CYREG_B0_UDB10_F0_F1
bleUart1_BUART_sTX_TxShifter_u0__F0_REG EQU CYREG_B0_UDB10_F0
bleUart1_BUART_sTX_TxShifter_u0__F1_REG EQU CYREG_B0_UDB10_F1
bleUart1_BUART_sTX_TxSts__0__MASK EQU 0x01
bleUart1_BUART_sTX_TxSts__0__POS EQU 0
bleUart1_BUART_sTX_TxSts__1__MASK EQU 0x02
bleUart1_BUART_sTX_TxSts__1__POS EQU 1
bleUart1_BUART_sTX_TxSts__16BIT_STATUS_AUX_CTL_REG EQU CYREG_B0_UDB10_11_ACTL
bleUart1_BUART_sTX_TxSts__16BIT_STATUS_REG EQU CYREG_B0_UDB10_11_ST
bleUart1_BUART_sTX_TxSts__2__MASK EQU 0x04
bleUart1_BUART_sTX_TxSts__2__POS EQU 2
bleUart1_BUART_sTX_TxSts__3__MASK EQU 0x08
bleUart1_BUART_sTX_TxSts__3__POS EQU 3
bleUart1_BUART_sTX_TxSts__MASK EQU 0x0F
bleUart1_BUART_sTX_TxSts__MASK_REG EQU CYREG_B0_UDB10_MSK
bleUart1_BUART_sTX_TxSts__STATUS_AUX_CTL_REG EQU CYREG_B0_UDB10_ACTL
bleUart1_BUART_sTX_TxSts__STATUS_REG EQU CYREG_B0_UDB10_ST
bleUart1_IntClock__CFG0 EQU CYREG_CLKDIST_DCFG0_CFG0
bleUart1_IntClock__CFG1 EQU CYREG_CLKDIST_DCFG0_CFG1
bleUart1_IntClock__CFG2 EQU CYREG_CLKDIST_DCFG0_CFG2
bleUart1_IntClock__CFG2_SRC_SEL_MASK EQU 0x07
bleUart1_IntClock__INDEX EQU 0x00
bleUart1_IntClock__PM_ACT_CFG EQU CYREG_PM_ACT_CFG2
bleUart1_IntClock__PM_ACT_MSK EQU 0x01
bleUart1_IntClock__PM_STBY_CFG EQU CYREG_PM_STBY_CFG2
bleUart1_IntClock__PM_STBY_MSK EQU 0x01

; rxBleISR
rxBleISR__INTC_CLR_EN_REG EQU CYREG_NVIC_CLRENA0
rxBleISR__INTC_CLR_PD_REG EQU CYREG_NVIC_CLRPEND0
rxBleISR__INTC_MASK EQU 0x01
rxBleISR__INTC_NUMBER EQU 0
rxBleISR__INTC_PRIOR_NUM EQU 7
rxBleISR__INTC_PRIOR_REG EQU CYREG_NVIC_PRI_0
rxBleISR__INTC_SET_EN_REG EQU CYREG_NVIC_SETENA0
rxBleISR__INTC_SET_PD_REG EQU CYREG_NVIC_SETPEND0

; puttyUart1
puttyUart1_BUART_sRX_RxBitCounter__16BIT_CONTROL_AUX_CTL_REG EQU CYREG_B1_UDB10_11_ACTL
puttyUart1_BUART_sRX_RxBitCounter__16BIT_CONTROL_CONTROL_REG EQU CYREG_B1_UDB10_11_CTL
puttyUart1_BUART_sRX_RxBitCounter__16BIT_CONTROL_COUNT_REG EQU CYREG_B1_UDB10_11_CTL
puttyUart1_BUART_sRX_RxBitCounter__16BIT_COUNT_CONTROL_REG EQU CYREG_B1_UDB10_11_CTL
puttyUart1_BUART_sRX_RxBitCounter__16BIT_COUNT_COUNT_REG EQU CYREG_B1_UDB10_11_CTL
puttyUart1_BUART_sRX_RxBitCounter__16BIT_MASK_MASK_REG EQU CYREG_B1_UDB10_11_MSK
puttyUart1_BUART_sRX_RxBitCounter__16BIT_MASK_PERIOD_REG EQU CYREG_B1_UDB10_11_MSK
puttyUart1_BUART_sRX_RxBitCounter__16BIT_PERIOD_MASK_REG EQU CYREG_B1_UDB10_11_MSK
puttyUart1_BUART_sRX_RxBitCounter__16BIT_PERIOD_PERIOD_REG EQU CYREG_B1_UDB10_11_MSK
puttyUart1_BUART_sRX_RxBitCounter__CONTROL_AUX_CTL_REG EQU CYREG_B1_UDB10_ACTL
puttyUart1_BUART_sRX_RxBitCounter__CONTROL_REG EQU CYREG_B1_UDB10_CTL
puttyUart1_BUART_sRX_RxBitCounter__CONTROL_ST_REG EQU CYREG_B1_UDB10_ST_CTL
puttyUart1_BUART_sRX_RxBitCounter__COUNT_REG EQU CYREG_B1_UDB10_CTL
puttyUart1_BUART_sRX_RxBitCounter__COUNT_ST_REG EQU CYREG_B1_UDB10_ST_CTL
puttyUart1_BUART_sRX_RxBitCounter__MASK_CTL_AUX_CTL_REG EQU CYREG_B1_UDB10_MSK_ACTL
puttyUart1_BUART_sRX_RxBitCounter__PER_CTL_AUX_CTL_REG EQU CYREG_B1_UDB10_MSK_ACTL
puttyUart1_BUART_sRX_RxBitCounter__PERIOD_REG EQU CYREG_B1_UDB10_MSK
puttyUart1_BUART_sRX_RxBitCounter_ST__16BIT_STATUS_AUX_CTL_REG EQU CYREG_B1_UDB10_11_ACTL
puttyUart1_BUART_sRX_RxBitCounter_ST__16BIT_STATUS_REG EQU CYREG_B1_UDB10_11_ST
puttyUart1_BUART_sRX_RxBitCounter_ST__MASK_REG EQU CYREG_B1_UDB10_MSK
puttyUart1_BUART_sRX_RxBitCounter_ST__MASK_ST_AUX_CTL_REG EQU CYREG_B1_UDB10_MSK_ACTL
puttyUart1_BUART_sRX_RxBitCounter_ST__PER_ST_AUX_CTL_REG EQU CYREG_B1_UDB10_MSK_ACTL
puttyUart1_BUART_sRX_RxBitCounter_ST__STATUS_AUX_CTL_REG EQU CYREG_B1_UDB10_ACTL
puttyUart1_BUART_sRX_RxBitCounter_ST__STATUS_CNT_REG EQU CYREG_B1_UDB10_ST_CTL
puttyUart1_BUART_sRX_RxBitCounter_ST__STATUS_CONTROL_REG EQU CYREG_B1_UDB10_ST_CTL
puttyUart1_BUART_sRX_RxBitCounter_ST__STATUS_REG EQU CYREG_B1_UDB10_ST
puttyUart1_BUART_sRX_RxShifter_u0__16BIT_A0_REG EQU CYREG_B1_UDB10_11_A0
puttyUart1_BUART_sRX_RxShifter_u0__16BIT_A1_REG EQU CYREG_B1_UDB10_11_A1
puttyUart1_BUART_sRX_RxShifter_u0__16BIT_D0_REG EQU CYREG_B1_UDB10_11_D0
puttyUart1_BUART_sRX_RxShifter_u0__16BIT_D1_REG EQU CYREG_B1_UDB10_11_D1
puttyUart1_BUART_sRX_RxShifter_u0__16BIT_DP_AUX_CTL_REG EQU CYREG_B1_UDB10_11_ACTL
puttyUart1_BUART_sRX_RxShifter_u0__16BIT_F0_REG EQU CYREG_B1_UDB10_11_F0
puttyUart1_BUART_sRX_RxShifter_u0__16BIT_F1_REG EQU CYREG_B1_UDB10_11_F1
puttyUart1_BUART_sRX_RxShifter_u0__A0_A1_REG EQU CYREG_B1_UDB10_A0_A1
puttyUart1_BUART_sRX_RxShifter_u0__A0_REG EQU CYREG_B1_UDB10_A0
puttyUart1_BUART_sRX_RxShifter_u0__A1_REG EQU CYREG_B1_UDB10_A1
puttyUart1_BUART_sRX_RxShifter_u0__D0_D1_REG EQU CYREG_B1_UDB10_D0_D1
puttyUart1_BUART_sRX_RxShifter_u0__D0_REG EQU CYREG_B1_UDB10_D0
puttyUart1_BUART_sRX_RxShifter_u0__D1_REG EQU CYREG_B1_UDB10_D1
puttyUart1_BUART_sRX_RxShifter_u0__DP_AUX_CTL_REG EQU CYREG_B1_UDB10_ACTL
puttyUart1_BUART_sRX_RxShifter_u0__F0_F1_REG EQU CYREG_B1_UDB10_F0_F1
puttyUart1_BUART_sRX_RxShifter_u0__F0_REG EQU CYREG_B1_UDB10_F0
puttyUart1_BUART_sRX_RxShifter_u0__F1_REG EQU CYREG_B1_UDB10_F1
puttyUart1_BUART_sRX_RxShifter_u0__MSK_DP_AUX_CTL_REG EQU CYREG_B1_UDB10_MSK_ACTL
puttyUart1_BUART_sRX_RxShifter_u0__PER_DP_AUX_CTL_REG EQU CYREG_B1_UDB10_MSK_ACTL
puttyUart1_BUART_sRX_RxSts__3__MASK EQU 0x08
puttyUart1_BUART_sRX_RxSts__3__POS EQU 3
puttyUart1_BUART_sRX_RxSts__4__MASK EQU 0x10
puttyUart1_BUART_sRX_RxSts__4__POS EQU 4
puttyUart1_BUART_sRX_RxSts__5__MASK EQU 0x20
puttyUart1_BUART_sRX_RxSts__5__POS EQU 5
puttyUart1_BUART_sRX_RxSts__MASK EQU 0x38
puttyUart1_BUART_sRX_RxSts__MASK_REG EQU CYREG_B1_UDB11_MSK
puttyUart1_BUART_sRX_RxSts__STATUS_AUX_CTL_REG EQU CYREG_B1_UDB11_ACTL
puttyUart1_BUART_sRX_RxSts__STATUS_REG EQU CYREG_B1_UDB11_ST
puttyUart1_BUART_sTX_sCLOCK_TxBitClkGen__16BIT_A0_REG EQU CYREG_B0_UDB08_09_A0
puttyUart1_BUART_sTX_sCLOCK_TxBitClkGen__16BIT_A1_REG EQU CYREG_B0_UDB08_09_A1
puttyUart1_BUART_sTX_sCLOCK_TxBitClkGen__16BIT_D0_REG EQU CYREG_B0_UDB08_09_D0
puttyUart1_BUART_sTX_sCLOCK_TxBitClkGen__16BIT_D1_REG EQU CYREG_B0_UDB08_09_D1
puttyUart1_BUART_sTX_sCLOCK_TxBitClkGen__16BIT_DP_AUX_CTL_REG EQU CYREG_B0_UDB08_09_ACTL
puttyUart1_BUART_sTX_sCLOCK_TxBitClkGen__16BIT_F0_REG EQU CYREG_B0_UDB08_09_F0
puttyUart1_BUART_sTX_sCLOCK_TxBitClkGen__16BIT_F1_REG EQU CYREG_B0_UDB08_09_F1
puttyUart1_BUART_sTX_sCLOCK_TxBitClkGen__A0_A1_REG EQU CYREG_B0_UDB08_A0_A1
puttyUart1_BUART_sTX_sCLOCK_TxBitClkGen__A0_REG EQU CYREG_B0_UDB08_A0
puttyUart1_BUART_sTX_sCLOCK_TxBitClkGen__A1_REG EQU CYREG_B0_UDB08_A1
puttyUart1_BUART_sTX_sCLOCK_TxBitClkGen__D0_D1_REG EQU CYREG_B0_UDB08_D0_D1
puttyUart1_BUART_sTX_sCLOCK_TxBitClkGen__D0_REG EQU CYREG_B0_UDB08_D0
puttyUart1_BUART_sTX_sCLOCK_TxBitClkGen__D1_REG EQU CYREG_B0_UDB08_D1
puttyUart1_BUART_sTX_sCLOCK_TxBitClkGen__DP_AUX_CTL_REG EQU CYREG_B0_UDB08_ACTL
puttyUart1_BUART_sTX_sCLOCK_TxBitClkGen__F0_F1_REG EQU CYREG_B0_UDB08_F0_F1
puttyUart1_BUART_sTX_sCLOCK_TxBitClkGen__F0_REG EQU CYREG_B0_UDB08_F0
puttyUart1_BUART_sTX_sCLOCK_TxBitClkGen__F1_REG EQU CYREG_B0_UDB08_F1
puttyUart1_BUART_sTX_TxShifter_u0__16BIT_A0_REG EQU CYREG_B0_UDB11_12_A0
puttyUart1_BUART_sTX_TxShifter_u0__16BIT_A1_REG EQU CYREG_B0_UDB11_12_A1
puttyUart1_BUART_sTX_TxShifter_u0__16BIT_D0_REG EQU CYREG_B0_UDB11_12_D0
puttyUart1_BUART_sTX_TxShifter_u0__16BIT_D1_REG EQU CYREG_B0_UDB11_12_D1
puttyUart1_BUART_sTX_TxShifter_u0__16BIT_DP_AUX_CTL_REG EQU CYREG_B0_UDB11_12_ACTL
puttyUart1_BUART_sTX_TxShifter_u0__16BIT_F0_REG EQU CYREG_B0_UDB11_12_F0
puttyUart1_BUART_sTX_TxShifter_u0__16BIT_F1_REG EQU CYREG_B0_UDB11_12_F1
puttyUart1_BUART_sTX_TxShifter_u0__A0_A1_REG EQU CYREG_B0_UDB11_A0_A1
puttyUart1_BUART_sTX_TxShifter_u0__A0_REG EQU CYREG_B0_UDB11_A0
puttyUart1_BUART_sTX_TxShifter_u0__A1_REG EQU CYREG_B0_UDB11_A1
puttyUart1_BUART_sTX_TxShifter_u0__D0_D1_REG EQU CYREG_B0_UDB11_D0_D1
puttyUart1_BUART_sTX_TxShifter_u0__D0_REG EQU CYREG_B0_UDB11_D0
puttyUart1_BUART_sTX_TxShifter_u0__D1_REG EQU CYREG_B0_UDB11_D1
puttyUart1_BUART_sTX_TxShifter_u0__DP_AUX_CTL_REG EQU CYREG_B0_UDB11_ACTL
puttyUart1_BUART_sTX_TxShifter_u0__F0_F1_REG EQU CYREG_B0_UDB11_F0_F1
puttyUart1_BUART_sTX_TxShifter_u0__F0_REG EQU CYREG_B0_UDB11_F0
puttyUart1_BUART_sTX_TxShifter_u0__F1_REG EQU CYREG_B0_UDB11_F1
puttyUart1_BUART_sTX_TxSts__0__MASK EQU 0x01
puttyUart1_BUART_sTX_TxSts__0__POS EQU 0
puttyUart1_BUART_sTX_TxSts__1__MASK EQU 0x02
puttyUart1_BUART_sTX_TxSts__1__POS EQU 1
puttyUart1_BUART_sTX_TxSts__16BIT_STATUS_AUX_CTL_REG EQU CYREG_B0_UDB11_12_ACTL
puttyUart1_BUART_sTX_TxSts__16BIT_STATUS_REG EQU CYREG_B0_UDB11_12_ST
puttyUart1_BUART_sTX_TxSts__2__MASK EQU 0x04
puttyUart1_BUART_sTX_TxSts__2__POS EQU 2
puttyUart1_BUART_sTX_TxSts__3__MASK EQU 0x08
puttyUart1_BUART_sTX_TxSts__3__POS EQU 3
puttyUart1_BUART_sTX_TxSts__MASK EQU 0x0F
puttyUart1_BUART_sTX_TxSts__MASK_REG EQU CYREG_B0_UDB11_MSK
puttyUart1_BUART_sTX_TxSts__STATUS_AUX_CTL_REG EQU CYREG_B0_UDB11_ACTL
puttyUart1_BUART_sTX_TxSts__STATUS_REG EQU CYREG_B0_UDB11_ST
puttyUart1_IntClock__CFG0 EQU CYREG_CLKDIST_DCFG1_CFG0
puttyUart1_IntClock__CFG1 EQU CYREG_CLKDIST_DCFG1_CFG1
puttyUart1_IntClock__CFG2 EQU CYREG_CLKDIST_DCFG1_CFG2
puttyUart1_IntClock__CFG2_SRC_SEL_MASK EQU 0x07
puttyUart1_IntClock__INDEX EQU 0x01
puttyUart1_IntClock__PM_ACT_CFG EQU CYREG_PM_ACT_CFG2
puttyUart1_IntClock__PM_ACT_MSK EQU 0x02
puttyUart1_IntClock__PM_STBY_CFG EQU CYREG_PM_STBY_CFG2
puttyUart1_IntClock__PM_STBY_MSK EQU 0x02

; rxPuttyISR
rxPuttyISR__INTC_CLR_EN_REG EQU CYREG_NVIC_CLRENA0
rxPuttyISR__INTC_CLR_PD_REG EQU CYREG_NVIC_CLRPEND0
rxPuttyISR__INTC_MASK EQU 0x02
rxPuttyISR__INTC_NUMBER EQU 1
rxPuttyISR__INTC_PRIOR_NUM EQU 7
rxPuttyISR__INTC_PRIOR_REG EQU CYREG_NVIC_PRI_1
rxPuttyISR__INTC_SET_EN_REG EQU CYREG_NVIC_SETENA0
rxPuttyISR__INTC_SET_PD_REG EQU CYREG_NVIC_SETPEND0

; Miscellaneous
BCLK__BUS_CLK__HZ EQU 24000000
BCLK__BUS_CLK__KHZ EQU 24000
BCLK__BUS_CLK__MHZ EQU 24
CYDEV_CHIP_DIE_LEOPARD EQU 1
CYDEV_CHIP_DIE_PSOC4A EQU 18
CYDEV_CHIP_DIE_PSOC5LP EQU 2
CYDEV_CHIP_DIE_PSOC5TM EQU 3
CYDEV_CHIP_DIE_TMA4 EQU 4
CYDEV_CHIP_DIE_UNKNOWN EQU 0
CYDEV_CHIP_FAMILY_FM0P EQU 5
CYDEV_CHIP_FAMILY_FM3 EQU 6
CYDEV_CHIP_FAMILY_FM4 EQU 7
CYDEV_CHIP_FAMILY_PSOC3 EQU 1
CYDEV_CHIP_FAMILY_PSOC4 EQU 2
CYDEV_CHIP_FAMILY_PSOC5 EQU 3
CYDEV_CHIP_FAMILY_PSOC6 EQU 4
CYDEV_CHIP_FAMILY_UNKNOWN EQU 0
CYDEV_CHIP_FAMILY_USED EQU CYDEV_CHIP_FAMILY_PSOC5
CYDEV_CHIP_JTAG_ID EQU 0x2E156069
CYDEV_CHIP_MEMBER_3A EQU 1
CYDEV_CHIP_MEMBER_4A EQU 18
CYDEV_CHIP_MEMBER_4D EQU 13
CYDEV_CHIP_MEMBER_4E EQU 6
CYDEV_CHIP_MEMBER_4F EQU 19
CYDEV_CHIP_MEMBER_4G EQU 4
CYDEV_CHIP_MEMBER_4H EQU 17
CYDEV_CHIP_MEMBER_4I EQU 23
CYDEV_CHIP_MEMBER_4J EQU 14
CYDEV_CHIP_MEMBER_4K EQU 15
CYDEV_CHIP_MEMBER_4L EQU 22
CYDEV_CHIP_MEMBER_4M EQU 21
CYDEV_CHIP_MEMBER_4N EQU 10
CYDEV_CHIP_MEMBER_4O EQU 7
CYDEV_CHIP_MEMBER_4P EQU 20
CYDEV_CHIP_MEMBER_4Q EQU 12
CYDEV_CHIP_MEMBER_4R EQU 8
CYDEV_CHIP_MEMBER_4S EQU 11
CYDEV_CHIP_MEMBER_4T EQU 9
CYDEV_CHIP_MEMBER_4U EQU 5
CYDEV_CHIP_MEMBER_4V EQU 16
CYDEV_CHIP_MEMBER_5A EQU 3
CYDEV_CHIP_MEMBER_5B EQU 2
CYDEV_CHIP_MEMBER_6A EQU 24
CYDEV_CHIP_MEMBER_FM3 EQU 28
CYDEV_CHIP_MEMBER_FM4 EQU 29
CYDEV_CHIP_MEMBER_PDL_FM0P_TYPE1 EQU 25
CYDEV_CHIP_MEMBER_PDL_FM0P_TYPE2 EQU 26
CYDEV_CHIP_MEMBER_PDL_FM0P_TYPE3 EQU 27
CYDEV_CHIP_MEMBER_UNKNOWN EQU 0
CYDEV_CHIP_MEMBER_USED EQU CYDEV_CHIP_MEMBER_5B
CYDEV_CHIP_DIE_EXPECT EQU CYDEV_CHIP_MEMBER_USED
CYDEV_CHIP_DIE_ACTUAL EQU CYDEV_CHIP_DIE_EXPECT
CYDEV_CHIP_REV_LEOPARD_ES1 EQU 0
CYDEV_CHIP_REV_LEOPARD_ES2 EQU 1
CYDEV_CHIP_REV_LEOPARD_ES3 EQU 3
CYDEV_CHIP_REV_LEOPARD_PRODUCTION EQU 3
CYDEV_CHIP_REV_PSOC4A_ES0 EQU 17
CYDEV_CHIP_REV_PSOC4A_PRODUCTION EQU 17
CYDEV_CHIP_REV_PSOC5LP_ES0 EQU 0
CYDEV_CHIP_REV_PSOC5LP_PRODUCTION EQU 0
CYDEV_CHIP_REV_PSOC5TM_ES0 EQU 0
CYDEV_CHIP_REV_PSOC5TM_ES1 EQU 1
CYDEV_CHIP_REV_PSOC5TM_PRODUCTION EQU 1
CYDEV_CHIP_REV_TMA4_ES EQU 17
CYDEV_CHIP_REV_TMA4_ES2 EQU 33
CYDEV_CHIP_REV_TMA4_PRODUCTION EQU 17
CYDEV_CHIP_REVISION_3A_ES1 EQU 0
CYDEV_CHIP_REVISION_3A_ES2 EQU 1
CYDEV_CHIP_REVISION_3A_ES3 EQU 3
CYDEV_CHIP_REVISION_3A_PRODUCTION EQU 3
CYDEV_CHIP_REVISION_4A_ES0 EQU 17
CYDEV_CHIP_REVISION_4A_PRODUCTION EQU 17
CYDEV_CHIP_REVISION_4D_PRODUCTION EQU 0
CYDEV_CHIP_REVISION_4E_CCG2_NO_USBPD EQU 0
CYDEV_CHIP_REVISION_4E_PRODUCTION EQU 0
CYDEV_CHIP_REVISION_4F_PRODUCTION EQU 0
CYDEV_CHIP_REVISION_4F_PRODUCTION_256DMA EQU 0
CYDEV_CHIP_REVISION_4F_PRODUCTION_256K EQU 0
CYDEV_CHIP_REVISION_4G_ES EQU 17
CYDEV_CHIP_REVISION_4G_ES2 EQU 33
CYDEV_CHIP_REVISION_4G_PRODUCTION EQU 17
CYDEV_CHIP_REVISION_4H_PRODUCTION EQU 0
CYDEV_CHIP_REVISION_4I_PRODUCTION EQU 0
CYDEV_CHIP_REVISION_4J_PRODUCTION EQU 0
CYDEV_CHIP_REVISION_4K_PRODUCTION EQU 0
CYDEV_CHIP_REVISION_4L_PRODUCTION EQU 0
CYDEV_CHIP_REVISION_4M_PRODUCTION EQU 0
CYDEV_CHIP_REVISION_4N_PRODUCTION EQU 0
CYDEV_CHIP_REVISION_4O_PRODUCTION EQU 0
CYDEV_CHIP_REVISION_4P_PRODUCTION EQU 0
CYDEV_CHIP_REVISION_4Q_PRODUCTION EQU 0
CYDEV_CHIP_REVISION_4R_PRODUCTION EQU 0
CYDEV_CHIP_REVISION_4S_PRODUCTION EQU 0
CYDEV_CHIP_REVISION_4T_PRODUCTION EQU 0
CYDEV_CHIP_REVISION_4U_PRODUCTION EQU 0
CYDEV_CHIP_REVISION_4V_PRODUCTION EQU 0
CYDEV_CHIP_REVISION_5A_ES0 EQU 0
CYDEV_CHIP_REVISION_5A_ES1 EQU 1
CYDEV_CHIP_REVISION_5A_PRODUCTION EQU 1
CYDEV_CHIP_REVISION_5B_ES0 EQU 0
CYDEV_CHIP_REVISION_5B_PRODUCTION EQU 0
CYDEV_CHIP_REVISION_6A_ES EQU 17
CYDEV_CHIP_REVISION_6A_NO_UDB EQU 33
CYDEV_CHIP_REVISION_6A_PRODUCTION EQU 33
CYDEV_CHIP_REVISION_FM3_PRODUCTION EQU 0
CYDEV_CHIP_REVISION_FM4_PRODUCTION EQU 0
CYDEV_CHIP_REVISION_PDL_FM0P_TYPE1_PRODUCTION EQU 0
CYDEV_CHIP_REVISION_PDL_FM0P_TYPE2_PRODUCTION EQU 0
CYDEV_CHIP_REVISION_PDL_FM0P_TYPE3_PRODUCTION EQU 0
CYDEV_CHIP_REVISION_USED EQU CYDEV_CHIP_REVISION_5B_PRODUCTION
CYDEV_CHIP_REV_EXPECT EQU CYDEV_CHIP_REVISION_USED
CYDEV_CONFIG_FASTBOOT_ENABLED EQU 1
CYDEV_CONFIG_UNUSED_IO_AllowButWarn EQU 0
CYDEV_CONFIG_UNUSED_IO EQU CYDEV_CONFIG_UNUSED_IO_AllowButWarn
CYDEV_CONFIG_UNUSED_IO_AllowWithInfo EQU 1
CYDEV_CONFIG_UNUSED_IO_Disallowed EQU 2
CYDEV_CONFIGURATION_COMPRESSED EQU 1
CYDEV_CONFIGURATION_DMA EQU 0
CYDEV_CONFIGURATION_ECC EQU 1
CYDEV_CONFIGURATION_IMOENABLED EQU CYDEV_CONFIG_FASTBOOT_ENABLED
CYDEV_CONFIGURATION_MODE_COMPRESSED EQU 0
CYDEV_CONFIGURATION_MODE EQU CYDEV_CONFIGURATION_MODE_COMPRESSED
CYDEV_CONFIGURATION_MODE_DMA EQU 2
CYDEV_CONFIGURATION_MODE_UNCOMPRESSED EQU 1
CYDEV_DEBUG_ENABLE_MASK EQU 0x20
CYDEV_DEBUG_ENABLE_REGISTER EQU CYREG_MLOGIC_DEBUG
CYDEV_DEBUGGING_DPS_Disable EQU 3
CYDEV_DEBUGGING_DPS_JTAG_4 EQU 1
CYDEV_DEBUGGING_DPS_JTAG_5 EQU 0
CYDEV_DEBUGGING_DPS_SWD EQU 2
CYDEV_DEBUGGING_DPS_SWD_SWV EQU 6
CYDEV_DEBUGGING_DPS EQU CYDEV_DEBUGGING_DPS_SWD_SWV
CYDEV_DEBUGGING_ENABLE EQU 1
CYDEV_DEBUGGING_XRES EQU 0
CYDEV_DMA_CHANNELS_AVAILABLE EQU 24
CYDEV_ECC_ENABLE EQU 0
CYDEV_HEAP_SIZE EQU 0x80
CYDEV_INSTRUCT_CACHE_ENABLED EQU 1
CYDEV_INTR_RISING EQU 0x00000003
CYDEV_IS_EXPORTING_CODE EQU 0
CYDEV_IS_IMPORTING_CODE EQU 0
CYDEV_PROJ_TYPE EQU 0
CYDEV_PROJ_TYPE_BOOTLOADER EQU 1
CYDEV_PROJ_TYPE_LAUNCHER EQU 5
CYDEV_PROJ_TYPE_LOADABLE EQU 2
CYDEV_PROJ_TYPE_LOADABLEANDBOOTLOADER EQU 4
CYDEV_PROJ_TYPE_MULTIAPPBOOTLOADER EQU 3
CYDEV_PROJ_TYPE_STANDARD EQU 0
CYDEV_PROTECTION_ENABLE EQU 0
CYDEV_STACK_SIZE EQU 0x0800
CYDEV_USE_BUNDLED_CMSIS EQU 1
CYDEV_VARIABLE_VDDA EQU 0
CYDEV_VDDA_MV EQU 5000
CYDEV_VDDD_MV EQU 5000
CYDEV_VDDIO0_MV EQU 5000
CYDEV_VDDIO1_MV EQU 5000
CYDEV_VDDIO2_MV EQU 5000
CYDEV_VDDIO3_MV EQU 5000
CYDEV_VIO0_MV EQU 5000
CYDEV_VIO1_MV EQU 5000
CYDEV_VIO2_MV EQU 5000
CYDEV_VIO3_MV EQU 5000
CYIPBLOCK_ARM_CM3_VERSION EQU 0
CYIPBLOCK_P3_ANAIF_VERSION EQU 0
CYIPBLOCK_P3_CAPSENSE_VERSION EQU 0
CYIPBLOCK_P3_COMP_VERSION EQU 0
CYIPBLOCK_P3_DFB_VERSION EQU 0
CYIPBLOCK_P3_DMA_VERSION EQU 0
CYIPBLOCK_P3_DRQ_VERSION EQU 0
CYIPBLOCK_P3_EMIF_VERSION EQU 0
CYIPBLOCK_P3_I2C_VERSION EQU 0
CYIPBLOCK_P3_LCD_VERSION EQU 0
CYIPBLOCK_P3_LPF_VERSION EQU 0
CYIPBLOCK_P3_OPAMP_VERSION EQU 0
CYIPBLOCK_P3_PM_VERSION EQU 0
CYIPBLOCK_P3_SCCT_VERSION EQU 0
CYIPBLOCK_P3_TIMER_VERSION EQU 0
CYIPBLOCK_P3_USB_VERSION EQU 0
CYIPBLOCK_P3_VIDAC_VERSION EQU 0
CYIPBLOCK_P3_VREF_VERSION EQU 0
CYIPBLOCK_S8_GPIO_VERSION EQU 0
CYIPBLOCK_S8_IRQ_VERSION EQU 0
CYIPBLOCK_S8_SAR_VERSION EQU 0
CYIPBLOCK_S8_SIO_VERSION EQU 0
CYIPBLOCK_S8_UDB_VERSION EQU 0
Dedicated_Output__INTTYPE EQU CYREG_PICU3_INTTYPE7
Dedicated_Output__MASK EQU 0x80
Dedicated_Output__PC EQU CYREG_PRT3_PC7
Dedicated_Output__PORT EQU 3
Dedicated_Output__SHIFT EQU 7
DMA_CHANNELS_USED__MASK0 EQU 0x00000000
CYDEV_BOOTLOADER_ENABLE EQU 0
    ENDIF
    END

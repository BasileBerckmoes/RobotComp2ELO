;
; File Name: cyfitterrv.inc
; 
; PSoC Creator  4.1 Update 1
;
; Description:
; 
;
;-------------------------------------------------------------------------------
; Copyright (c) 2007-2017 Cypress Semiconductor.  All rights reserved.
; You may use this file only in accordance with the license, terms, conditions, 
; disclaimers, and limitations in the end user license agreement accompanying 
; the software package with which this file was provided.
;-------------------------------------------------------------------------------

    IF :LNOT::DEF:INCLUDED_CYFITTERRV_INC
INCLUDED_CYFITTERRV_INC EQU 1
    GET cydevicerv.inc
    GET cydevicerv_trm.inc

; ADC_IR
ADC_IR_bSAR_SEQ_ChannelCounter__16BIT_CONTROL_AUX_CTL_REG EQU CYREG_B1_UDB06_07_ACTL
ADC_IR_bSAR_SEQ_ChannelCounter__16BIT_CONTROL_CONTROL_REG EQU CYREG_B1_UDB06_07_CTL
ADC_IR_bSAR_SEQ_ChannelCounter__16BIT_CONTROL_COUNT_REG EQU CYREG_B1_UDB06_07_CTL
ADC_IR_bSAR_SEQ_ChannelCounter__16BIT_COUNT_CONTROL_REG EQU CYREG_B1_UDB06_07_CTL
ADC_IR_bSAR_SEQ_ChannelCounter__16BIT_COUNT_COUNT_REG EQU CYREG_B1_UDB06_07_CTL
ADC_IR_bSAR_SEQ_ChannelCounter__16BIT_MASK_MASK_REG EQU CYREG_B1_UDB06_07_MSK
ADC_IR_bSAR_SEQ_ChannelCounter__16BIT_MASK_PERIOD_REG EQU CYREG_B1_UDB06_07_MSK
ADC_IR_bSAR_SEQ_ChannelCounter__16BIT_PERIOD_MASK_REG EQU CYREG_B1_UDB06_07_MSK
ADC_IR_bSAR_SEQ_ChannelCounter__16BIT_PERIOD_PERIOD_REG EQU CYREG_B1_UDB06_07_MSK
ADC_IR_bSAR_SEQ_ChannelCounter__CONTROL_AUX_CTL_REG EQU CYREG_B1_UDB06_ACTL
ADC_IR_bSAR_SEQ_ChannelCounter__CONTROL_REG EQU CYREG_B1_UDB06_CTL
ADC_IR_bSAR_SEQ_ChannelCounter__CONTROL_ST_REG EQU CYREG_B1_UDB06_ST_CTL
ADC_IR_bSAR_SEQ_ChannelCounter__COUNT_REG EQU CYREG_B1_UDB06_CTL
ADC_IR_bSAR_SEQ_ChannelCounter__COUNT_ST_REG EQU CYREG_B1_UDB06_ST_CTL
ADC_IR_bSAR_SEQ_ChannelCounter__MASK_CTL_AUX_CTL_REG EQU CYREG_B1_UDB06_MSK_ACTL
ADC_IR_bSAR_SEQ_ChannelCounter__PER_CTL_AUX_CTL_REG EQU CYREG_B1_UDB06_MSK_ACTL
ADC_IR_bSAR_SEQ_ChannelCounter__PERIOD_REG EQU CYREG_B1_UDB06_MSK
ADC_IR_bSAR_SEQ_ChannelCounter_ST__16BIT_STATUS_AUX_CTL_REG EQU CYREG_B1_UDB06_07_ACTL
ADC_IR_bSAR_SEQ_ChannelCounter_ST__16BIT_STATUS_REG EQU CYREG_B1_UDB06_07_ST
ADC_IR_bSAR_SEQ_ChannelCounter_ST__MASK_REG EQU CYREG_B1_UDB06_MSK
ADC_IR_bSAR_SEQ_ChannelCounter_ST__MASK_ST_AUX_CTL_REG EQU CYREG_B1_UDB06_MSK_ACTL
ADC_IR_bSAR_SEQ_ChannelCounter_ST__PER_ST_AUX_CTL_REG EQU CYREG_B1_UDB06_MSK_ACTL
ADC_IR_bSAR_SEQ_ChannelCounter_ST__STATUS_AUX_CTL_REG EQU CYREG_B1_UDB06_ACTL
ADC_IR_bSAR_SEQ_ChannelCounter_ST__STATUS_CNT_REG EQU CYREG_B1_UDB06_ST_CTL
ADC_IR_bSAR_SEQ_ChannelCounter_ST__STATUS_CONTROL_REG EQU CYREG_B1_UDB06_ST_CTL
ADC_IR_bSAR_SEQ_ChannelCounter_ST__STATUS_REG EQU CYREG_B1_UDB06_ST
ADC_IR_bSAR_SEQ_CtrlReg__0__MASK EQU 0x01
ADC_IR_bSAR_SEQ_CtrlReg__0__POS EQU 0
ADC_IR_bSAR_SEQ_CtrlReg__1__MASK EQU 0x02
ADC_IR_bSAR_SEQ_CtrlReg__1__POS EQU 1
ADC_IR_bSAR_SEQ_CtrlReg__16BIT_CONTROL_AUX_CTL_REG EQU CYREG_B1_UDB05_06_ACTL
ADC_IR_bSAR_SEQ_CtrlReg__16BIT_CONTROL_CONTROL_REG EQU CYREG_B1_UDB05_06_CTL
ADC_IR_bSAR_SEQ_CtrlReg__16BIT_CONTROL_COUNT_REG EQU CYREG_B1_UDB05_06_CTL
ADC_IR_bSAR_SEQ_CtrlReg__16BIT_COUNT_CONTROL_REG EQU CYREG_B1_UDB05_06_CTL
ADC_IR_bSAR_SEQ_CtrlReg__16BIT_COUNT_COUNT_REG EQU CYREG_B1_UDB05_06_CTL
ADC_IR_bSAR_SEQ_CtrlReg__16BIT_MASK_MASK_REG EQU CYREG_B1_UDB05_06_MSK
ADC_IR_bSAR_SEQ_CtrlReg__16BIT_MASK_PERIOD_REG EQU CYREG_B1_UDB05_06_MSK
ADC_IR_bSAR_SEQ_CtrlReg__16BIT_PERIOD_MASK_REG EQU CYREG_B1_UDB05_06_MSK
ADC_IR_bSAR_SEQ_CtrlReg__16BIT_PERIOD_PERIOD_REG EQU CYREG_B1_UDB05_06_MSK
ADC_IR_bSAR_SEQ_CtrlReg__CONTROL_AUX_CTL_REG EQU CYREG_B1_UDB05_ACTL
ADC_IR_bSAR_SEQ_CtrlReg__CONTROL_REG EQU CYREG_B1_UDB05_CTL
ADC_IR_bSAR_SEQ_CtrlReg__CONTROL_ST_REG EQU CYREG_B1_UDB05_ST_CTL
ADC_IR_bSAR_SEQ_CtrlReg__COUNT_REG EQU CYREG_B1_UDB05_CTL
ADC_IR_bSAR_SEQ_CtrlReg__COUNT_ST_REG EQU CYREG_B1_UDB05_ST_CTL
ADC_IR_bSAR_SEQ_CtrlReg__MASK EQU 0x03
ADC_IR_bSAR_SEQ_CtrlReg__MASK_CTL_AUX_CTL_REG EQU CYREG_B1_UDB05_MSK_ACTL
ADC_IR_bSAR_SEQ_CtrlReg__PER_CTL_AUX_CTL_REG EQU CYREG_B1_UDB05_MSK_ACTL
ADC_IR_bSAR_SEQ_CtrlReg__PERIOD_REG EQU CYREG_B1_UDB05_MSK
ADC_IR_bSAR_SEQ_EOCSts__0__MASK EQU 0x01
ADC_IR_bSAR_SEQ_EOCSts__0__POS EQU 0
ADC_IR_bSAR_SEQ_EOCSts__16BIT_STATUS_AUX_CTL_REG EQU CYREG_B0_UDB06_07_ACTL
ADC_IR_bSAR_SEQ_EOCSts__16BIT_STATUS_REG EQU CYREG_B0_UDB06_07_ST
ADC_IR_bSAR_SEQ_EOCSts__MASK EQU 0x01
ADC_IR_bSAR_SEQ_EOCSts__MASK_REG EQU CYREG_B0_UDB06_MSK
ADC_IR_bSAR_SEQ_EOCSts__STATUS_AUX_CTL_REG EQU CYREG_B0_UDB06_ACTL
ADC_IR_bSAR_SEQ_EOCSts__STATUS_REG EQU CYREG_B0_UDB06_ST
ADC_IR_FinalBuf__DRQ_CTL EQU CYREG_IDMUX_DRQ_CTL0
ADC_IR_FinalBuf__DRQ_NUMBER EQU 0
ADC_IR_FinalBuf__NUMBEROF_TDS EQU 0
ADC_IR_FinalBuf__PRIORITY EQU 2
ADC_IR_FinalBuf__TERMIN_EN EQU 0
ADC_IR_FinalBuf__TERMIN_SEL EQU 0
ADC_IR_FinalBuf__TERMOUT0_EN EQU 1
ADC_IR_FinalBuf__TERMOUT0_SEL EQU 0
ADC_IR_FinalBuf__TERMOUT1_EN EQU 0
ADC_IR_FinalBuf__TERMOUT1_SEL EQU 0
ADC_IR_IntClock__CFG0 EQU CYREG_CLKDIST_DCFG1_CFG0
ADC_IR_IntClock__CFG1 EQU CYREG_CLKDIST_DCFG1_CFG1
ADC_IR_IntClock__CFG2 EQU CYREG_CLKDIST_DCFG1_CFG2
ADC_IR_IntClock__CFG2_SRC_SEL_MASK EQU 0x07
ADC_IR_IntClock__INDEX EQU 0x01
ADC_IR_IntClock__PM_ACT_CFG EQU CYREG_PM_ACT_CFG2
ADC_IR_IntClock__PM_ACT_MSK EQU 0x02
ADC_IR_IntClock__PM_STBY_CFG EQU CYREG_PM_STBY_CFG2
ADC_IR_IntClock__PM_STBY_MSK EQU 0x02
ADC_IR_IRQ__INTC_CLR_EN_REG EQU CYREG_NVIC_CLRENA0
ADC_IR_IRQ__INTC_CLR_PD_REG EQU CYREG_NVIC_CLRPEND0
ADC_IR_IRQ__INTC_MASK EQU 0x01
ADC_IR_IRQ__INTC_NUMBER EQU 0
ADC_IR_IRQ__INTC_PRIOR_NUM EQU 7
ADC_IR_IRQ__INTC_PRIOR_REG EQU CYREG_NVIC_PRI_0
ADC_IR_IRQ__INTC_SET_EN_REG EQU CYREG_NVIC_SETENA0
ADC_IR_IRQ__INTC_SET_PD_REG EQU CYREG_NVIC_SETPEND0
ADC_IR_SAR_ADC_SAR__CLK EQU CYREG_SAR0_CLK
ADC_IR_SAR_ADC_SAR__CSR0 EQU CYREG_SAR0_CSR0
ADC_IR_SAR_ADC_SAR__CSR1 EQU CYREG_SAR0_CSR1
ADC_IR_SAR_ADC_SAR__CSR2 EQU CYREG_SAR0_CSR2
ADC_IR_SAR_ADC_SAR__CSR3 EQU CYREG_SAR0_CSR3
ADC_IR_SAR_ADC_SAR__CSR4 EQU CYREG_SAR0_CSR4
ADC_IR_SAR_ADC_SAR__CSR5 EQU CYREG_SAR0_CSR5
ADC_IR_SAR_ADC_SAR__CSR6 EQU CYREG_SAR0_CSR6
ADC_IR_SAR_ADC_SAR__PM_ACT_CFG EQU CYREG_PM_ACT_CFG11
ADC_IR_SAR_ADC_SAR__PM_ACT_MSK EQU 0x01
ADC_IR_SAR_ADC_SAR__PM_STBY_CFG EQU CYREG_PM_STBY_CFG11
ADC_IR_SAR_ADC_SAR__PM_STBY_MSK EQU 0x01
ADC_IR_SAR_ADC_SAR__SW0 EQU CYREG_SAR0_SW0
ADC_IR_SAR_ADC_SAR__SW2 EQU CYREG_SAR0_SW2
ADC_IR_SAR_ADC_SAR__SW3 EQU CYREG_SAR0_SW3
ADC_IR_SAR_ADC_SAR__SW4 EQU CYREG_SAR0_SW4
ADC_IR_SAR_ADC_SAR__SW6 EQU CYREG_SAR0_SW6
ADC_IR_SAR_ADC_SAR__TR0 EQU CYREG_SAR0_TR0
ADC_IR_SAR_ADC_SAR__WRK0 EQU CYREG_SAR0_WRK0
ADC_IR_SAR_ADC_SAR__WRK1 EQU CYREG_SAR0_WRK1
ADC_IR_TempBuf__DRQ_CTL EQU CYREG_IDMUX_DRQ_CTL0
ADC_IR_TempBuf__DRQ_NUMBER EQU 1
ADC_IR_TempBuf__NUMBEROF_TDS EQU 0
ADC_IR_TempBuf__PRIORITY EQU 2
ADC_IR_TempBuf__TERMIN_EN EQU 0
ADC_IR_TempBuf__TERMIN_SEL EQU 0
ADC_IR_TempBuf__TERMOUT0_EN EQU 1
ADC_IR_TempBuf__TERMOUT0_SEL EQU 1
ADC_IR_TempBuf__TERMOUT1_EN EQU 0
ADC_IR_TempBuf__TERMOUT1_SEL EQU 0

; Clock_1
Clock_1__CFG0 EQU CYREG_CLKDIST_DCFG0_CFG0
Clock_1__CFG1 EQU CYREG_CLKDIST_DCFG0_CFG1
Clock_1__CFG2 EQU CYREG_CLKDIST_DCFG0_CFG2
Clock_1__CFG2_SRC_SEL_MASK EQU 0x07
Clock_1__INDEX EQU 0x00
Clock_1__PM_ACT_CFG EQU CYREG_PM_ACT_CFG2
Clock_1__PM_ACT_MSK EQU 0x01
Clock_1__PM_STBY_CFG EQU CYREG_PM_STBY_CFG2
Clock_1__PM_STBY_MSK EQU 0x01

; IR1
IR1__0__INTTYPE EQU CYREG_PICU0_INTTYPE0
IR1__0__MASK EQU 0x01
IR1__0__PC EQU CYREG_PRT0_PC0
IR1__0__PORT EQU 0
IR1__0__SHIFT EQU 0
IR1__AG EQU CYREG_PRT0_AG
IR1__AMUX EQU CYREG_PRT0_AMUX
IR1__BIE EQU CYREG_PRT0_BIE
IR1__BIT_MASK EQU CYREG_PRT0_BIT_MASK
IR1__BYP EQU CYREG_PRT0_BYP
IR1__CTL EQU CYREG_PRT0_CTL
IR1__DM0 EQU CYREG_PRT0_DM0
IR1__DM1 EQU CYREG_PRT0_DM1
IR1__DM2 EQU CYREG_PRT0_DM2
IR1__DR EQU CYREG_PRT0_DR
IR1__INP_DIS EQU CYREG_PRT0_INP_DIS
IR1__INTTYPE_BASE EQU CYDEV_PICU_INTTYPE_PICU0_BASE
IR1__LCD_COM_SEG EQU CYREG_PRT0_LCD_COM_SEG
IR1__LCD_EN EQU CYREG_PRT0_LCD_EN
IR1__MASK EQU 0x01
IR1__PORT EQU 0
IR1__PRT EQU CYREG_PRT0_PRT
IR1__PRTDSI__CAPS_SEL EQU CYREG_PRT0_CAPS_SEL
IR1__PRTDSI__DBL_SYNC_IN EQU CYREG_PRT0_DBL_SYNC_IN
IR1__PRTDSI__OE_SEL0 EQU CYREG_PRT0_OE_SEL0
IR1__PRTDSI__OE_SEL1 EQU CYREG_PRT0_OE_SEL1
IR1__PRTDSI__OUT_SEL0 EQU CYREG_PRT0_OUT_SEL0
IR1__PRTDSI__OUT_SEL1 EQU CYREG_PRT0_OUT_SEL1
IR1__PRTDSI__SYNC_OUT EQU CYREG_PRT0_SYNC_OUT
IR1__PS EQU CYREG_PRT0_PS
IR1__SHIFT EQU 0
IR1__SLW EQU CYREG_PRT0_SLW

; IR2
IR2__0__INTTYPE EQU CYREG_PICU0_INTTYPE1
IR2__0__MASK EQU 0x02
IR2__0__PC EQU CYREG_PRT0_PC1
IR2__0__PORT EQU 0
IR2__0__SHIFT EQU 1
IR2__AG EQU CYREG_PRT0_AG
IR2__AMUX EQU CYREG_PRT0_AMUX
IR2__BIE EQU CYREG_PRT0_BIE
IR2__BIT_MASK EQU CYREG_PRT0_BIT_MASK
IR2__BYP EQU CYREG_PRT0_BYP
IR2__CTL EQU CYREG_PRT0_CTL
IR2__DM0 EQU CYREG_PRT0_DM0
IR2__DM1 EQU CYREG_PRT0_DM1
IR2__DM2 EQU CYREG_PRT0_DM2
IR2__DR EQU CYREG_PRT0_DR
IR2__INP_DIS EQU CYREG_PRT0_INP_DIS
IR2__INTTYPE_BASE EQU CYDEV_PICU_INTTYPE_PICU0_BASE
IR2__LCD_COM_SEG EQU CYREG_PRT0_LCD_COM_SEG
IR2__LCD_EN EQU CYREG_PRT0_LCD_EN
IR2__MASK EQU 0x02
IR2__PORT EQU 0
IR2__PRT EQU CYREG_PRT0_PRT
IR2__PRTDSI__CAPS_SEL EQU CYREG_PRT0_CAPS_SEL
IR2__PRTDSI__DBL_SYNC_IN EQU CYREG_PRT0_DBL_SYNC_IN
IR2__PRTDSI__OE_SEL0 EQU CYREG_PRT0_OE_SEL0
IR2__PRTDSI__OE_SEL1 EQU CYREG_PRT0_OE_SEL1
IR2__PRTDSI__OUT_SEL0 EQU CYREG_PRT0_OUT_SEL0
IR2__PRTDSI__OUT_SEL1 EQU CYREG_PRT0_OUT_SEL1
IR2__PRTDSI__SYNC_OUT EQU CYREG_PRT0_SYNC_OUT
IR2__PS EQU CYREG_PRT0_PS
IR2__SHIFT EQU 1
IR2__SLW EQU CYREG_PRT0_SLW

; IR3
IR3__0__INTTYPE EQU CYREG_PICU0_INTTYPE2
IR3__0__MASK EQU 0x04
IR3__0__PC EQU CYREG_PRT0_PC2
IR3__0__PORT EQU 0
IR3__0__SHIFT EQU 2
IR3__AG EQU CYREG_PRT0_AG
IR3__AMUX EQU CYREG_PRT0_AMUX
IR3__BIE EQU CYREG_PRT0_BIE
IR3__BIT_MASK EQU CYREG_PRT0_BIT_MASK
IR3__BYP EQU CYREG_PRT0_BYP
IR3__CTL EQU CYREG_PRT0_CTL
IR3__DM0 EQU CYREG_PRT0_DM0
IR3__DM1 EQU CYREG_PRT0_DM1
IR3__DM2 EQU CYREG_PRT0_DM2
IR3__DR EQU CYREG_PRT0_DR
IR3__INP_DIS EQU CYREG_PRT0_INP_DIS
IR3__INTTYPE_BASE EQU CYDEV_PICU_INTTYPE_PICU0_BASE
IR3__LCD_COM_SEG EQU CYREG_PRT0_LCD_COM_SEG
IR3__LCD_EN EQU CYREG_PRT0_LCD_EN
IR3__MASK EQU 0x04
IR3__PORT EQU 0
IR3__PRT EQU CYREG_PRT0_PRT
IR3__PRTDSI__CAPS_SEL EQU CYREG_PRT0_CAPS_SEL
IR3__PRTDSI__DBL_SYNC_IN EQU CYREG_PRT0_DBL_SYNC_IN
IR3__PRTDSI__OE_SEL0 EQU CYREG_PRT0_OE_SEL0
IR3__PRTDSI__OE_SEL1 EQU CYREG_PRT0_OE_SEL1
IR3__PRTDSI__OUT_SEL0 EQU CYREG_PRT0_OUT_SEL0
IR3__PRTDSI__OUT_SEL1 EQU CYREG_PRT0_OUT_SEL1
IR3__PRTDSI__SYNC_OUT EQU CYREG_PRT0_SYNC_OUT
IR3__PS EQU CYREG_PRT0_PS
IR3__SHIFT EQU 2
IR3__SLW EQU CYREG_PRT0_SLW

; IR4
IR4__0__INTTYPE EQU CYREG_PICU0_INTTYPE3
IR4__0__MASK EQU 0x08
IR4__0__PC EQU CYREG_PRT0_PC3
IR4__0__PORT EQU 0
IR4__0__SHIFT EQU 3
IR4__AG EQU CYREG_PRT0_AG
IR4__AMUX EQU CYREG_PRT0_AMUX
IR4__BIE EQU CYREG_PRT0_BIE
IR4__BIT_MASK EQU CYREG_PRT0_BIT_MASK
IR4__BYP EQU CYREG_PRT0_BYP
IR4__CTL EQU CYREG_PRT0_CTL
IR4__DM0 EQU CYREG_PRT0_DM0
IR4__DM1 EQU CYREG_PRT0_DM1
IR4__DM2 EQU CYREG_PRT0_DM2
IR4__DR EQU CYREG_PRT0_DR
IR4__INP_DIS EQU CYREG_PRT0_INP_DIS
IR4__INTTYPE_BASE EQU CYDEV_PICU_INTTYPE_PICU0_BASE
IR4__LCD_COM_SEG EQU CYREG_PRT0_LCD_COM_SEG
IR4__LCD_EN EQU CYREG_PRT0_LCD_EN
IR4__MASK EQU 0x08
IR4__PORT EQU 0
IR4__PRT EQU CYREG_PRT0_PRT
IR4__PRTDSI__CAPS_SEL EQU CYREG_PRT0_CAPS_SEL
IR4__PRTDSI__DBL_SYNC_IN EQU CYREG_PRT0_DBL_SYNC_IN
IR4__PRTDSI__OE_SEL0 EQU CYREG_PRT0_OE_SEL0
IR4__PRTDSI__OE_SEL1 EQU CYREG_PRT0_OE_SEL1
IR4__PRTDSI__OUT_SEL0 EQU CYREG_PRT0_OUT_SEL0
IR4__PRTDSI__OUT_SEL1 EQU CYREG_PRT0_OUT_SEL1
IR4__PRTDSI__SYNC_OUT EQU CYREG_PRT0_SYNC_OUT
IR4__PS EQU CYREG_PRT0_PS
IR4__SHIFT EQU 3
IR4__SLW EQU CYREG_PRT0_SLW

; IR5
IR5__0__INTTYPE EQU CYREG_PICU0_INTTYPE4
IR5__0__MASK EQU 0x10
IR5__0__PC EQU CYREG_PRT0_PC4
IR5__0__PORT EQU 0
IR5__0__SHIFT EQU 4
IR5__AG EQU CYREG_PRT0_AG
IR5__AMUX EQU CYREG_PRT0_AMUX
IR5__BIE EQU CYREG_PRT0_BIE
IR5__BIT_MASK EQU CYREG_PRT0_BIT_MASK
IR5__BYP EQU CYREG_PRT0_BYP
IR5__CTL EQU CYREG_PRT0_CTL
IR5__DM0 EQU CYREG_PRT0_DM0
IR5__DM1 EQU CYREG_PRT0_DM1
IR5__DM2 EQU CYREG_PRT0_DM2
IR5__DR EQU CYREG_PRT0_DR
IR5__INP_DIS EQU CYREG_PRT0_INP_DIS
IR5__INTTYPE_BASE EQU CYDEV_PICU_INTTYPE_PICU0_BASE
IR5__LCD_COM_SEG EQU CYREG_PRT0_LCD_COM_SEG
IR5__LCD_EN EQU CYREG_PRT0_LCD_EN
IR5__MASK EQU 0x10
IR5__PORT EQU 0
IR5__PRT EQU CYREG_PRT0_PRT
IR5__PRTDSI__CAPS_SEL EQU CYREG_PRT0_CAPS_SEL
IR5__PRTDSI__DBL_SYNC_IN EQU CYREG_PRT0_DBL_SYNC_IN
IR5__PRTDSI__OE_SEL0 EQU CYREG_PRT0_OE_SEL0
IR5__PRTDSI__OE_SEL1 EQU CYREG_PRT0_OE_SEL1
IR5__PRTDSI__OUT_SEL0 EQU CYREG_PRT0_OUT_SEL0
IR5__PRTDSI__OUT_SEL1 EQU CYREG_PRT0_OUT_SEL1
IR5__PRTDSI__SYNC_OUT EQU CYREG_PRT0_SYNC_OUT
IR5__PS EQU CYREG_PRT0_PS
IR5__SHIFT EQU 4
IR5__SLW EQU CYREG_PRT0_SLW

; IR6
IR6__0__INTTYPE EQU CYREG_PICU0_INTTYPE5
IR6__0__MASK EQU 0x20
IR6__0__PC EQU CYREG_PRT0_PC5
IR6__0__PORT EQU 0
IR6__0__SHIFT EQU 5
IR6__AG EQU CYREG_PRT0_AG
IR6__AMUX EQU CYREG_PRT0_AMUX
IR6__BIE EQU CYREG_PRT0_BIE
IR6__BIT_MASK EQU CYREG_PRT0_BIT_MASK
IR6__BYP EQU CYREG_PRT0_BYP
IR6__CTL EQU CYREG_PRT0_CTL
IR6__DM0 EQU CYREG_PRT0_DM0
IR6__DM1 EQU CYREG_PRT0_DM1
IR6__DM2 EQU CYREG_PRT0_DM2
IR6__DR EQU CYREG_PRT0_DR
IR6__INP_DIS EQU CYREG_PRT0_INP_DIS
IR6__INTTYPE_BASE EQU CYDEV_PICU_INTTYPE_PICU0_BASE
IR6__LCD_COM_SEG EQU CYREG_PRT0_LCD_COM_SEG
IR6__LCD_EN EQU CYREG_PRT0_LCD_EN
IR6__MASK EQU 0x20
IR6__PORT EQU 0
IR6__PRT EQU CYREG_PRT0_PRT
IR6__PRTDSI__CAPS_SEL EQU CYREG_PRT0_CAPS_SEL
IR6__PRTDSI__DBL_SYNC_IN EQU CYREG_PRT0_DBL_SYNC_IN
IR6__PRTDSI__OE_SEL0 EQU CYREG_PRT0_OE_SEL0
IR6__PRTDSI__OE_SEL1 EQU CYREG_PRT0_OE_SEL1
IR6__PRTDSI__OUT_SEL0 EQU CYREG_PRT0_OUT_SEL0
IR6__PRTDSI__OUT_SEL1 EQU CYREG_PRT0_OUT_SEL1
IR6__PRTDSI__SYNC_OUT EQU CYREG_PRT0_SYNC_OUT
IR6__PS EQU CYREG_PRT0_PS
IR6__SHIFT EQU 5
IR6__SLW EQU CYREG_PRT0_SLW

; IR7
IR7__0__INTTYPE EQU CYREG_PICU0_INTTYPE6
IR7__0__MASK EQU 0x40
IR7__0__PC EQU CYREG_PRT0_PC6
IR7__0__PORT EQU 0
IR7__0__SHIFT EQU 6
IR7__AG EQU CYREG_PRT0_AG
IR7__AMUX EQU CYREG_PRT0_AMUX
IR7__BIE EQU CYREG_PRT0_BIE
IR7__BIT_MASK EQU CYREG_PRT0_BIT_MASK
IR7__BYP EQU CYREG_PRT0_BYP
IR7__CTL EQU CYREG_PRT0_CTL
IR7__DM0 EQU CYREG_PRT0_DM0
IR7__DM1 EQU CYREG_PRT0_DM1
IR7__DM2 EQU CYREG_PRT0_DM2
IR7__DR EQU CYREG_PRT0_DR
IR7__INP_DIS EQU CYREG_PRT0_INP_DIS
IR7__INTTYPE_BASE EQU CYDEV_PICU_INTTYPE_PICU0_BASE
IR7__LCD_COM_SEG EQU CYREG_PRT0_LCD_COM_SEG
IR7__LCD_EN EQU CYREG_PRT0_LCD_EN
IR7__MASK EQU 0x40
IR7__PORT EQU 0
IR7__PRT EQU CYREG_PRT0_PRT
IR7__PRTDSI__CAPS_SEL EQU CYREG_PRT0_CAPS_SEL
IR7__PRTDSI__DBL_SYNC_IN EQU CYREG_PRT0_DBL_SYNC_IN
IR7__PRTDSI__OE_SEL0 EQU CYREG_PRT0_OE_SEL0
IR7__PRTDSI__OE_SEL1 EQU CYREG_PRT0_OE_SEL1
IR7__PRTDSI__OUT_SEL0 EQU CYREG_PRT0_OUT_SEL0
IR7__PRTDSI__OUT_SEL1 EQU CYREG_PRT0_OUT_SEL1
IR7__PRTDSI__SYNC_OUT EQU CYREG_PRT0_SYNC_OUT
IR7__PS EQU CYREG_PRT0_PS
IR7__SHIFT EQU 6
IR7__SLW EQU CYREG_PRT0_SLW

; IR8
IR8__0__INTTYPE EQU CYREG_PICU0_INTTYPE7
IR8__0__MASK EQU 0x80
IR8__0__PC EQU CYREG_PRT0_PC7
IR8__0__PORT EQU 0
IR8__0__SHIFT EQU 7
IR8__AG EQU CYREG_PRT0_AG
IR8__AMUX EQU CYREG_PRT0_AMUX
IR8__BIE EQU CYREG_PRT0_BIE
IR8__BIT_MASK EQU CYREG_PRT0_BIT_MASK
IR8__BYP EQU CYREG_PRT0_BYP
IR8__CTL EQU CYREG_PRT0_CTL
IR8__DM0 EQU CYREG_PRT0_DM0
IR8__DM1 EQU CYREG_PRT0_DM1
IR8__DM2 EQU CYREG_PRT0_DM2
IR8__DR EQU CYREG_PRT0_DR
IR8__INP_DIS EQU CYREG_PRT0_INP_DIS
IR8__INTTYPE_BASE EQU CYDEV_PICU_INTTYPE_PICU0_BASE
IR8__LCD_COM_SEG EQU CYREG_PRT0_LCD_COM_SEG
IR8__LCD_EN EQU CYREG_PRT0_LCD_EN
IR8__MASK EQU 0x80
IR8__PORT EQU 0
IR8__PRT EQU CYREG_PRT0_PRT
IR8__PRTDSI__CAPS_SEL EQU CYREG_PRT0_CAPS_SEL
IR8__PRTDSI__DBL_SYNC_IN EQU CYREG_PRT0_DBL_SYNC_IN
IR8__PRTDSI__OE_SEL0 EQU CYREG_PRT0_OE_SEL0
IR8__PRTDSI__OE_SEL1 EQU CYREG_PRT0_OE_SEL1
IR8__PRTDSI__OUT_SEL0 EQU CYREG_PRT0_OUT_SEL0
IR8__PRTDSI__OUT_SEL1 EQU CYREG_PRT0_OUT_SEL1
IR8__PRTDSI__SYNC_OUT EQU CYREG_PRT0_SYNC_OUT
IR8__PS EQU CYREG_PRT0_PS
IR8__SHIFT EQU 7
IR8__SLW EQU CYREG_PRT0_SLW

; LCD_LCDPort
LCD_LCDPort__0__INTTYPE EQU CYREG_PICU2_INTTYPE0
LCD_LCDPort__0__MASK EQU 0x01
LCD_LCDPort__0__PC EQU CYREG_PRT2_PC0
LCD_LCDPort__0__PORT EQU 2
LCD_LCDPort__0__SHIFT EQU 0
LCD_LCDPort__1__INTTYPE EQU CYREG_PICU2_INTTYPE1
LCD_LCDPort__1__MASK EQU 0x02
LCD_LCDPort__1__PC EQU CYREG_PRT2_PC1
LCD_LCDPort__1__PORT EQU 2
LCD_LCDPort__1__SHIFT EQU 1
LCD_LCDPort__2__INTTYPE EQU CYREG_PICU2_INTTYPE2
LCD_LCDPort__2__MASK EQU 0x04
LCD_LCDPort__2__PC EQU CYREG_PRT2_PC2
LCD_LCDPort__2__PORT EQU 2
LCD_LCDPort__2__SHIFT EQU 2
LCD_LCDPort__3__INTTYPE EQU CYREG_PICU2_INTTYPE3
LCD_LCDPort__3__MASK EQU 0x08
LCD_LCDPort__3__PC EQU CYREG_PRT2_PC3
LCD_LCDPort__3__PORT EQU 2
LCD_LCDPort__3__SHIFT EQU 3
LCD_LCDPort__4__INTTYPE EQU CYREG_PICU2_INTTYPE4
LCD_LCDPort__4__MASK EQU 0x10
LCD_LCDPort__4__PC EQU CYREG_PRT2_PC4
LCD_LCDPort__4__PORT EQU 2
LCD_LCDPort__4__SHIFT EQU 4
LCD_LCDPort__5__INTTYPE EQU CYREG_PICU2_INTTYPE5
LCD_LCDPort__5__MASK EQU 0x20
LCD_LCDPort__5__PC EQU CYREG_PRT2_PC5
LCD_LCDPort__5__PORT EQU 2
LCD_LCDPort__5__SHIFT EQU 5
LCD_LCDPort__6__INTTYPE EQU CYREG_PICU2_INTTYPE6
LCD_LCDPort__6__MASK EQU 0x40
LCD_LCDPort__6__PC EQU CYREG_PRT2_PC6
LCD_LCDPort__6__PORT EQU 2
LCD_LCDPort__6__SHIFT EQU 6
LCD_LCDPort__AG EQU CYREG_PRT2_AG
LCD_LCDPort__AMUX EQU CYREG_PRT2_AMUX
LCD_LCDPort__BIE EQU CYREG_PRT2_BIE
LCD_LCDPort__BIT_MASK EQU CYREG_PRT2_BIT_MASK
LCD_LCDPort__BYP EQU CYREG_PRT2_BYP
LCD_LCDPort__CTL EQU CYREG_PRT2_CTL
LCD_LCDPort__DM0 EQU CYREG_PRT2_DM0
LCD_LCDPort__DM1 EQU CYREG_PRT2_DM1
LCD_LCDPort__DM2 EQU CYREG_PRT2_DM2
LCD_LCDPort__DR EQU CYREG_PRT2_DR
LCD_LCDPort__INP_DIS EQU CYREG_PRT2_INP_DIS
LCD_LCDPort__INTTYPE_BASE EQU CYDEV_PICU_INTTYPE_PICU2_BASE
LCD_LCDPort__LCD_COM_SEG EQU CYREG_PRT2_LCD_COM_SEG
LCD_LCDPort__LCD_EN EQU CYREG_PRT2_LCD_EN
LCD_LCDPort__MASK EQU 0x7F
LCD_LCDPort__PORT EQU 2
LCD_LCDPort__PRT EQU CYREG_PRT2_PRT
LCD_LCDPort__PRTDSI__CAPS_SEL EQU CYREG_PRT2_CAPS_SEL
LCD_LCDPort__PRTDSI__DBL_SYNC_IN EQU CYREG_PRT2_DBL_SYNC_IN
LCD_LCDPort__PRTDSI__OE_SEL0 EQU CYREG_PRT2_OE_SEL0
LCD_LCDPort__PRTDSI__OE_SEL1 EQU CYREG_PRT2_OE_SEL1
LCD_LCDPort__PRTDSI__OUT_SEL0 EQU CYREG_PRT2_OUT_SEL0
LCD_LCDPort__PRTDSI__OUT_SEL1 EQU CYREG_PRT2_OUT_SEL1
LCD_LCDPort__PRTDSI__SYNC_OUT EQU CYREG_PRT2_SYNC_OUT
LCD_LCDPort__PS EQU CYREG_PRT2_PS
LCD_LCDPort__SHIFT EQU 0
LCD_LCDPort__SLW EQU CYREG_PRT2_SLW

; LED1
LED1__0__INTTYPE EQU CYREG_PICU3_INTTYPE0
LED1__0__MASK EQU 0x01
LED1__0__PC EQU CYREG_PRT3_PC0
LED1__0__PORT EQU 3
LED1__0__SHIFT EQU 0
LED1__AG EQU CYREG_PRT3_AG
LED1__AMUX EQU CYREG_PRT3_AMUX
LED1__BIE EQU CYREG_PRT3_BIE
LED1__BIT_MASK EQU CYREG_PRT3_BIT_MASK
LED1__BYP EQU CYREG_PRT3_BYP
LED1__CTL EQU CYREG_PRT3_CTL
LED1__DM0 EQU CYREG_PRT3_DM0
LED1__DM1 EQU CYREG_PRT3_DM1
LED1__DM2 EQU CYREG_PRT3_DM2
LED1__DR EQU CYREG_PRT3_DR
LED1__INP_DIS EQU CYREG_PRT3_INP_DIS
LED1__INTTYPE_BASE EQU CYDEV_PICU_INTTYPE_PICU3_BASE
LED1__LCD_COM_SEG EQU CYREG_PRT3_LCD_COM_SEG
LED1__LCD_EN EQU CYREG_PRT3_LCD_EN
LED1__MASK EQU 0x01
LED1__PORT EQU 3
LED1__PRT EQU CYREG_PRT3_PRT
LED1__PRTDSI__CAPS_SEL EQU CYREG_PRT3_CAPS_SEL
LED1__PRTDSI__DBL_SYNC_IN EQU CYREG_PRT3_DBL_SYNC_IN
LED1__PRTDSI__OE_SEL0 EQU CYREG_PRT3_OE_SEL0
LED1__PRTDSI__OE_SEL1 EQU CYREG_PRT3_OE_SEL1
LED1__PRTDSI__OUT_SEL0 EQU CYREG_PRT3_OUT_SEL0
LED1__PRTDSI__OUT_SEL1 EQU CYREG_PRT3_OUT_SEL1
LED1__PRTDSI__SYNC_OUT EQU CYREG_PRT3_SYNC_OUT
LED1__PS EQU CYREG_PRT3_PS
LED1__SHIFT EQU 0
LED1__SLW EQU CYREG_PRT3_SLW

; LED2
LED2__0__INTTYPE EQU CYREG_PICU3_INTTYPE1
LED2__0__MASK EQU 0x02
LED2__0__PC EQU CYREG_PRT3_PC1
LED2__0__PORT EQU 3
LED2__0__SHIFT EQU 1
LED2__AG EQU CYREG_PRT3_AG
LED2__AMUX EQU CYREG_PRT3_AMUX
LED2__BIE EQU CYREG_PRT3_BIE
LED2__BIT_MASK EQU CYREG_PRT3_BIT_MASK
LED2__BYP EQU CYREG_PRT3_BYP
LED2__CTL EQU CYREG_PRT3_CTL
LED2__DM0 EQU CYREG_PRT3_DM0
LED2__DM1 EQU CYREG_PRT3_DM1
LED2__DM2 EQU CYREG_PRT3_DM2
LED2__DR EQU CYREG_PRT3_DR
LED2__INP_DIS EQU CYREG_PRT3_INP_DIS
LED2__INTTYPE_BASE EQU CYDEV_PICU_INTTYPE_PICU3_BASE
LED2__LCD_COM_SEG EQU CYREG_PRT3_LCD_COM_SEG
LED2__LCD_EN EQU CYREG_PRT3_LCD_EN
LED2__MASK EQU 0x02
LED2__PORT EQU 3
LED2__PRT EQU CYREG_PRT3_PRT
LED2__PRTDSI__CAPS_SEL EQU CYREG_PRT3_CAPS_SEL
LED2__PRTDSI__DBL_SYNC_IN EQU CYREG_PRT3_DBL_SYNC_IN
LED2__PRTDSI__OE_SEL0 EQU CYREG_PRT3_OE_SEL0
LED2__PRTDSI__OE_SEL1 EQU CYREG_PRT3_OE_SEL1
LED2__PRTDSI__OUT_SEL0 EQU CYREG_PRT3_OUT_SEL0
LED2__PRTDSI__OUT_SEL1 EQU CYREG_PRT3_OUT_SEL1
LED2__PRTDSI__SYNC_OUT EQU CYREG_PRT3_SYNC_OUT
LED2__PS EQU CYREG_PRT3_PS
LED2__SHIFT EQU 1
LED2__SLW EQU CYREG_PRT3_SLW

; LED3
LED3__0__INTTYPE EQU CYREG_PICU3_INTTYPE2
LED3__0__MASK EQU 0x04
LED3__0__PC EQU CYREG_PRT3_PC2
LED3__0__PORT EQU 3
LED3__0__SHIFT EQU 2
LED3__AG EQU CYREG_PRT3_AG
LED3__AMUX EQU CYREG_PRT3_AMUX
LED3__BIE EQU CYREG_PRT3_BIE
LED3__BIT_MASK EQU CYREG_PRT3_BIT_MASK
LED3__BYP EQU CYREG_PRT3_BYP
LED3__CTL EQU CYREG_PRT3_CTL
LED3__DM0 EQU CYREG_PRT3_DM0
LED3__DM1 EQU CYREG_PRT3_DM1
LED3__DM2 EQU CYREG_PRT3_DM2
LED3__DR EQU CYREG_PRT3_DR
LED3__INP_DIS EQU CYREG_PRT3_INP_DIS
LED3__INTTYPE_BASE EQU CYDEV_PICU_INTTYPE_PICU3_BASE
LED3__LCD_COM_SEG EQU CYREG_PRT3_LCD_COM_SEG
LED3__LCD_EN EQU CYREG_PRT3_LCD_EN
LED3__MASK EQU 0x04
LED3__PORT EQU 3
LED3__PRT EQU CYREG_PRT3_PRT
LED3__PRTDSI__CAPS_SEL EQU CYREG_PRT3_CAPS_SEL
LED3__PRTDSI__DBL_SYNC_IN EQU CYREG_PRT3_DBL_SYNC_IN
LED3__PRTDSI__OE_SEL0 EQU CYREG_PRT3_OE_SEL0
LED3__PRTDSI__OE_SEL1 EQU CYREG_PRT3_OE_SEL1
LED3__PRTDSI__OUT_SEL0 EQU CYREG_PRT3_OUT_SEL0
LED3__PRTDSI__OUT_SEL1 EQU CYREG_PRT3_OUT_SEL1
LED3__PRTDSI__SYNC_OUT EQU CYREG_PRT3_SYNC_OUT
LED3__PS EQU CYREG_PRT3_PS
LED3__SHIFT EQU 2
LED3__SLW EQU CYREG_PRT3_SLW

; LED4
LED4__0__INTTYPE EQU CYREG_PICU3_INTTYPE3
LED4__0__MASK EQU 0x08
LED4__0__PC EQU CYREG_PRT3_PC3
LED4__0__PORT EQU 3
LED4__0__SHIFT EQU 3
LED4__AG EQU CYREG_PRT3_AG
LED4__AMUX EQU CYREG_PRT3_AMUX
LED4__BIE EQU CYREG_PRT3_BIE
LED4__BIT_MASK EQU CYREG_PRT3_BIT_MASK
LED4__BYP EQU CYREG_PRT3_BYP
LED4__CTL EQU CYREG_PRT3_CTL
LED4__DM0 EQU CYREG_PRT3_DM0
LED4__DM1 EQU CYREG_PRT3_DM1
LED4__DM2 EQU CYREG_PRT3_DM2
LED4__DR EQU CYREG_PRT3_DR
LED4__INP_DIS EQU CYREG_PRT3_INP_DIS
LED4__INTTYPE_BASE EQU CYDEV_PICU_INTTYPE_PICU3_BASE
LED4__LCD_COM_SEG EQU CYREG_PRT3_LCD_COM_SEG
LED4__LCD_EN EQU CYREG_PRT3_LCD_EN
LED4__MASK EQU 0x08
LED4__PORT EQU 3
LED4__PRT EQU CYREG_PRT3_PRT
LED4__PRTDSI__CAPS_SEL EQU CYREG_PRT3_CAPS_SEL
LED4__PRTDSI__DBL_SYNC_IN EQU CYREG_PRT3_DBL_SYNC_IN
LED4__PRTDSI__OE_SEL0 EQU CYREG_PRT3_OE_SEL0
LED4__PRTDSI__OE_SEL1 EQU CYREG_PRT3_OE_SEL1
LED4__PRTDSI__OUT_SEL0 EQU CYREG_PRT3_OUT_SEL0
LED4__PRTDSI__OUT_SEL1 EQU CYREG_PRT3_OUT_SEL1
LED4__PRTDSI__SYNC_OUT EQU CYREG_PRT3_SYNC_OUT
LED4__PS EQU CYREG_PRT3_PS
LED4__SHIFT EQU 3
LED4__SLW EQU CYREG_PRT3_SLW

; LED5
LED5__0__INTTYPE EQU CYREG_PICU3_INTTYPE4
LED5__0__MASK EQU 0x10
LED5__0__PC EQU CYREG_PRT3_PC4
LED5__0__PORT EQU 3
LED5__0__SHIFT EQU 4
LED5__AG EQU CYREG_PRT3_AG
LED5__AMUX EQU CYREG_PRT3_AMUX
LED5__BIE EQU CYREG_PRT3_BIE
LED5__BIT_MASK EQU CYREG_PRT3_BIT_MASK
LED5__BYP EQU CYREG_PRT3_BYP
LED5__CTL EQU CYREG_PRT3_CTL
LED5__DM0 EQU CYREG_PRT3_DM0
LED5__DM1 EQU CYREG_PRT3_DM1
LED5__DM2 EQU CYREG_PRT3_DM2
LED5__DR EQU CYREG_PRT3_DR
LED5__INP_DIS EQU CYREG_PRT3_INP_DIS
LED5__INTTYPE_BASE EQU CYDEV_PICU_INTTYPE_PICU3_BASE
LED5__LCD_COM_SEG EQU CYREG_PRT3_LCD_COM_SEG
LED5__LCD_EN EQU CYREG_PRT3_LCD_EN
LED5__MASK EQU 0x10
LED5__PORT EQU 3
LED5__PRT EQU CYREG_PRT3_PRT
LED5__PRTDSI__CAPS_SEL EQU CYREG_PRT3_CAPS_SEL
LED5__PRTDSI__DBL_SYNC_IN EQU CYREG_PRT3_DBL_SYNC_IN
LED5__PRTDSI__OE_SEL0 EQU CYREG_PRT3_OE_SEL0
LED5__PRTDSI__OE_SEL1 EQU CYREG_PRT3_OE_SEL1
LED5__PRTDSI__OUT_SEL0 EQU CYREG_PRT3_OUT_SEL0
LED5__PRTDSI__OUT_SEL1 EQU CYREG_PRT3_OUT_SEL1
LED5__PRTDSI__SYNC_OUT EQU CYREG_PRT3_SYNC_OUT
LED5__PS EQU CYREG_PRT3_PS
LED5__SHIFT EQU 4
LED5__SLW EQU CYREG_PRT3_SLW

; LedOn
LedOn__0__INTTYPE EQU CYREG_PICU3_INTTYPE7
LedOn__0__MASK EQU 0x80
LedOn__0__PC EQU CYREG_PRT3_PC7
LedOn__0__PORT EQU 3
LedOn__0__SHIFT EQU 7
LedOn__AG EQU CYREG_PRT3_AG
LedOn__AMUX EQU CYREG_PRT3_AMUX
LedOn__BIE EQU CYREG_PRT3_BIE
LedOn__BIT_MASK EQU CYREG_PRT3_BIT_MASK
LedOn__BYP EQU CYREG_PRT3_BYP
LedOn__CTL EQU CYREG_PRT3_CTL
LedOn__DM0 EQU CYREG_PRT3_DM0
LedOn__DM1 EQU CYREG_PRT3_DM1
LedOn__DM2 EQU CYREG_PRT3_DM2
LedOn__DR EQU CYREG_PRT3_DR
LedOn__INP_DIS EQU CYREG_PRT3_INP_DIS
LedOn__INTTYPE_BASE EQU CYDEV_PICU_INTTYPE_PICU3_BASE
LedOn__LCD_COM_SEG EQU CYREG_PRT3_LCD_COM_SEG
LedOn__LCD_EN EQU CYREG_PRT3_LCD_EN
LedOn__MASK EQU 0x80
LedOn__PORT EQU 3
LedOn__PRT EQU CYREG_PRT3_PRT
LedOn__PRTDSI__CAPS_SEL EQU CYREG_PRT3_CAPS_SEL
LedOn__PRTDSI__DBL_SYNC_IN EQU CYREG_PRT3_DBL_SYNC_IN
LedOn__PRTDSI__OE_SEL0 EQU CYREG_PRT3_OE_SEL0
LedOn__PRTDSI__OE_SEL1 EQU CYREG_PRT3_OE_SEL1
LedOn__PRTDSI__OUT_SEL0 EQU CYREG_PRT3_OUT_SEL0
LedOn__PRTDSI__OUT_SEL1 EQU CYREG_PRT3_OUT_SEL1
LedOn__PRTDSI__SYNC_OUT EQU CYREG_PRT3_SYNC_OUT
LedOn__PS EQU CYREG_PRT3_PS
LedOn__SHIFT EQU 7
LedOn__SLW EQU CYREG_PRT3_SLW

; MotorControl
MotorControl_PWMUDB_genblk1_ctrlreg__16BIT_CONTROL_AUX_CTL_REG EQU CYREG_B0_UDB07_08_ACTL
MotorControl_PWMUDB_genblk1_ctrlreg__16BIT_CONTROL_CONTROL_REG EQU CYREG_B0_UDB07_08_CTL
MotorControl_PWMUDB_genblk1_ctrlreg__16BIT_CONTROL_COUNT_REG EQU CYREG_B0_UDB07_08_CTL
MotorControl_PWMUDB_genblk1_ctrlreg__16BIT_COUNT_CONTROL_REG EQU CYREG_B0_UDB07_08_CTL
MotorControl_PWMUDB_genblk1_ctrlreg__16BIT_COUNT_COUNT_REG EQU CYREG_B0_UDB07_08_CTL
MotorControl_PWMUDB_genblk1_ctrlreg__16BIT_MASK_MASK_REG EQU CYREG_B0_UDB07_08_MSK
MotorControl_PWMUDB_genblk1_ctrlreg__16BIT_MASK_PERIOD_REG EQU CYREG_B0_UDB07_08_MSK
MotorControl_PWMUDB_genblk1_ctrlreg__16BIT_PERIOD_MASK_REG EQU CYREG_B0_UDB07_08_MSK
MotorControl_PWMUDB_genblk1_ctrlreg__16BIT_PERIOD_PERIOD_REG EQU CYREG_B0_UDB07_08_MSK
MotorControl_PWMUDB_genblk1_ctrlreg__7__MASK EQU 0x80
MotorControl_PWMUDB_genblk1_ctrlreg__7__POS EQU 7
MotorControl_PWMUDB_genblk1_ctrlreg__CONTROL_AUX_CTL_REG EQU CYREG_B0_UDB07_ACTL
MotorControl_PWMUDB_genblk1_ctrlreg__CONTROL_REG EQU CYREG_B0_UDB07_CTL
MotorControl_PWMUDB_genblk1_ctrlreg__CONTROL_ST_REG EQU CYREG_B0_UDB07_ST_CTL
MotorControl_PWMUDB_genblk1_ctrlreg__COUNT_REG EQU CYREG_B0_UDB07_CTL
MotorControl_PWMUDB_genblk1_ctrlreg__COUNT_ST_REG EQU CYREG_B0_UDB07_ST_CTL
MotorControl_PWMUDB_genblk1_ctrlreg__MASK EQU 0x80
MotorControl_PWMUDB_genblk1_ctrlreg__MASK_CTL_AUX_CTL_REG EQU CYREG_B0_UDB07_MSK_ACTL
MotorControl_PWMUDB_genblk1_ctrlreg__PER_CTL_AUX_CTL_REG EQU CYREG_B0_UDB07_MSK_ACTL
MotorControl_PWMUDB_genblk1_ctrlreg__PERIOD_REG EQU CYREG_B0_UDB07_MSK
MotorControl_PWMUDB_genblk8_stsreg__0__MASK EQU 0x01
MotorControl_PWMUDB_genblk8_stsreg__0__POS EQU 0
MotorControl_PWMUDB_genblk8_stsreg__1__MASK EQU 0x02
MotorControl_PWMUDB_genblk8_stsreg__1__POS EQU 1
MotorControl_PWMUDB_genblk8_stsreg__16BIT_STATUS_AUX_CTL_REG EQU CYREG_B0_UDB07_08_ACTL
MotorControl_PWMUDB_genblk8_stsreg__16BIT_STATUS_REG EQU CYREG_B0_UDB07_08_ST
MotorControl_PWMUDB_genblk8_stsreg__2__MASK EQU 0x04
MotorControl_PWMUDB_genblk8_stsreg__2__POS EQU 2
MotorControl_PWMUDB_genblk8_stsreg__3__MASK EQU 0x08
MotorControl_PWMUDB_genblk8_stsreg__3__POS EQU 3
MotorControl_PWMUDB_genblk8_stsreg__MASK EQU 0x0F
MotorControl_PWMUDB_genblk8_stsreg__MASK_REG EQU CYREG_B0_UDB07_MSK
MotorControl_PWMUDB_genblk8_stsreg__MASK_ST_AUX_CTL_REG EQU CYREG_B0_UDB07_MSK_ACTL
MotorControl_PWMUDB_genblk8_stsreg__PER_ST_AUX_CTL_REG EQU CYREG_B0_UDB07_MSK_ACTL
MotorControl_PWMUDB_genblk8_stsreg__STATUS_AUX_CTL_REG EQU CYREG_B0_UDB07_ACTL
MotorControl_PWMUDB_genblk8_stsreg__STATUS_CNT_REG EQU CYREG_B0_UDB07_ST_CTL
MotorControl_PWMUDB_genblk8_stsreg__STATUS_CONTROL_REG EQU CYREG_B0_UDB07_ST_CTL
MotorControl_PWMUDB_genblk8_stsreg__STATUS_REG EQU CYREG_B0_UDB07_ST
MotorControl_PWMUDB_sP8_pwmdp_u0__16BIT_A0_REG EQU CYREG_B0_UDB07_08_A0
MotorControl_PWMUDB_sP8_pwmdp_u0__16BIT_A1_REG EQU CYREG_B0_UDB07_08_A1
MotorControl_PWMUDB_sP8_pwmdp_u0__16BIT_D0_REG EQU CYREG_B0_UDB07_08_D0
MotorControl_PWMUDB_sP8_pwmdp_u0__16BIT_D1_REG EQU CYREG_B0_UDB07_08_D1
MotorControl_PWMUDB_sP8_pwmdp_u0__16BIT_DP_AUX_CTL_REG EQU CYREG_B0_UDB07_08_ACTL
MotorControl_PWMUDB_sP8_pwmdp_u0__16BIT_F0_REG EQU CYREG_B0_UDB07_08_F0
MotorControl_PWMUDB_sP8_pwmdp_u0__16BIT_F1_REG EQU CYREG_B0_UDB07_08_F1
MotorControl_PWMUDB_sP8_pwmdp_u0__A0_A1_REG EQU CYREG_B0_UDB07_A0_A1
MotorControl_PWMUDB_sP8_pwmdp_u0__A0_REG EQU CYREG_B0_UDB07_A0
MotorControl_PWMUDB_sP8_pwmdp_u0__A1_REG EQU CYREG_B0_UDB07_A1
MotorControl_PWMUDB_sP8_pwmdp_u0__D0_D1_REG EQU CYREG_B0_UDB07_D0_D1
MotorControl_PWMUDB_sP8_pwmdp_u0__D0_REG EQU CYREG_B0_UDB07_D0
MotorControl_PWMUDB_sP8_pwmdp_u0__D1_REG EQU CYREG_B0_UDB07_D1
MotorControl_PWMUDB_sP8_pwmdp_u0__DP_AUX_CTL_REG EQU CYREG_B0_UDB07_ACTL
MotorControl_PWMUDB_sP8_pwmdp_u0__F0_F1_REG EQU CYREG_B0_UDB07_F0_F1
MotorControl_PWMUDB_sP8_pwmdp_u0__F0_REG EQU CYREG_B0_UDB07_F0
MotorControl_PWMUDB_sP8_pwmdp_u0__F1_REG EQU CYREG_B0_UDB07_F1
MotorControl_PWMUDB_sP8_pwmdp_u0__MSK_DP_AUX_CTL_REG EQU CYREG_B0_UDB07_MSK_ACTL
MotorControl_PWMUDB_sP8_pwmdp_u0__PER_DP_AUX_CTL_REG EQU CYREG_B0_UDB07_MSK_ACTL

; SW1
SW1__0__INTTYPE EQU CYREG_PICU3_INTTYPE5
SW1__0__MASK EQU 0x20
SW1__0__PC EQU CYREG_PRT3_PC5
SW1__0__PORT EQU 3
SW1__0__SHIFT EQU 5
SW1__AG EQU CYREG_PRT3_AG
SW1__AMUX EQU CYREG_PRT3_AMUX
SW1__BIE EQU CYREG_PRT3_BIE
SW1__BIT_MASK EQU CYREG_PRT3_BIT_MASK
SW1__BYP EQU CYREG_PRT3_BYP
SW1__CTL EQU CYREG_PRT3_CTL
SW1__DM0 EQU CYREG_PRT3_DM0
SW1__DM1 EQU CYREG_PRT3_DM1
SW1__DM2 EQU CYREG_PRT3_DM2
SW1__DR EQU CYREG_PRT3_DR
SW1__INP_DIS EQU CYREG_PRT3_INP_DIS
SW1__INTTYPE_BASE EQU CYDEV_PICU_INTTYPE_PICU3_BASE
SW1__LCD_COM_SEG EQU CYREG_PRT3_LCD_COM_SEG
SW1__LCD_EN EQU CYREG_PRT3_LCD_EN
SW1__MASK EQU 0x20
SW1__PORT EQU 3
SW1__PRT EQU CYREG_PRT3_PRT
SW1__PRTDSI__CAPS_SEL EQU CYREG_PRT3_CAPS_SEL
SW1__PRTDSI__DBL_SYNC_IN EQU CYREG_PRT3_DBL_SYNC_IN
SW1__PRTDSI__OE_SEL0 EQU CYREG_PRT3_OE_SEL0
SW1__PRTDSI__OE_SEL1 EQU CYREG_PRT3_OE_SEL1
SW1__PRTDSI__OUT_SEL0 EQU CYREG_PRT3_OUT_SEL0
SW1__PRTDSI__OUT_SEL1 EQU CYREG_PRT3_OUT_SEL1
SW1__PRTDSI__SYNC_OUT EQU CYREG_PRT3_SYNC_OUT
SW1__PS EQU CYREG_PRT3_PS
SW1__SHIFT EQU 5
SW1__SLW EQU CYREG_PRT3_SLW

; SW2
SW2__0__INTTYPE EQU CYREG_PICU3_INTTYPE6
SW2__0__MASK EQU 0x40
SW2__0__PC EQU CYREG_PRT3_PC6
SW2__0__PORT EQU 3
SW2__0__SHIFT EQU 6
SW2__AG EQU CYREG_PRT3_AG
SW2__AMUX EQU CYREG_PRT3_AMUX
SW2__BIE EQU CYREG_PRT3_BIE
SW2__BIT_MASK EQU CYREG_PRT3_BIT_MASK
SW2__BYP EQU CYREG_PRT3_BYP
SW2__CTL EQU CYREG_PRT3_CTL
SW2__DM0 EQU CYREG_PRT3_DM0
SW2__DM1 EQU CYREG_PRT3_DM1
SW2__DM2 EQU CYREG_PRT3_DM2
SW2__DR EQU CYREG_PRT3_DR
SW2__INP_DIS EQU CYREG_PRT3_INP_DIS
SW2__INTTYPE_BASE EQU CYDEV_PICU_INTTYPE_PICU3_BASE
SW2__LCD_COM_SEG EQU CYREG_PRT3_LCD_COM_SEG
SW2__LCD_EN EQU CYREG_PRT3_LCD_EN
SW2__MASK EQU 0x40
SW2__PORT EQU 3
SW2__PRT EQU CYREG_PRT3_PRT
SW2__PRTDSI__CAPS_SEL EQU CYREG_PRT3_CAPS_SEL
SW2__PRTDSI__DBL_SYNC_IN EQU CYREG_PRT3_DBL_SYNC_IN
SW2__PRTDSI__OE_SEL0 EQU CYREG_PRT3_OE_SEL0
SW2__PRTDSI__OE_SEL1 EQU CYREG_PRT3_OE_SEL1
SW2__PRTDSI__OUT_SEL0 EQU CYREG_PRT3_OUT_SEL0
SW2__PRTDSI__OUT_SEL1 EQU CYREG_PRT3_OUT_SEL1
SW2__PRTDSI__SYNC_OUT EQU CYREG_PRT3_SYNC_OUT
SW2__PS EQU CYREG_PRT3_PS
SW2__SHIFT EQU 6
SW2__SLW EQU CYREG_PRT3_SLW

; readIRSensors
readIRSensors__INTC_CLR_EN_REG EQU CYREG_NVIC_CLRENA0
readIRSensors__INTC_CLR_PD_REG EQU CYREG_NVIC_CLRPEND0
readIRSensors__INTC_MASK EQU 0x02
readIRSensors__INTC_NUMBER EQU 1
readIRSensors__INTC_PRIOR_NUM EQU 7
readIRSensors__INTC_PRIOR_REG EQU CYREG_NVIC_PRI_1
readIRSensors__INTC_SET_EN_REG EQU CYREG_NVIC_SETENA0
readIRSensors__INTC_SET_PD_REG EQU CYREG_NVIC_SETPEND0

; Miscellaneous
BCLK__BUS_CLK__HZ EQU 24000000
BCLK__BUS_CLK__KHZ EQU 24000
BCLK__BUS_CLK__MHZ EQU 24
CYDEV_CHIP_DIE_LEOPARD EQU 1
CYDEV_CHIP_DIE_PSOC4A EQU 16
CYDEV_CHIP_DIE_PSOC5LP EQU 2
CYDEV_CHIP_DIE_PSOC5TM EQU 3
CYDEV_CHIP_DIE_TMA4 EQU 4
CYDEV_CHIP_DIE_UNKNOWN EQU 0
CYDEV_CHIP_FAMILY_FM0P EQU 5
CYDEV_CHIP_FAMILY_FM3 EQU 6
CYDEV_CHIP_FAMILY_FM4 EQU 7
CYDEV_CHIP_FAMILY_PSOC3 EQU 1
CYDEV_CHIP_FAMILY_PSOC4 EQU 2
CYDEV_CHIP_FAMILY_PSOC5 EQU 3
CYDEV_CHIP_FAMILY_PSOC6 EQU 4
CYDEV_CHIP_FAMILY_UNKNOWN EQU 0
CYDEV_CHIP_FAMILY_USED EQU CYDEV_CHIP_FAMILY_PSOC5
CYDEV_CHIP_JTAG_ID EQU 0x2E15A069
CYDEV_CHIP_MEMBER_3A EQU 1
CYDEV_CHIP_MEMBER_4A EQU 16
CYDEV_CHIP_MEMBER_4D EQU 12
CYDEV_CHIP_MEMBER_4E EQU 6
CYDEV_CHIP_MEMBER_4F EQU 17
CYDEV_CHIP_MEMBER_4G EQU 4
CYDEV_CHIP_MEMBER_4H EQU 15
CYDEV_CHIP_MEMBER_4I EQU 21
CYDEV_CHIP_MEMBER_4J EQU 13
CYDEV_CHIP_MEMBER_4K EQU 14
CYDEV_CHIP_MEMBER_4L EQU 20
CYDEV_CHIP_MEMBER_4M EQU 19
CYDEV_CHIP_MEMBER_4N EQU 9
CYDEV_CHIP_MEMBER_4O EQU 7
CYDEV_CHIP_MEMBER_4P EQU 18
CYDEV_CHIP_MEMBER_4Q EQU 11
CYDEV_CHIP_MEMBER_4R EQU 8
CYDEV_CHIP_MEMBER_4S EQU 10
CYDEV_CHIP_MEMBER_4U EQU 5
CYDEV_CHIP_MEMBER_5A EQU 3
CYDEV_CHIP_MEMBER_5B EQU 2
CYDEV_CHIP_MEMBER_6A EQU 22
CYDEV_CHIP_MEMBER_FM3 EQU 26
CYDEV_CHIP_MEMBER_FM4 EQU 27
CYDEV_CHIP_MEMBER_PDL_FM0P_TYPE1 EQU 23
CYDEV_CHIP_MEMBER_PDL_FM0P_TYPE2 EQU 24
CYDEV_CHIP_MEMBER_PDL_FM0P_TYPE3 EQU 25
CYDEV_CHIP_MEMBER_UNKNOWN EQU 0
CYDEV_CHIP_MEMBER_USED EQU CYDEV_CHIP_MEMBER_5B
CYDEV_CHIP_DIE_EXPECT EQU CYDEV_CHIP_MEMBER_USED
CYDEV_CHIP_DIE_ACTUAL EQU CYDEV_CHIP_DIE_EXPECT
CYDEV_CHIP_REV_LEOPARD_ES1 EQU 0
CYDEV_CHIP_REV_LEOPARD_ES2 EQU 1
CYDEV_CHIP_REV_LEOPARD_ES3 EQU 3
CYDEV_CHIP_REV_LEOPARD_PRODUCTION EQU 3
CYDEV_CHIP_REV_PSOC4A_ES0 EQU 17
CYDEV_CHIP_REV_PSOC4A_PRODUCTION EQU 17
CYDEV_CHIP_REV_PSOC5LP_ES0 EQU 0
CYDEV_CHIP_REV_PSOC5LP_PRODUCTION EQU 0
CYDEV_CHIP_REV_PSOC5TM_ES0 EQU 0
CYDEV_CHIP_REV_PSOC5TM_ES1 EQU 1
CYDEV_CHIP_REV_PSOC5TM_PRODUCTION EQU 1
CYDEV_CHIP_REV_TMA4_ES EQU 17
CYDEV_CHIP_REV_TMA4_ES2 EQU 33
CYDEV_CHIP_REV_TMA4_PRODUCTION EQU 17
CYDEV_CHIP_REVISION_3A_ES1 EQU 0
CYDEV_CHIP_REVISION_3A_ES2 EQU 1
CYDEV_CHIP_REVISION_3A_ES3 EQU 3
CYDEV_CHIP_REVISION_3A_PRODUCTION EQU 3
CYDEV_CHIP_REVISION_4A_ES0 EQU 17
CYDEV_CHIP_REVISION_4A_PRODUCTION EQU 17
CYDEV_CHIP_REVISION_4D_PRODUCTION EQU 0
CYDEV_CHIP_REVISION_4E_PRODUCTION EQU 0
CYDEV_CHIP_REVISION_4F_PRODUCTION EQU 0
CYDEV_CHIP_REVISION_4F_PRODUCTION_256DMA EQU 0
CYDEV_CHIP_REVISION_4F_PRODUCTION_256K EQU 0
CYDEV_CHIP_REVISION_4G_ES EQU 17
CYDEV_CHIP_REVISION_4G_ES2 EQU 33
CYDEV_CHIP_REVISION_4G_PRODUCTION EQU 17
CYDEV_CHIP_REVISION_4H_PRODUCTION EQU 0
CYDEV_CHIP_REVISION_4I_PRODUCTION EQU 0
CYDEV_CHIP_REVISION_4J_PRODUCTION EQU 0
CYDEV_CHIP_REVISION_4K_PRODUCTION EQU 0
CYDEV_CHIP_REVISION_4L_PRODUCTION EQU 0
CYDEV_CHIP_REVISION_4M_PRODUCTION EQU 0
CYDEV_CHIP_REVISION_4N_PRODUCTION EQU 0
CYDEV_CHIP_REVISION_4O_PRODUCTION EQU 0
CYDEV_CHIP_REVISION_4P_PRODUCTION EQU 0
CYDEV_CHIP_REVISION_4Q_PRODUCTION EQU 0
CYDEV_CHIP_REVISION_4R_PRODUCTION EQU 0
CYDEV_CHIP_REVISION_4S_PRODUCTION EQU 0
CYDEV_CHIP_REVISION_4U_PRODUCTION EQU 0
CYDEV_CHIP_REVISION_5A_ES0 EQU 0
CYDEV_CHIP_REVISION_5A_ES1 EQU 1
CYDEV_CHIP_REVISION_5A_PRODUCTION EQU 1
CYDEV_CHIP_REVISION_5B_ES0 EQU 0
CYDEV_CHIP_REVISION_5B_PRODUCTION EQU 0
CYDEV_CHIP_REVISION_6A_NO_UDB EQU 0
CYDEV_CHIP_REVISION_6A_PRODUCTION EQU 0
CYDEV_CHIP_REVISION_FM3_PRODUCTION EQU 0
CYDEV_CHIP_REVISION_FM4_PRODUCTION EQU 0
CYDEV_CHIP_REVISION_PDL_FM0P_TYPE1_PRODUCTION EQU 0
CYDEV_CHIP_REVISION_PDL_FM0P_TYPE2_PRODUCTION EQU 0
CYDEV_CHIP_REVISION_PDL_FM0P_TYPE3_PRODUCTION EQU 0
CYDEV_CHIP_REVISION_USED EQU CYDEV_CHIP_REVISION_5B_PRODUCTION
CYDEV_CHIP_REV_EXPECT EQU CYDEV_CHIP_REVISION_USED
CYDEV_CONFIG_FASTBOOT_ENABLED EQU 1
CYDEV_CONFIG_UNUSED_IO_AllowButWarn EQU 0
CYDEV_CONFIG_UNUSED_IO EQU CYDEV_CONFIG_UNUSED_IO_AllowButWarn
CYDEV_CONFIG_UNUSED_IO_AllowWithInfo EQU 1
CYDEV_CONFIG_UNUSED_IO_Disallowed EQU 2
CYDEV_CONFIGURATION_COMPRESSED EQU 1
CYDEV_CONFIGURATION_DMA EQU 0
CYDEV_CONFIGURATION_ECC EQU 1
CYDEV_CONFIGURATION_IMOENABLED EQU CYDEV_CONFIG_FASTBOOT_ENABLED
CYDEV_CONFIGURATION_MODE_COMPRESSED EQU 0
CYDEV_CONFIGURATION_MODE EQU CYDEV_CONFIGURATION_MODE_COMPRESSED
CYDEV_CONFIGURATION_MODE_DMA EQU 2
CYDEV_CONFIGURATION_MODE_UNCOMPRESSED EQU 1
CYDEV_DEBUG_ENABLE_MASK EQU 0x20
CYDEV_DEBUG_ENABLE_REGISTER EQU CYREG_MLOGIC_DEBUG
CYDEV_DEBUGGING_DPS_Disable EQU 3
CYDEV_DEBUGGING_DPS_JTAG_4 EQU 1
CYDEV_DEBUGGING_DPS_JTAG_5 EQU 0
CYDEV_DEBUGGING_DPS_SWD EQU 2
CYDEV_DEBUGGING_DPS_SWD_SWV EQU 6
CYDEV_DEBUGGING_DPS EQU CYDEV_DEBUGGING_DPS_SWD_SWV
CYDEV_DEBUGGING_ENABLE EQU 1
CYDEV_DEBUGGING_XRES EQU 0
CYDEV_DMA_CHANNELS_AVAILABLE EQU 24
CYDEV_ECC_ENABLE EQU 0
CYDEV_HEAP_SIZE EQU 0x80
CYDEV_INSTRUCT_CACHE_ENABLED EQU 1
CYDEV_INTR_RISING EQU 0x00000003
CYDEV_IS_EXPORTING_CODE EQU 0
CYDEV_IS_IMPORTING_CODE EQU 0
CYDEV_PROJ_TYPE EQU 0
CYDEV_PROJ_TYPE_BOOTLOADER EQU 1
CYDEV_PROJ_TYPE_LAUNCHER EQU 5
CYDEV_PROJ_TYPE_LOADABLE EQU 2
CYDEV_PROJ_TYPE_LOADABLEANDBOOTLOADER EQU 4
CYDEV_PROJ_TYPE_MULTIAPPBOOTLOADER EQU 3
CYDEV_PROJ_TYPE_STANDARD EQU 0
CYDEV_PROTECTION_ENABLE EQU 0
CYDEV_STACK_SIZE EQU 0x0800
CYDEV_USE_BUNDLED_CMSIS EQU 1
CYDEV_VARIABLE_VDDA EQU 0
CYDEV_VDDA_MV EQU 5000
CYDEV_VDDD_MV EQU 5000
CYDEV_VDDIO0_MV EQU 5000
CYDEV_VDDIO1_MV EQU 5000
CYDEV_VDDIO2_MV EQU 5000
CYDEV_VDDIO3_MV EQU 5000
CYDEV_VIO0_MV EQU 5000
CYDEV_VIO1_MV EQU 5000
CYDEV_VIO2_MV EQU 5000
CYDEV_VIO3_MV EQU 5000
CYIPBLOCK_ARM_CM3_VERSION EQU 0
CYIPBLOCK_P3_ANAIF_VERSION EQU 0
CYIPBLOCK_P3_CAPSENSE_VERSION EQU 0
CYIPBLOCK_P3_COMP_VERSION EQU 0
CYIPBLOCK_P3_DMA_VERSION EQU 0
CYIPBLOCK_P3_DRQ_VERSION EQU 0
CYIPBLOCK_P3_EMIF_VERSION EQU 0
CYIPBLOCK_P3_I2C_VERSION EQU 0
CYIPBLOCK_P3_LCD_VERSION EQU 0
CYIPBLOCK_P3_LPF_VERSION EQU 0
CYIPBLOCK_P3_PM_VERSION EQU 0
CYIPBLOCK_P3_TIMER_VERSION EQU 0
CYIPBLOCK_P3_USB_VERSION EQU 0
CYIPBLOCK_P3_VIDAC_VERSION EQU 0
CYIPBLOCK_P3_VREF_VERSION EQU 0
CYIPBLOCK_S8_GPIO_VERSION EQU 0
CYIPBLOCK_S8_IRQ_VERSION EQU 0
CYIPBLOCK_S8_SAR_VERSION EQU 0
CYIPBLOCK_S8_SIO_VERSION EQU 0
CYIPBLOCK_S8_UDB_VERSION EQU 0
DMA_CHANNELS_USED__MASK0 EQU 0x00000003
CYDEV_BOOTLOADER_ENABLE EQU 0
    ENDIF
    END

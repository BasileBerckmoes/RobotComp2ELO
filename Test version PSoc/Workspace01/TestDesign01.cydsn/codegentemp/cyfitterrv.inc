;
; File Name: cyfitterrv.inc
; 
; PSoC Creator  4.1 Update 1
;
; Description:
; 
;
;-------------------------------------------------------------------------------
; Copyright (c) 2007-2017 Cypress Semiconductor.  All rights reserved.
; You may use this file only in accordance with the license, terms, conditions, 
; disclaimers, and limitations in the end user license agreement accompanying 
; the software package with which this file was provided.
;-------------------------------------------------------------------------------

    IF :LNOT::DEF:INCLUDED_CYFITTERRV_INC
INCLUDED_CYFITTERRV_INC EQU 1
    GET cydevicerv.inc
    GET cydevicerv_trm.inc

; AdcMux
AdcMux_bSAR_SEQ_ChannelCounter__16BIT_CONTROL_AUX_CTL_REG EQU CYREG_B0_UDB06_07_ACTL
AdcMux_bSAR_SEQ_ChannelCounter__16BIT_CONTROL_CONTROL_REG EQU CYREG_B0_UDB06_07_CTL
AdcMux_bSAR_SEQ_ChannelCounter__16BIT_CONTROL_COUNT_REG EQU CYREG_B0_UDB06_07_CTL
AdcMux_bSAR_SEQ_ChannelCounter__16BIT_COUNT_CONTROL_REG EQU CYREG_B0_UDB06_07_CTL
AdcMux_bSAR_SEQ_ChannelCounter__16BIT_COUNT_COUNT_REG EQU CYREG_B0_UDB06_07_CTL
AdcMux_bSAR_SEQ_ChannelCounter__16BIT_MASK_MASK_REG EQU CYREG_B0_UDB06_07_MSK
AdcMux_bSAR_SEQ_ChannelCounter__16BIT_MASK_PERIOD_REG EQU CYREG_B0_UDB06_07_MSK
AdcMux_bSAR_SEQ_ChannelCounter__16BIT_PERIOD_MASK_REG EQU CYREG_B0_UDB06_07_MSK
AdcMux_bSAR_SEQ_ChannelCounter__16BIT_PERIOD_PERIOD_REG EQU CYREG_B0_UDB06_07_MSK
AdcMux_bSAR_SEQ_ChannelCounter__CONTROL_AUX_CTL_REG EQU CYREG_B0_UDB06_ACTL
AdcMux_bSAR_SEQ_ChannelCounter__CONTROL_REG EQU CYREG_B0_UDB06_CTL
AdcMux_bSAR_SEQ_ChannelCounter__CONTROL_ST_REG EQU CYREG_B0_UDB06_ST_CTL
AdcMux_bSAR_SEQ_ChannelCounter__COUNT_REG EQU CYREG_B0_UDB06_CTL
AdcMux_bSAR_SEQ_ChannelCounter__COUNT_ST_REG EQU CYREG_B0_UDB06_ST_CTL
AdcMux_bSAR_SEQ_ChannelCounter__MASK_CTL_AUX_CTL_REG EQU CYREG_B0_UDB06_MSK_ACTL
AdcMux_bSAR_SEQ_ChannelCounter__PER_CTL_AUX_CTL_REG EQU CYREG_B0_UDB06_MSK_ACTL
AdcMux_bSAR_SEQ_ChannelCounter__PERIOD_REG EQU CYREG_B0_UDB06_MSK
AdcMux_bSAR_SEQ_ChannelCounter_ST__16BIT_STATUS_AUX_CTL_REG EQU CYREG_B0_UDB06_07_ACTL
AdcMux_bSAR_SEQ_ChannelCounter_ST__16BIT_STATUS_REG EQU CYREG_B0_UDB06_07_ST
AdcMux_bSAR_SEQ_ChannelCounter_ST__MASK_REG EQU CYREG_B0_UDB06_MSK
AdcMux_bSAR_SEQ_ChannelCounter_ST__MASK_ST_AUX_CTL_REG EQU CYREG_B0_UDB06_MSK_ACTL
AdcMux_bSAR_SEQ_ChannelCounter_ST__PER_ST_AUX_CTL_REG EQU CYREG_B0_UDB06_MSK_ACTL
AdcMux_bSAR_SEQ_ChannelCounter_ST__STATUS_AUX_CTL_REG EQU CYREG_B0_UDB06_ACTL
AdcMux_bSAR_SEQ_ChannelCounter_ST__STATUS_CNT_REG EQU CYREG_B0_UDB06_ST_CTL
AdcMux_bSAR_SEQ_ChannelCounter_ST__STATUS_CONTROL_REG EQU CYREG_B0_UDB06_ST_CTL
AdcMux_bSAR_SEQ_ChannelCounter_ST__STATUS_REG EQU CYREG_B0_UDB06_ST
AdcMux_bSAR_SEQ_CtrlReg__0__MASK EQU 0x01
AdcMux_bSAR_SEQ_CtrlReg__0__POS EQU 0
AdcMux_bSAR_SEQ_CtrlReg__1__MASK EQU 0x02
AdcMux_bSAR_SEQ_CtrlReg__1__POS EQU 1
AdcMux_bSAR_SEQ_CtrlReg__16BIT_CONTROL_AUX_CTL_REG EQU CYREG_B0_UDB05_06_ACTL
AdcMux_bSAR_SEQ_CtrlReg__16BIT_CONTROL_CONTROL_REG EQU CYREG_B0_UDB05_06_CTL
AdcMux_bSAR_SEQ_CtrlReg__16BIT_CONTROL_COUNT_REG EQU CYREG_B0_UDB05_06_CTL
AdcMux_bSAR_SEQ_CtrlReg__16BIT_COUNT_CONTROL_REG EQU CYREG_B0_UDB05_06_CTL
AdcMux_bSAR_SEQ_CtrlReg__16BIT_COUNT_COUNT_REG EQU CYREG_B0_UDB05_06_CTL
AdcMux_bSAR_SEQ_CtrlReg__16BIT_MASK_MASK_REG EQU CYREG_B0_UDB05_06_MSK
AdcMux_bSAR_SEQ_CtrlReg__16BIT_MASK_PERIOD_REG EQU CYREG_B0_UDB05_06_MSK
AdcMux_bSAR_SEQ_CtrlReg__16BIT_PERIOD_MASK_REG EQU CYREG_B0_UDB05_06_MSK
AdcMux_bSAR_SEQ_CtrlReg__16BIT_PERIOD_PERIOD_REG EQU CYREG_B0_UDB05_06_MSK
AdcMux_bSAR_SEQ_CtrlReg__CONTROL_AUX_CTL_REG EQU CYREG_B0_UDB05_ACTL
AdcMux_bSAR_SEQ_CtrlReg__CONTROL_REG EQU CYREG_B0_UDB05_CTL
AdcMux_bSAR_SEQ_CtrlReg__CONTROL_ST_REG EQU CYREG_B0_UDB05_ST_CTL
AdcMux_bSAR_SEQ_CtrlReg__COUNT_REG EQU CYREG_B0_UDB05_CTL
AdcMux_bSAR_SEQ_CtrlReg__COUNT_ST_REG EQU CYREG_B0_UDB05_ST_CTL
AdcMux_bSAR_SEQ_CtrlReg__MASK EQU 0x03
AdcMux_bSAR_SEQ_CtrlReg__MASK_CTL_AUX_CTL_REG EQU CYREG_B0_UDB05_MSK_ACTL
AdcMux_bSAR_SEQ_CtrlReg__PER_CTL_AUX_CTL_REG EQU CYREG_B0_UDB05_MSK_ACTL
AdcMux_bSAR_SEQ_CtrlReg__PERIOD_REG EQU CYREG_B0_UDB05_MSK
AdcMux_bSAR_SEQ_EOCSts__0__MASK EQU 0x01
AdcMux_bSAR_SEQ_EOCSts__0__POS EQU 0
AdcMux_bSAR_SEQ_EOCSts__16BIT_STATUS_AUX_CTL_REG EQU CYREG_B0_UDB01_02_ACTL
AdcMux_bSAR_SEQ_EOCSts__16BIT_STATUS_REG EQU CYREG_B0_UDB01_02_ST
AdcMux_bSAR_SEQ_EOCSts__MASK EQU 0x01
AdcMux_bSAR_SEQ_EOCSts__MASK_REG EQU CYREG_B0_UDB01_MSK
AdcMux_bSAR_SEQ_EOCSts__STATUS_AUX_CTL_REG EQU CYREG_B0_UDB01_ACTL
AdcMux_bSAR_SEQ_EOCSts__STATUS_REG EQU CYREG_B0_UDB01_ST
AdcMux_FinalBuf__DRQ_CTL EQU CYREG_IDMUX_DRQ_CTL0
AdcMux_FinalBuf__DRQ_NUMBER EQU 0
AdcMux_FinalBuf__NUMBEROF_TDS EQU 0
AdcMux_FinalBuf__PRIORITY EQU 2
AdcMux_FinalBuf__TERMIN_EN EQU 0
AdcMux_FinalBuf__TERMIN_SEL EQU 0
AdcMux_FinalBuf__TERMOUT0_EN EQU 1
AdcMux_FinalBuf__TERMOUT0_SEL EQU 0
AdcMux_FinalBuf__TERMOUT1_EN EQU 0
AdcMux_FinalBuf__TERMOUT1_SEL EQU 0
AdcMux_IntClock__CFG0 EQU CYREG_CLKDIST_DCFG0_CFG0
AdcMux_IntClock__CFG1 EQU CYREG_CLKDIST_DCFG0_CFG1
AdcMux_IntClock__CFG2 EQU CYREG_CLKDIST_DCFG0_CFG2
AdcMux_IntClock__CFG2_SRC_SEL_MASK EQU 0x07
AdcMux_IntClock__INDEX EQU 0x00
AdcMux_IntClock__PM_ACT_CFG EQU CYREG_PM_ACT_CFG2
AdcMux_IntClock__PM_ACT_MSK EQU 0x01
AdcMux_IntClock__PM_STBY_CFG EQU CYREG_PM_STBY_CFG2
AdcMux_IntClock__PM_STBY_MSK EQU 0x01
AdcMux_IRQ__INTC_CLR_EN_REG EQU CYREG_NVIC_CLRENA0
AdcMux_IRQ__INTC_CLR_PD_REG EQU CYREG_NVIC_CLRPEND0
AdcMux_IRQ__INTC_MASK EQU 0x01
AdcMux_IRQ__INTC_NUMBER EQU 0
AdcMux_IRQ__INTC_PRIOR_NUM EQU 7
AdcMux_IRQ__INTC_PRIOR_REG EQU CYREG_NVIC_PRI_0
AdcMux_IRQ__INTC_SET_EN_REG EQU CYREG_NVIC_SETENA0
AdcMux_IRQ__INTC_SET_PD_REG EQU CYREG_NVIC_SETPEND0
AdcMux_SAR_ADC_SAR__CLK EQU CYREG_SAR0_CLK
AdcMux_SAR_ADC_SAR__CSR0 EQU CYREG_SAR0_CSR0
AdcMux_SAR_ADC_SAR__CSR1 EQU CYREG_SAR0_CSR1
AdcMux_SAR_ADC_SAR__CSR2 EQU CYREG_SAR0_CSR2
AdcMux_SAR_ADC_SAR__CSR3 EQU CYREG_SAR0_CSR3
AdcMux_SAR_ADC_SAR__CSR4 EQU CYREG_SAR0_CSR4
AdcMux_SAR_ADC_SAR__CSR5 EQU CYREG_SAR0_CSR5
AdcMux_SAR_ADC_SAR__CSR6 EQU CYREG_SAR0_CSR6
AdcMux_SAR_ADC_SAR__PM_ACT_CFG EQU CYREG_PM_ACT_CFG11
AdcMux_SAR_ADC_SAR__PM_ACT_MSK EQU 0x01
AdcMux_SAR_ADC_SAR__PM_STBY_CFG EQU CYREG_PM_STBY_CFG11
AdcMux_SAR_ADC_SAR__PM_STBY_MSK EQU 0x01
AdcMux_SAR_ADC_SAR__SW0 EQU CYREG_SAR0_SW0
AdcMux_SAR_ADC_SAR__SW2 EQU CYREG_SAR0_SW2
AdcMux_SAR_ADC_SAR__SW3 EQU CYREG_SAR0_SW3
AdcMux_SAR_ADC_SAR__SW4 EQU CYREG_SAR0_SW4
AdcMux_SAR_ADC_SAR__SW6 EQU CYREG_SAR0_SW6
AdcMux_SAR_ADC_SAR__TR0 EQU CYREG_SAR0_TR0
AdcMux_SAR_ADC_SAR__WRK0 EQU CYREG_SAR0_WRK0
AdcMux_SAR_ADC_SAR__WRK1 EQU CYREG_SAR0_WRK1
AdcMux_TempBuf__DRQ_CTL EQU CYREG_IDMUX_DRQ_CTL0
AdcMux_TempBuf__DRQ_NUMBER EQU 1
AdcMux_TempBuf__NUMBEROF_TDS EQU 0
AdcMux_TempBuf__PRIORITY EQU 2
AdcMux_TempBuf__TERMIN_EN EQU 0
AdcMux_TempBuf__TERMIN_SEL EQU 0
AdcMux_TempBuf__TERMOUT0_EN EQU 1
AdcMux_TempBuf__TERMOUT0_SEL EQU 1
AdcMux_TempBuf__TERMOUT1_EN EQU 0
AdcMux_TempBuf__TERMOUT1_SEL EQU 0

; LED1
LED1__0__INTTYPE EQU CYREG_PICU2_INTTYPE0
LED1__0__MASK EQU 0x01
LED1__0__PC EQU CYREG_PRT2_PC0
LED1__0__PORT EQU 2
LED1__0__SHIFT EQU 0
LED1__AG EQU CYREG_PRT2_AG
LED1__AMUX EQU CYREG_PRT2_AMUX
LED1__BIE EQU CYREG_PRT2_BIE
LED1__BIT_MASK EQU CYREG_PRT2_BIT_MASK
LED1__BYP EQU CYREG_PRT2_BYP
LED1__CTL EQU CYREG_PRT2_CTL
LED1__DM0 EQU CYREG_PRT2_DM0
LED1__DM1 EQU CYREG_PRT2_DM1
LED1__DM2 EQU CYREG_PRT2_DM2
LED1__DR EQU CYREG_PRT2_DR
LED1__INP_DIS EQU CYREG_PRT2_INP_DIS
LED1__INTTYPE_BASE EQU CYDEV_PICU_INTTYPE_PICU2_BASE
LED1__LCD_COM_SEG EQU CYREG_PRT2_LCD_COM_SEG
LED1__LCD_EN EQU CYREG_PRT2_LCD_EN
LED1__MASK EQU 0x01
LED1__PORT EQU 2
LED1__PRT EQU CYREG_PRT2_PRT
LED1__PRTDSI__CAPS_SEL EQU CYREG_PRT2_CAPS_SEL
LED1__PRTDSI__DBL_SYNC_IN EQU CYREG_PRT2_DBL_SYNC_IN
LED1__PRTDSI__OE_SEL0 EQU CYREG_PRT2_OE_SEL0
LED1__PRTDSI__OE_SEL1 EQU CYREG_PRT2_OE_SEL1
LED1__PRTDSI__OUT_SEL0 EQU CYREG_PRT2_OUT_SEL0
LED1__PRTDSI__OUT_SEL1 EQU CYREG_PRT2_OUT_SEL1
LED1__PRTDSI__SYNC_OUT EQU CYREG_PRT2_SYNC_OUT
LED1__PS EQU CYREG_PRT2_PS
LED1__SHIFT EQU 0
LED1__SLW EQU CYREG_PRT2_SLW

; LED2
LED2__0__INTTYPE EQU CYREG_PICU2_INTTYPE1
LED2__0__MASK EQU 0x02
LED2__0__PC EQU CYREG_PRT2_PC1
LED2__0__PORT EQU 2
LED2__0__SHIFT EQU 1
LED2__AG EQU CYREG_PRT2_AG
LED2__AMUX EQU CYREG_PRT2_AMUX
LED2__BIE EQU CYREG_PRT2_BIE
LED2__BIT_MASK EQU CYREG_PRT2_BIT_MASK
LED2__BYP EQU CYREG_PRT2_BYP
LED2__CTL EQU CYREG_PRT2_CTL
LED2__DM0 EQU CYREG_PRT2_DM0
LED2__DM1 EQU CYREG_PRT2_DM1
LED2__DM2 EQU CYREG_PRT2_DM2
LED2__DR EQU CYREG_PRT2_DR
LED2__INP_DIS EQU CYREG_PRT2_INP_DIS
LED2__INTTYPE_BASE EQU CYDEV_PICU_INTTYPE_PICU2_BASE
LED2__LCD_COM_SEG EQU CYREG_PRT2_LCD_COM_SEG
LED2__LCD_EN EQU CYREG_PRT2_LCD_EN
LED2__MASK EQU 0x02
LED2__PORT EQU 2
LED2__PRT EQU CYREG_PRT2_PRT
LED2__PRTDSI__CAPS_SEL EQU CYREG_PRT2_CAPS_SEL
LED2__PRTDSI__DBL_SYNC_IN EQU CYREG_PRT2_DBL_SYNC_IN
LED2__PRTDSI__OE_SEL0 EQU CYREG_PRT2_OE_SEL0
LED2__PRTDSI__OE_SEL1 EQU CYREG_PRT2_OE_SEL1
LED2__PRTDSI__OUT_SEL0 EQU CYREG_PRT2_OUT_SEL0
LED2__PRTDSI__OUT_SEL1 EQU CYREG_PRT2_OUT_SEL1
LED2__PRTDSI__SYNC_OUT EQU CYREG_PRT2_SYNC_OUT
LED2__PS EQU CYREG_PRT2_PS
LED2__SHIFT EQU 1
LED2__SLW EQU CYREG_PRT2_SLW

; LED3
LED3__0__INTTYPE EQU CYREG_PICU2_INTTYPE2
LED3__0__MASK EQU 0x04
LED3__0__PC EQU CYREG_PRT2_PC2
LED3__0__PORT EQU 2
LED3__0__SHIFT EQU 2
LED3__AG EQU CYREG_PRT2_AG
LED3__AMUX EQU CYREG_PRT2_AMUX
LED3__BIE EQU CYREG_PRT2_BIE
LED3__BIT_MASK EQU CYREG_PRT2_BIT_MASK
LED3__BYP EQU CYREG_PRT2_BYP
LED3__CTL EQU CYREG_PRT2_CTL
LED3__DM0 EQU CYREG_PRT2_DM0
LED3__DM1 EQU CYREG_PRT2_DM1
LED3__DM2 EQU CYREG_PRT2_DM2
LED3__DR EQU CYREG_PRT2_DR
LED3__INP_DIS EQU CYREG_PRT2_INP_DIS
LED3__INTTYPE_BASE EQU CYDEV_PICU_INTTYPE_PICU2_BASE
LED3__LCD_COM_SEG EQU CYREG_PRT2_LCD_COM_SEG
LED3__LCD_EN EQU CYREG_PRT2_LCD_EN
LED3__MASK EQU 0x04
LED3__PORT EQU 2
LED3__PRT EQU CYREG_PRT2_PRT
LED3__PRTDSI__CAPS_SEL EQU CYREG_PRT2_CAPS_SEL
LED3__PRTDSI__DBL_SYNC_IN EQU CYREG_PRT2_DBL_SYNC_IN
LED3__PRTDSI__OE_SEL0 EQU CYREG_PRT2_OE_SEL0
LED3__PRTDSI__OE_SEL1 EQU CYREG_PRT2_OE_SEL1
LED3__PRTDSI__OUT_SEL0 EQU CYREG_PRT2_OUT_SEL0
LED3__PRTDSI__OUT_SEL1 EQU CYREG_PRT2_OUT_SEL1
LED3__PRTDSI__SYNC_OUT EQU CYREG_PRT2_SYNC_OUT
LED3__PS EQU CYREG_PRT2_PS
LED3__SHIFT EQU 2
LED3__SLW EQU CYREG_PRT2_SLW

; Sensor0
Sensor0__0__INTTYPE EQU CYREG_PICU0_INTTYPE0
Sensor0__0__MASK EQU 0x01
Sensor0__0__PC EQU CYREG_PRT0_PC0
Sensor0__0__PORT EQU 0
Sensor0__0__SHIFT EQU 0
Sensor0__AG EQU CYREG_PRT0_AG
Sensor0__AMUX EQU CYREG_PRT0_AMUX
Sensor0__BIE EQU CYREG_PRT0_BIE
Sensor0__BIT_MASK EQU CYREG_PRT0_BIT_MASK
Sensor0__BYP EQU CYREG_PRT0_BYP
Sensor0__CTL EQU CYREG_PRT0_CTL
Sensor0__DM0 EQU CYREG_PRT0_DM0
Sensor0__DM1 EQU CYREG_PRT0_DM1
Sensor0__DM2 EQU CYREG_PRT0_DM2
Sensor0__DR EQU CYREG_PRT0_DR
Sensor0__INP_DIS EQU CYREG_PRT0_INP_DIS
Sensor0__INTTYPE_BASE EQU CYDEV_PICU_INTTYPE_PICU0_BASE
Sensor0__LCD_COM_SEG EQU CYREG_PRT0_LCD_COM_SEG
Sensor0__LCD_EN EQU CYREG_PRT0_LCD_EN
Sensor0__MASK EQU 0x01
Sensor0__PORT EQU 0
Sensor0__PRT EQU CYREG_PRT0_PRT
Sensor0__PRTDSI__CAPS_SEL EQU CYREG_PRT0_CAPS_SEL
Sensor0__PRTDSI__DBL_SYNC_IN EQU CYREG_PRT0_DBL_SYNC_IN
Sensor0__PRTDSI__OE_SEL0 EQU CYREG_PRT0_OE_SEL0
Sensor0__PRTDSI__OE_SEL1 EQU CYREG_PRT0_OE_SEL1
Sensor0__PRTDSI__OUT_SEL0 EQU CYREG_PRT0_OUT_SEL0
Sensor0__PRTDSI__OUT_SEL1 EQU CYREG_PRT0_OUT_SEL1
Sensor0__PRTDSI__SYNC_OUT EQU CYREG_PRT0_SYNC_OUT
Sensor0__PS EQU CYREG_PRT0_PS
Sensor0__SHIFT EQU 0
Sensor0__SLW EQU CYREG_PRT0_SLW

; Sensor1
Sensor1__0__INTTYPE EQU CYREG_PICU0_INTTYPE1
Sensor1__0__MASK EQU 0x02
Sensor1__0__PC EQU CYREG_PRT0_PC1
Sensor1__0__PORT EQU 0
Sensor1__0__SHIFT EQU 1
Sensor1__AG EQU CYREG_PRT0_AG
Sensor1__AMUX EQU CYREG_PRT0_AMUX
Sensor1__BIE EQU CYREG_PRT0_BIE
Sensor1__BIT_MASK EQU CYREG_PRT0_BIT_MASK
Sensor1__BYP EQU CYREG_PRT0_BYP
Sensor1__CTL EQU CYREG_PRT0_CTL
Sensor1__DM0 EQU CYREG_PRT0_DM0
Sensor1__DM1 EQU CYREG_PRT0_DM1
Sensor1__DM2 EQU CYREG_PRT0_DM2
Sensor1__DR EQU CYREG_PRT0_DR
Sensor1__INP_DIS EQU CYREG_PRT0_INP_DIS
Sensor1__INTTYPE_BASE EQU CYDEV_PICU_INTTYPE_PICU0_BASE
Sensor1__LCD_COM_SEG EQU CYREG_PRT0_LCD_COM_SEG
Sensor1__LCD_EN EQU CYREG_PRT0_LCD_EN
Sensor1__MASK EQU 0x02
Sensor1__PORT EQU 0
Sensor1__PRT EQU CYREG_PRT0_PRT
Sensor1__PRTDSI__CAPS_SEL EQU CYREG_PRT0_CAPS_SEL
Sensor1__PRTDSI__DBL_SYNC_IN EQU CYREG_PRT0_DBL_SYNC_IN
Sensor1__PRTDSI__OE_SEL0 EQU CYREG_PRT0_OE_SEL0
Sensor1__PRTDSI__OE_SEL1 EQU CYREG_PRT0_OE_SEL1
Sensor1__PRTDSI__OUT_SEL0 EQU CYREG_PRT0_OUT_SEL0
Sensor1__PRTDSI__OUT_SEL1 EQU CYREG_PRT0_OUT_SEL1
Sensor1__PRTDSI__SYNC_OUT EQU CYREG_PRT0_SYNC_OUT
Sensor1__PS EQU CYREG_PRT0_PS
Sensor1__SHIFT EQU 1
Sensor1__SLW EQU CYREG_PRT0_SLW

; Sensor2
Sensor2__0__INTTYPE EQU CYREG_PICU0_INTTYPE2
Sensor2__0__MASK EQU 0x04
Sensor2__0__PC EQU CYREG_PRT0_PC2
Sensor2__0__PORT EQU 0
Sensor2__0__SHIFT EQU 2
Sensor2__AG EQU CYREG_PRT0_AG
Sensor2__AMUX EQU CYREG_PRT0_AMUX
Sensor2__BIE EQU CYREG_PRT0_BIE
Sensor2__BIT_MASK EQU CYREG_PRT0_BIT_MASK
Sensor2__BYP EQU CYREG_PRT0_BYP
Sensor2__CTL EQU CYREG_PRT0_CTL
Sensor2__DM0 EQU CYREG_PRT0_DM0
Sensor2__DM1 EQU CYREG_PRT0_DM1
Sensor2__DM2 EQU CYREG_PRT0_DM2
Sensor2__DR EQU CYREG_PRT0_DR
Sensor2__INP_DIS EQU CYREG_PRT0_INP_DIS
Sensor2__INTTYPE_BASE EQU CYDEV_PICU_INTTYPE_PICU0_BASE
Sensor2__LCD_COM_SEG EQU CYREG_PRT0_LCD_COM_SEG
Sensor2__LCD_EN EQU CYREG_PRT0_LCD_EN
Sensor2__MASK EQU 0x04
Sensor2__PORT EQU 0
Sensor2__PRT EQU CYREG_PRT0_PRT
Sensor2__PRTDSI__CAPS_SEL EQU CYREG_PRT0_CAPS_SEL
Sensor2__PRTDSI__DBL_SYNC_IN EQU CYREG_PRT0_DBL_SYNC_IN
Sensor2__PRTDSI__OE_SEL0 EQU CYREG_PRT0_OE_SEL0
Sensor2__PRTDSI__OE_SEL1 EQU CYREG_PRT0_OE_SEL1
Sensor2__PRTDSI__OUT_SEL0 EQU CYREG_PRT0_OUT_SEL0
Sensor2__PRTDSI__OUT_SEL1 EQU CYREG_PRT0_OUT_SEL1
Sensor2__PRTDSI__SYNC_OUT EQU CYREG_PRT0_SYNC_OUT
Sensor2__PS EQU CYREG_PRT0_PS
Sensor2__SHIFT EQU 2
Sensor2__SLW EQU CYREG_PRT0_SLW

; Sensor3
Sensor3__0__INTTYPE EQU CYREG_PICU0_INTTYPE3
Sensor3__0__MASK EQU 0x08
Sensor3__0__PC EQU CYREG_PRT0_PC3
Sensor3__0__PORT EQU 0
Sensor3__0__SHIFT EQU 3
Sensor3__AG EQU CYREG_PRT0_AG
Sensor3__AMUX EQU CYREG_PRT0_AMUX
Sensor3__BIE EQU CYREG_PRT0_BIE
Sensor3__BIT_MASK EQU CYREG_PRT0_BIT_MASK
Sensor3__BYP EQU CYREG_PRT0_BYP
Sensor3__CTL EQU CYREG_PRT0_CTL
Sensor3__DM0 EQU CYREG_PRT0_DM0
Sensor3__DM1 EQU CYREG_PRT0_DM1
Sensor3__DM2 EQU CYREG_PRT0_DM2
Sensor3__DR EQU CYREG_PRT0_DR
Sensor3__INP_DIS EQU CYREG_PRT0_INP_DIS
Sensor3__INTTYPE_BASE EQU CYDEV_PICU_INTTYPE_PICU0_BASE
Sensor3__LCD_COM_SEG EQU CYREG_PRT0_LCD_COM_SEG
Sensor3__LCD_EN EQU CYREG_PRT0_LCD_EN
Sensor3__MASK EQU 0x08
Sensor3__PORT EQU 0
Sensor3__PRT EQU CYREG_PRT0_PRT
Sensor3__PRTDSI__CAPS_SEL EQU CYREG_PRT0_CAPS_SEL
Sensor3__PRTDSI__DBL_SYNC_IN EQU CYREG_PRT0_DBL_SYNC_IN
Sensor3__PRTDSI__OE_SEL0 EQU CYREG_PRT0_OE_SEL0
Sensor3__PRTDSI__OE_SEL1 EQU CYREG_PRT0_OE_SEL1
Sensor3__PRTDSI__OUT_SEL0 EQU CYREG_PRT0_OUT_SEL0
Sensor3__PRTDSI__OUT_SEL1 EQU CYREG_PRT0_OUT_SEL1
Sensor3__PRTDSI__SYNC_OUT EQU CYREG_PRT0_SYNC_OUT
Sensor3__PS EQU CYREG_PRT0_PS
Sensor3__SHIFT EQU 3
Sensor3__SLW EQU CYREG_PRT0_SLW

; Miscellaneous
BCLK__BUS_CLK__HZ EQU 24000000
BCLK__BUS_CLK__KHZ EQU 24000
BCLK__BUS_CLK__MHZ EQU 24
CYDEV_CHIP_DIE_LEOPARD EQU 1
CYDEV_CHIP_DIE_PSOC4A EQU 16
CYDEV_CHIP_DIE_PSOC5LP EQU 2
CYDEV_CHIP_DIE_PSOC5TM EQU 3
CYDEV_CHIP_DIE_TMA4 EQU 4
CYDEV_CHIP_DIE_UNKNOWN EQU 0
CYDEV_CHIP_FAMILY_FM0P EQU 5
CYDEV_CHIP_FAMILY_FM3 EQU 6
CYDEV_CHIP_FAMILY_FM4 EQU 7
CYDEV_CHIP_FAMILY_PSOC3 EQU 1
CYDEV_CHIP_FAMILY_PSOC4 EQU 2
CYDEV_CHIP_FAMILY_PSOC5 EQU 3
CYDEV_CHIP_FAMILY_PSOC6 EQU 4
CYDEV_CHIP_FAMILY_UNKNOWN EQU 0
CYDEV_CHIP_FAMILY_USED EQU CYDEV_CHIP_FAMILY_PSOC5
CYDEV_CHIP_JTAG_ID EQU 0x2E15A069
CYDEV_CHIP_MEMBER_3A EQU 1
CYDEV_CHIP_MEMBER_4A EQU 16
CYDEV_CHIP_MEMBER_4D EQU 12
CYDEV_CHIP_MEMBER_4E EQU 6
CYDEV_CHIP_MEMBER_4F EQU 17
CYDEV_CHIP_MEMBER_4G EQU 4
CYDEV_CHIP_MEMBER_4H EQU 15
CYDEV_CHIP_MEMBER_4I EQU 21
CYDEV_CHIP_MEMBER_4J EQU 13
CYDEV_CHIP_MEMBER_4K EQU 14
CYDEV_CHIP_MEMBER_4L EQU 20
CYDEV_CHIP_MEMBER_4M EQU 19
CYDEV_CHIP_MEMBER_4N EQU 9
CYDEV_CHIP_MEMBER_4O EQU 7
CYDEV_CHIP_MEMBER_4P EQU 18
CYDEV_CHIP_MEMBER_4Q EQU 11
CYDEV_CHIP_MEMBER_4R EQU 8
CYDEV_CHIP_MEMBER_4S EQU 10
CYDEV_CHIP_MEMBER_4U EQU 5
CYDEV_CHIP_MEMBER_5A EQU 3
CYDEV_CHIP_MEMBER_5B EQU 2
CYDEV_CHIP_MEMBER_6A EQU 22
CYDEV_CHIP_MEMBER_FM3 EQU 26
CYDEV_CHIP_MEMBER_FM4 EQU 27
CYDEV_CHIP_MEMBER_PDL_FM0P_TYPE1 EQU 23
CYDEV_CHIP_MEMBER_PDL_FM0P_TYPE2 EQU 24
CYDEV_CHIP_MEMBER_PDL_FM0P_TYPE3 EQU 25
CYDEV_CHIP_MEMBER_UNKNOWN EQU 0
CYDEV_CHIP_MEMBER_USED EQU CYDEV_CHIP_MEMBER_5B
CYDEV_CHIP_DIE_EXPECT EQU CYDEV_CHIP_MEMBER_USED
CYDEV_CHIP_DIE_ACTUAL EQU CYDEV_CHIP_DIE_EXPECT
CYDEV_CHIP_REV_LEOPARD_ES1 EQU 0
CYDEV_CHIP_REV_LEOPARD_ES2 EQU 1
CYDEV_CHIP_REV_LEOPARD_ES3 EQU 3
CYDEV_CHIP_REV_LEOPARD_PRODUCTION EQU 3
CYDEV_CHIP_REV_PSOC4A_ES0 EQU 17
CYDEV_CHIP_REV_PSOC4A_PRODUCTION EQU 17
CYDEV_CHIP_REV_PSOC5LP_ES0 EQU 0
CYDEV_CHIP_REV_PSOC5LP_PRODUCTION EQU 0
CYDEV_CHIP_REV_PSOC5TM_ES0 EQU 0
CYDEV_CHIP_REV_PSOC5TM_ES1 EQU 1
CYDEV_CHIP_REV_PSOC5TM_PRODUCTION EQU 1
CYDEV_CHIP_REV_TMA4_ES EQU 17
CYDEV_CHIP_REV_TMA4_ES2 EQU 33
CYDEV_CHIP_REV_TMA4_PRODUCTION EQU 17
CYDEV_CHIP_REVISION_3A_ES1 EQU 0
CYDEV_CHIP_REVISION_3A_ES2 EQU 1
CYDEV_CHIP_REVISION_3A_ES3 EQU 3
CYDEV_CHIP_REVISION_3A_PRODUCTION EQU 3
CYDEV_CHIP_REVISION_4A_ES0 EQU 17
CYDEV_CHIP_REVISION_4A_PRODUCTION EQU 17
CYDEV_CHIP_REVISION_4D_PRODUCTION EQU 0
CYDEV_CHIP_REVISION_4E_PRODUCTION EQU 0
CYDEV_CHIP_REVISION_4F_PRODUCTION EQU 0
CYDEV_CHIP_REVISION_4F_PRODUCTION_256DMA EQU 0
CYDEV_CHIP_REVISION_4F_PRODUCTION_256K EQU 0
CYDEV_CHIP_REVISION_4G_ES EQU 17
CYDEV_CHIP_REVISION_4G_ES2 EQU 33
CYDEV_CHIP_REVISION_4G_PRODUCTION EQU 17
CYDEV_CHIP_REVISION_4H_PRODUCTION EQU 0
CYDEV_CHIP_REVISION_4I_PRODUCTION EQU 0
CYDEV_CHIP_REVISION_4J_PRODUCTION EQU 0
CYDEV_CHIP_REVISION_4K_PRODUCTION EQU 0
CYDEV_CHIP_REVISION_4L_PRODUCTION EQU 0
CYDEV_CHIP_REVISION_4M_PRODUCTION EQU 0
CYDEV_CHIP_REVISION_4N_PRODUCTION EQU 0
CYDEV_CHIP_REVISION_4O_PRODUCTION EQU 0
CYDEV_CHIP_REVISION_4P_PRODUCTION EQU 0
CYDEV_CHIP_REVISION_4Q_PRODUCTION EQU 0
CYDEV_CHIP_REVISION_4R_PRODUCTION EQU 0
CYDEV_CHIP_REVISION_4S_PRODUCTION EQU 0
CYDEV_CHIP_REVISION_4U_PRODUCTION EQU 0
CYDEV_CHIP_REVISION_5A_ES0 EQU 0
CYDEV_CHIP_REVISION_5A_ES1 EQU 1
CYDEV_CHIP_REVISION_5A_PRODUCTION EQU 1
CYDEV_CHIP_REVISION_5B_ES0 EQU 0
CYDEV_CHIP_REVISION_5B_PRODUCTION EQU 0
CYDEV_CHIP_REVISION_6A_NO_UDB EQU 0
CYDEV_CHIP_REVISION_6A_PRODUCTION EQU 0
CYDEV_CHIP_REVISION_FM3_PRODUCTION EQU 0
CYDEV_CHIP_REVISION_FM4_PRODUCTION EQU 0
CYDEV_CHIP_REVISION_PDL_FM0P_TYPE1_PRODUCTION EQU 0
CYDEV_CHIP_REVISION_PDL_FM0P_TYPE2_PRODUCTION EQU 0
CYDEV_CHIP_REVISION_PDL_FM0P_TYPE3_PRODUCTION EQU 0
CYDEV_CHIP_REVISION_USED EQU CYDEV_CHIP_REVISION_5B_PRODUCTION
CYDEV_CHIP_REV_EXPECT EQU CYDEV_CHIP_REVISION_USED
CYDEV_CONFIG_FASTBOOT_ENABLED EQU 1
CYDEV_CONFIG_UNUSED_IO_AllowButWarn EQU 0
CYDEV_CONFIG_UNUSED_IO EQU CYDEV_CONFIG_UNUSED_IO_AllowButWarn
CYDEV_CONFIG_UNUSED_IO_AllowWithInfo EQU 1
CYDEV_CONFIG_UNUSED_IO_Disallowed EQU 2
CYDEV_CONFIGURATION_COMPRESSED EQU 1
CYDEV_CONFIGURATION_DMA EQU 0
CYDEV_CONFIGURATION_ECC EQU 1
CYDEV_CONFIGURATION_IMOENABLED EQU CYDEV_CONFIG_FASTBOOT_ENABLED
CYDEV_CONFIGURATION_MODE_COMPRESSED EQU 0
CYDEV_CONFIGURATION_MODE EQU CYDEV_CONFIGURATION_MODE_COMPRESSED
CYDEV_CONFIGURATION_MODE_DMA EQU 2
CYDEV_CONFIGURATION_MODE_UNCOMPRESSED EQU 1
CYDEV_DEBUG_ENABLE_MASK EQU 0x20
CYDEV_DEBUG_ENABLE_REGISTER EQU CYREG_MLOGIC_DEBUG
CYDEV_DEBUGGING_DPS_Disable EQU 3
CYDEV_DEBUGGING_DPS_JTAG_4 EQU 1
CYDEV_DEBUGGING_DPS_JTAG_5 EQU 0
CYDEV_DEBUGGING_DPS_SWD EQU 2
CYDEV_DEBUGGING_DPS_SWD_SWV EQU 6
CYDEV_DEBUGGING_DPS EQU CYDEV_DEBUGGING_DPS_SWD_SWV
CYDEV_DEBUGGING_ENABLE EQU 1
CYDEV_DEBUGGING_XRES EQU 0
CYDEV_DMA_CHANNELS_AVAILABLE EQU 24
CYDEV_ECC_ENABLE EQU 0
CYDEV_HEAP_SIZE EQU 0x80
CYDEV_INSTRUCT_CACHE_ENABLED EQU 1
CYDEV_INTR_RISING EQU 0x00000001
CYDEV_IS_EXPORTING_CODE EQU 0
CYDEV_IS_IMPORTING_CODE EQU 0
CYDEV_PROJ_TYPE EQU 0
CYDEV_PROJ_TYPE_BOOTLOADER EQU 1
CYDEV_PROJ_TYPE_LAUNCHER EQU 5
CYDEV_PROJ_TYPE_LOADABLE EQU 2
CYDEV_PROJ_TYPE_LOADABLEANDBOOTLOADER EQU 4
CYDEV_PROJ_TYPE_MULTIAPPBOOTLOADER EQU 3
CYDEV_PROJ_TYPE_STANDARD EQU 0
CYDEV_PROTECTION_ENABLE EQU 0
CYDEV_STACK_SIZE EQU 0x0800
CYDEV_USE_BUNDLED_CMSIS EQU 1
CYDEV_VARIABLE_VDDA EQU 0
CYDEV_VDDA_MV EQU 5000
CYDEV_VDDD_MV EQU 5000
CYDEV_VDDIO0_MV EQU 5000
CYDEV_VDDIO1_MV EQU 5000
CYDEV_VDDIO2_MV EQU 5000
CYDEV_VDDIO3_MV EQU 5000
CYDEV_VIO0_MV EQU 5000
CYDEV_VIO1_MV EQU 5000
CYDEV_VIO2_MV EQU 5000
CYDEV_VIO3_MV EQU 5000
CYIPBLOCK_ARM_CM3_VERSION EQU 0
CYIPBLOCK_P3_ANAIF_VERSION EQU 0
CYIPBLOCK_P3_CAPSENSE_VERSION EQU 0
CYIPBLOCK_P3_COMP_VERSION EQU 0
CYIPBLOCK_P3_DMA_VERSION EQU 0
CYIPBLOCK_P3_DRQ_VERSION EQU 0
CYIPBLOCK_P3_EMIF_VERSION EQU 0
CYIPBLOCK_P3_I2C_VERSION EQU 0
CYIPBLOCK_P3_LCD_VERSION EQU 0
CYIPBLOCK_P3_LPF_VERSION EQU 0
CYIPBLOCK_P3_PM_VERSION EQU 0
CYIPBLOCK_P3_TIMER_VERSION EQU 0
CYIPBLOCK_P3_USB_VERSION EQU 0
CYIPBLOCK_P3_VIDAC_VERSION EQU 0
CYIPBLOCK_P3_VREF_VERSION EQU 0
CYIPBLOCK_S8_GPIO_VERSION EQU 0
CYIPBLOCK_S8_IRQ_VERSION EQU 0
CYIPBLOCK_S8_SAR_VERSION EQU 0
CYIPBLOCK_S8_SIO_VERSION EQU 0
CYIPBLOCK_S8_UDB_VERSION EQU 0
DMA_CHANNELS_USED__MASK0 EQU 0x00000003
CYDEV_BOOTLOADER_ENABLE EQU 0
    ENDIF
    END

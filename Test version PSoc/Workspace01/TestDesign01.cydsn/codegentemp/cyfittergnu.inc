/*******************************************************************************
* File Name: cyfittergnu.inc
* 
* PSoC Creator  4.1 Update 1
*
* Description:
* 
* This file is automatically generated by PSoC Creator.
*
********************************************************************************
* Copyright (c) 2007-2017 Cypress Semiconductor.  All rights reserved.
* You may use this file only in accordance with the license, terms, conditions, 
* disclaimers, and limitations in the end user license agreement accompanying 
* the software package with which this file was provided.
********************************************************************************/

.ifndef INCLUDED_CYFITTERGNU_INC
.set INCLUDED_CYFITTERGNU_INC, 1
.include "cydevicegnu.inc"
.include "cydevicegnu_trm.inc"

/* AdcMux */
.set AdcMux_bSAR_SEQ_ChannelCounter__16BIT_CONTROL_AUX_CTL_REG, CYREG_B0_UDB06_07_ACTL
.set AdcMux_bSAR_SEQ_ChannelCounter__16BIT_CONTROL_CONTROL_REG, CYREG_B0_UDB06_07_CTL
.set AdcMux_bSAR_SEQ_ChannelCounter__16BIT_CONTROL_COUNT_REG, CYREG_B0_UDB06_07_CTL
.set AdcMux_bSAR_SEQ_ChannelCounter__16BIT_COUNT_CONTROL_REG, CYREG_B0_UDB06_07_CTL
.set AdcMux_bSAR_SEQ_ChannelCounter__16BIT_COUNT_COUNT_REG, CYREG_B0_UDB06_07_CTL
.set AdcMux_bSAR_SEQ_ChannelCounter__16BIT_MASK_MASK_REG, CYREG_B0_UDB06_07_MSK
.set AdcMux_bSAR_SEQ_ChannelCounter__16BIT_MASK_PERIOD_REG, CYREG_B0_UDB06_07_MSK
.set AdcMux_bSAR_SEQ_ChannelCounter__16BIT_PERIOD_MASK_REG, CYREG_B0_UDB06_07_MSK
.set AdcMux_bSAR_SEQ_ChannelCounter__16BIT_PERIOD_PERIOD_REG, CYREG_B0_UDB06_07_MSK
.set AdcMux_bSAR_SEQ_ChannelCounter__CONTROL_AUX_CTL_REG, CYREG_B0_UDB06_ACTL
.set AdcMux_bSAR_SEQ_ChannelCounter__CONTROL_REG, CYREG_B0_UDB06_CTL
.set AdcMux_bSAR_SEQ_ChannelCounter__CONTROL_ST_REG, CYREG_B0_UDB06_ST_CTL
.set AdcMux_bSAR_SEQ_ChannelCounter__COUNT_REG, CYREG_B0_UDB06_CTL
.set AdcMux_bSAR_SEQ_ChannelCounter__COUNT_ST_REG, CYREG_B0_UDB06_ST_CTL
.set AdcMux_bSAR_SEQ_ChannelCounter__MASK_CTL_AUX_CTL_REG, CYREG_B0_UDB06_MSK_ACTL
.set AdcMux_bSAR_SEQ_ChannelCounter__PER_CTL_AUX_CTL_REG, CYREG_B0_UDB06_MSK_ACTL
.set AdcMux_bSAR_SEQ_ChannelCounter__PERIOD_REG, CYREG_B0_UDB06_MSK
.set AdcMux_bSAR_SEQ_ChannelCounter_ST__16BIT_STATUS_AUX_CTL_REG, CYREG_B0_UDB06_07_ACTL
.set AdcMux_bSAR_SEQ_ChannelCounter_ST__16BIT_STATUS_REG, CYREG_B0_UDB06_07_ST
.set AdcMux_bSAR_SEQ_ChannelCounter_ST__MASK_REG, CYREG_B0_UDB06_MSK
.set AdcMux_bSAR_SEQ_ChannelCounter_ST__MASK_ST_AUX_CTL_REG, CYREG_B0_UDB06_MSK_ACTL
.set AdcMux_bSAR_SEQ_ChannelCounter_ST__PER_ST_AUX_CTL_REG, CYREG_B0_UDB06_MSK_ACTL
.set AdcMux_bSAR_SEQ_ChannelCounter_ST__STATUS_AUX_CTL_REG, CYREG_B0_UDB06_ACTL
.set AdcMux_bSAR_SEQ_ChannelCounter_ST__STATUS_CNT_REG, CYREG_B0_UDB06_ST_CTL
.set AdcMux_bSAR_SEQ_ChannelCounter_ST__STATUS_CONTROL_REG, CYREG_B0_UDB06_ST_CTL
.set AdcMux_bSAR_SEQ_ChannelCounter_ST__STATUS_REG, CYREG_B0_UDB06_ST
.set AdcMux_bSAR_SEQ_CtrlReg__0__MASK, 0x01
.set AdcMux_bSAR_SEQ_CtrlReg__0__POS, 0
.set AdcMux_bSAR_SEQ_CtrlReg__1__MASK, 0x02
.set AdcMux_bSAR_SEQ_CtrlReg__1__POS, 1
.set AdcMux_bSAR_SEQ_CtrlReg__16BIT_CONTROL_AUX_CTL_REG, CYREG_B0_UDB05_06_ACTL
.set AdcMux_bSAR_SEQ_CtrlReg__16BIT_CONTROL_CONTROL_REG, CYREG_B0_UDB05_06_CTL
.set AdcMux_bSAR_SEQ_CtrlReg__16BIT_CONTROL_COUNT_REG, CYREG_B0_UDB05_06_CTL
.set AdcMux_bSAR_SEQ_CtrlReg__16BIT_COUNT_CONTROL_REG, CYREG_B0_UDB05_06_CTL
.set AdcMux_bSAR_SEQ_CtrlReg__16BIT_COUNT_COUNT_REG, CYREG_B0_UDB05_06_CTL
.set AdcMux_bSAR_SEQ_CtrlReg__16BIT_MASK_MASK_REG, CYREG_B0_UDB05_06_MSK
.set AdcMux_bSAR_SEQ_CtrlReg__16BIT_MASK_PERIOD_REG, CYREG_B0_UDB05_06_MSK
.set AdcMux_bSAR_SEQ_CtrlReg__16BIT_PERIOD_MASK_REG, CYREG_B0_UDB05_06_MSK
.set AdcMux_bSAR_SEQ_CtrlReg__16BIT_PERIOD_PERIOD_REG, CYREG_B0_UDB05_06_MSK
.set AdcMux_bSAR_SEQ_CtrlReg__CONTROL_AUX_CTL_REG, CYREG_B0_UDB05_ACTL
.set AdcMux_bSAR_SEQ_CtrlReg__CONTROL_REG, CYREG_B0_UDB05_CTL
.set AdcMux_bSAR_SEQ_CtrlReg__CONTROL_ST_REG, CYREG_B0_UDB05_ST_CTL
.set AdcMux_bSAR_SEQ_CtrlReg__COUNT_REG, CYREG_B0_UDB05_CTL
.set AdcMux_bSAR_SEQ_CtrlReg__COUNT_ST_REG, CYREG_B0_UDB05_ST_CTL
.set AdcMux_bSAR_SEQ_CtrlReg__MASK, 0x03
.set AdcMux_bSAR_SEQ_CtrlReg__MASK_CTL_AUX_CTL_REG, CYREG_B0_UDB05_MSK_ACTL
.set AdcMux_bSAR_SEQ_CtrlReg__PER_CTL_AUX_CTL_REG, CYREG_B0_UDB05_MSK_ACTL
.set AdcMux_bSAR_SEQ_CtrlReg__PERIOD_REG, CYREG_B0_UDB05_MSK
.set AdcMux_bSAR_SEQ_EOCSts__0__MASK, 0x01
.set AdcMux_bSAR_SEQ_EOCSts__0__POS, 0
.set AdcMux_bSAR_SEQ_EOCSts__16BIT_STATUS_AUX_CTL_REG, CYREG_B0_UDB01_02_ACTL
.set AdcMux_bSAR_SEQ_EOCSts__16BIT_STATUS_REG, CYREG_B0_UDB01_02_ST
.set AdcMux_bSAR_SEQ_EOCSts__MASK, 0x01
.set AdcMux_bSAR_SEQ_EOCSts__MASK_REG, CYREG_B0_UDB01_MSK
.set AdcMux_bSAR_SEQ_EOCSts__STATUS_AUX_CTL_REG, CYREG_B0_UDB01_ACTL
.set AdcMux_bSAR_SEQ_EOCSts__STATUS_REG, CYREG_B0_UDB01_ST
.set AdcMux_FinalBuf__DRQ_CTL, CYREG_IDMUX_DRQ_CTL0
.set AdcMux_FinalBuf__DRQ_NUMBER, 0
.set AdcMux_FinalBuf__NUMBEROF_TDS, 0
.set AdcMux_FinalBuf__PRIORITY, 2
.set AdcMux_FinalBuf__TERMIN_EN, 0
.set AdcMux_FinalBuf__TERMIN_SEL, 0
.set AdcMux_FinalBuf__TERMOUT0_EN, 1
.set AdcMux_FinalBuf__TERMOUT0_SEL, 0
.set AdcMux_FinalBuf__TERMOUT1_EN, 0
.set AdcMux_FinalBuf__TERMOUT1_SEL, 0
.set AdcMux_IntClock__CFG0, CYREG_CLKDIST_DCFG0_CFG0
.set AdcMux_IntClock__CFG1, CYREG_CLKDIST_DCFG0_CFG1
.set AdcMux_IntClock__CFG2, CYREG_CLKDIST_DCFG0_CFG2
.set AdcMux_IntClock__CFG2_SRC_SEL_MASK, 0x07
.set AdcMux_IntClock__INDEX, 0x00
.set AdcMux_IntClock__PM_ACT_CFG, CYREG_PM_ACT_CFG2
.set AdcMux_IntClock__PM_ACT_MSK, 0x01
.set AdcMux_IntClock__PM_STBY_CFG, CYREG_PM_STBY_CFG2
.set AdcMux_IntClock__PM_STBY_MSK, 0x01
.set AdcMux_IRQ__INTC_CLR_EN_REG, CYREG_NVIC_CLRENA0
.set AdcMux_IRQ__INTC_CLR_PD_REG, CYREG_NVIC_CLRPEND0
.set AdcMux_IRQ__INTC_MASK, 0x01
.set AdcMux_IRQ__INTC_NUMBER, 0
.set AdcMux_IRQ__INTC_PRIOR_NUM, 7
.set AdcMux_IRQ__INTC_PRIOR_REG, CYREG_NVIC_PRI_0
.set AdcMux_IRQ__INTC_SET_EN_REG, CYREG_NVIC_SETENA0
.set AdcMux_IRQ__INTC_SET_PD_REG, CYREG_NVIC_SETPEND0
.set AdcMux_SAR_ADC_SAR__CLK, CYREG_SAR0_CLK
.set AdcMux_SAR_ADC_SAR__CSR0, CYREG_SAR0_CSR0
.set AdcMux_SAR_ADC_SAR__CSR1, CYREG_SAR0_CSR1
.set AdcMux_SAR_ADC_SAR__CSR2, CYREG_SAR0_CSR2
.set AdcMux_SAR_ADC_SAR__CSR3, CYREG_SAR0_CSR3
.set AdcMux_SAR_ADC_SAR__CSR4, CYREG_SAR0_CSR4
.set AdcMux_SAR_ADC_SAR__CSR5, CYREG_SAR0_CSR5
.set AdcMux_SAR_ADC_SAR__CSR6, CYREG_SAR0_CSR6
.set AdcMux_SAR_ADC_SAR__PM_ACT_CFG, CYREG_PM_ACT_CFG11
.set AdcMux_SAR_ADC_SAR__PM_ACT_MSK, 0x01
.set AdcMux_SAR_ADC_SAR__PM_STBY_CFG, CYREG_PM_STBY_CFG11
.set AdcMux_SAR_ADC_SAR__PM_STBY_MSK, 0x01
.set AdcMux_SAR_ADC_SAR__SW0, CYREG_SAR0_SW0
.set AdcMux_SAR_ADC_SAR__SW2, CYREG_SAR0_SW2
.set AdcMux_SAR_ADC_SAR__SW3, CYREG_SAR0_SW3
.set AdcMux_SAR_ADC_SAR__SW4, CYREG_SAR0_SW4
.set AdcMux_SAR_ADC_SAR__SW6, CYREG_SAR0_SW6
.set AdcMux_SAR_ADC_SAR__TR0, CYREG_SAR0_TR0
.set AdcMux_SAR_ADC_SAR__WRK0, CYREG_SAR0_WRK0
.set AdcMux_SAR_ADC_SAR__WRK1, CYREG_SAR0_WRK1
.set AdcMux_TempBuf__DRQ_CTL, CYREG_IDMUX_DRQ_CTL0
.set AdcMux_TempBuf__DRQ_NUMBER, 1
.set AdcMux_TempBuf__NUMBEROF_TDS, 0
.set AdcMux_TempBuf__PRIORITY, 2
.set AdcMux_TempBuf__TERMIN_EN, 0
.set AdcMux_TempBuf__TERMIN_SEL, 0
.set AdcMux_TempBuf__TERMOUT0_EN, 1
.set AdcMux_TempBuf__TERMOUT0_SEL, 1
.set AdcMux_TempBuf__TERMOUT1_EN, 0
.set AdcMux_TempBuf__TERMOUT1_SEL, 0

/* LED1 */
.set LED1__0__INTTYPE, CYREG_PICU2_INTTYPE0
.set LED1__0__MASK, 0x01
.set LED1__0__PC, CYREG_PRT2_PC0
.set LED1__0__PORT, 2
.set LED1__0__SHIFT, 0
.set LED1__AG, CYREG_PRT2_AG
.set LED1__AMUX, CYREG_PRT2_AMUX
.set LED1__BIE, CYREG_PRT2_BIE
.set LED1__BIT_MASK, CYREG_PRT2_BIT_MASK
.set LED1__BYP, CYREG_PRT2_BYP
.set LED1__CTL, CYREG_PRT2_CTL
.set LED1__DM0, CYREG_PRT2_DM0
.set LED1__DM1, CYREG_PRT2_DM1
.set LED1__DM2, CYREG_PRT2_DM2
.set LED1__DR, CYREG_PRT2_DR
.set LED1__INP_DIS, CYREG_PRT2_INP_DIS
.set LED1__INTTYPE_BASE, CYDEV_PICU_INTTYPE_PICU2_BASE
.set LED1__LCD_COM_SEG, CYREG_PRT2_LCD_COM_SEG
.set LED1__LCD_EN, CYREG_PRT2_LCD_EN
.set LED1__MASK, 0x01
.set LED1__PORT, 2
.set LED1__PRT, CYREG_PRT2_PRT
.set LED1__PRTDSI__CAPS_SEL, CYREG_PRT2_CAPS_SEL
.set LED1__PRTDSI__DBL_SYNC_IN, CYREG_PRT2_DBL_SYNC_IN
.set LED1__PRTDSI__OE_SEL0, CYREG_PRT2_OE_SEL0
.set LED1__PRTDSI__OE_SEL1, CYREG_PRT2_OE_SEL1
.set LED1__PRTDSI__OUT_SEL0, CYREG_PRT2_OUT_SEL0
.set LED1__PRTDSI__OUT_SEL1, CYREG_PRT2_OUT_SEL1
.set LED1__PRTDSI__SYNC_OUT, CYREG_PRT2_SYNC_OUT
.set LED1__PS, CYREG_PRT2_PS
.set LED1__SHIFT, 0
.set LED1__SLW, CYREG_PRT2_SLW

/* LED2 */
.set LED2__0__INTTYPE, CYREG_PICU2_INTTYPE1
.set LED2__0__MASK, 0x02
.set LED2__0__PC, CYREG_PRT2_PC1
.set LED2__0__PORT, 2
.set LED2__0__SHIFT, 1
.set LED2__AG, CYREG_PRT2_AG
.set LED2__AMUX, CYREG_PRT2_AMUX
.set LED2__BIE, CYREG_PRT2_BIE
.set LED2__BIT_MASK, CYREG_PRT2_BIT_MASK
.set LED2__BYP, CYREG_PRT2_BYP
.set LED2__CTL, CYREG_PRT2_CTL
.set LED2__DM0, CYREG_PRT2_DM0
.set LED2__DM1, CYREG_PRT2_DM1
.set LED2__DM2, CYREG_PRT2_DM2
.set LED2__DR, CYREG_PRT2_DR
.set LED2__INP_DIS, CYREG_PRT2_INP_DIS
.set LED2__INTTYPE_BASE, CYDEV_PICU_INTTYPE_PICU2_BASE
.set LED2__LCD_COM_SEG, CYREG_PRT2_LCD_COM_SEG
.set LED2__LCD_EN, CYREG_PRT2_LCD_EN
.set LED2__MASK, 0x02
.set LED2__PORT, 2
.set LED2__PRT, CYREG_PRT2_PRT
.set LED2__PRTDSI__CAPS_SEL, CYREG_PRT2_CAPS_SEL
.set LED2__PRTDSI__DBL_SYNC_IN, CYREG_PRT2_DBL_SYNC_IN
.set LED2__PRTDSI__OE_SEL0, CYREG_PRT2_OE_SEL0
.set LED2__PRTDSI__OE_SEL1, CYREG_PRT2_OE_SEL1
.set LED2__PRTDSI__OUT_SEL0, CYREG_PRT2_OUT_SEL0
.set LED2__PRTDSI__OUT_SEL1, CYREG_PRT2_OUT_SEL1
.set LED2__PRTDSI__SYNC_OUT, CYREG_PRT2_SYNC_OUT
.set LED2__PS, CYREG_PRT2_PS
.set LED2__SHIFT, 1
.set LED2__SLW, CYREG_PRT2_SLW

/* LED3 */
.set LED3__0__INTTYPE, CYREG_PICU2_INTTYPE2
.set LED3__0__MASK, 0x04
.set LED3__0__PC, CYREG_PRT2_PC2
.set LED3__0__PORT, 2
.set LED3__0__SHIFT, 2
.set LED3__AG, CYREG_PRT2_AG
.set LED3__AMUX, CYREG_PRT2_AMUX
.set LED3__BIE, CYREG_PRT2_BIE
.set LED3__BIT_MASK, CYREG_PRT2_BIT_MASK
.set LED3__BYP, CYREG_PRT2_BYP
.set LED3__CTL, CYREG_PRT2_CTL
.set LED3__DM0, CYREG_PRT2_DM0
.set LED3__DM1, CYREG_PRT2_DM1
.set LED3__DM2, CYREG_PRT2_DM2
.set LED3__DR, CYREG_PRT2_DR
.set LED3__INP_DIS, CYREG_PRT2_INP_DIS
.set LED3__INTTYPE_BASE, CYDEV_PICU_INTTYPE_PICU2_BASE
.set LED3__LCD_COM_SEG, CYREG_PRT2_LCD_COM_SEG
.set LED3__LCD_EN, CYREG_PRT2_LCD_EN
.set LED3__MASK, 0x04
.set LED3__PORT, 2
.set LED3__PRT, CYREG_PRT2_PRT
.set LED3__PRTDSI__CAPS_SEL, CYREG_PRT2_CAPS_SEL
.set LED3__PRTDSI__DBL_SYNC_IN, CYREG_PRT2_DBL_SYNC_IN
.set LED3__PRTDSI__OE_SEL0, CYREG_PRT2_OE_SEL0
.set LED3__PRTDSI__OE_SEL1, CYREG_PRT2_OE_SEL1
.set LED3__PRTDSI__OUT_SEL0, CYREG_PRT2_OUT_SEL0
.set LED3__PRTDSI__OUT_SEL1, CYREG_PRT2_OUT_SEL1
.set LED3__PRTDSI__SYNC_OUT, CYREG_PRT2_SYNC_OUT
.set LED3__PS, CYREG_PRT2_PS
.set LED3__SHIFT, 2
.set LED3__SLW, CYREG_PRT2_SLW

/* Sensor0 */
.set Sensor0__0__INTTYPE, CYREG_PICU0_INTTYPE0
.set Sensor0__0__MASK, 0x01
.set Sensor0__0__PC, CYREG_PRT0_PC0
.set Sensor0__0__PORT, 0
.set Sensor0__0__SHIFT, 0
.set Sensor0__AG, CYREG_PRT0_AG
.set Sensor0__AMUX, CYREG_PRT0_AMUX
.set Sensor0__BIE, CYREG_PRT0_BIE
.set Sensor0__BIT_MASK, CYREG_PRT0_BIT_MASK
.set Sensor0__BYP, CYREG_PRT0_BYP
.set Sensor0__CTL, CYREG_PRT0_CTL
.set Sensor0__DM0, CYREG_PRT0_DM0
.set Sensor0__DM1, CYREG_PRT0_DM1
.set Sensor0__DM2, CYREG_PRT0_DM2
.set Sensor0__DR, CYREG_PRT0_DR
.set Sensor0__INP_DIS, CYREG_PRT0_INP_DIS
.set Sensor0__INTTYPE_BASE, CYDEV_PICU_INTTYPE_PICU0_BASE
.set Sensor0__LCD_COM_SEG, CYREG_PRT0_LCD_COM_SEG
.set Sensor0__LCD_EN, CYREG_PRT0_LCD_EN
.set Sensor0__MASK, 0x01
.set Sensor0__PORT, 0
.set Sensor0__PRT, CYREG_PRT0_PRT
.set Sensor0__PRTDSI__CAPS_SEL, CYREG_PRT0_CAPS_SEL
.set Sensor0__PRTDSI__DBL_SYNC_IN, CYREG_PRT0_DBL_SYNC_IN
.set Sensor0__PRTDSI__OE_SEL0, CYREG_PRT0_OE_SEL0
.set Sensor0__PRTDSI__OE_SEL1, CYREG_PRT0_OE_SEL1
.set Sensor0__PRTDSI__OUT_SEL0, CYREG_PRT0_OUT_SEL0
.set Sensor0__PRTDSI__OUT_SEL1, CYREG_PRT0_OUT_SEL1
.set Sensor0__PRTDSI__SYNC_OUT, CYREG_PRT0_SYNC_OUT
.set Sensor0__PS, CYREG_PRT0_PS
.set Sensor0__SHIFT, 0
.set Sensor0__SLW, CYREG_PRT0_SLW

/* Sensor1 */
.set Sensor1__0__INTTYPE, CYREG_PICU0_INTTYPE1
.set Sensor1__0__MASK, 0x02
.set Sensor1__0__PC, CYREG_PRT0_PC1
.set Sensor1__0__PORT, 0
.set Sensor1__0__SHIFT, 1
.set Sensor1__AG, CYREG_PRT0_AG
.set Sensor1__AMUX, CYREG_PRT0_AMUX
.set Sensor1__BIE, CYREG_PRT0_BIE
.set Sensor1__BIT_MASK, CYREG_PRT0_BIT_MASK
.set Sensor1__BYP, CYREG_PRT0_BYP
.set Sensor1__CTL, CYREG_PRT0_CTL
.set Sensor1__DM0, CYREG_PRT0_DM0
.set Sensor1__DM1, CYREG_PRT0_DM1
.set Sensor1__DM2, CYREG_PRT0_DM2
.set Sensor1__DR, CYREG_PRT0_DR
.set Sensor1__INP_DIS, CYREG_PRT0_INP_DIS
.set Sensor1__INTTYPE_BASE, CYDEV_PICU_INTTYPE_PICU0_BASE
.set Sensor1__LCD_COM_SEG, CYREG_PRT0_LCD_COM_SEG
.set Sensor1__LCD_EN, CYREG_PRT0_LCD_EN
.set Sensor1__MASK, 0x02
.set Sensor1__PORT, 0
.set Sensor1__PRT, CYREG_PRT0_PRT
.set Sensor1__PRTDSI__CAPS_SEL, CYREG_PRT0_CAPS_SEL
.set Sensor1__PRTDSI__DBL_SYNC_IN, CYREG_PRT0_DBL_SYNC_IN
.set Sensor1__PRTDSI__OE_SEL0, CYREG_PRT0_OE_SEL0
.set Sensor1__PRTDSI__OE_SEL1, CYREG_PRT0_OE_SEL1
.set Sensor1__PRTDSI__OUT_SEL0, CYREG_PRT0_OUT_SEL0
.set Sensor1__PRTDSI__OUT_SEL1, CYREG_PRT0_OUT_SEL1
.set Sensor1__PRTDSI__SYNC_OUT, CYREG_PRT0_SYNC_OUT
.set Sensor1__PS, CYREG_PRT0_PS
.set Sensor1__SHIFT, 1
.set Sensor1__SLW, CYREG_PRT0_SLW

/* Sensor2 */
.set Sensor2__0__INTTYPE, CYREG_PICU0_INTTYPE2
.set Sensor2__0__MASK, 0x04
.set Sensor2__0__PC, CYREG_PRT0_PC2
.set Sensor2__0__PORT, 0
.set Sensor2__0__SHIFT, 2
.set Sensor2__AG, CYREG_PRT0_AG
.set Sensor2__AMUX, CYREG_PRT0_AMUX
.set Sensor2__BIE, CYREG_PRT0_BIE
.set Sensor2__BIT_MASK, CYREG_PRT0_BIT_MASK
.set Sensor2__BYP, CYREG_PRT0_BYP
.set Sensor2__CTL, CYREG_PRT0_CTL
.set Sensor2__DM0, CYREG_PRT0_DM0
.set Sensor2__DM1, CYREG_PRT0_DM1
.set Sensor2__DM2, CYREG_PRT0_DM2
.set Sensor2__DR, CYREG_PRT0_DR
.set Sensor2__INP_DIS, CYREG_PRT0_INP_DIS
.set Sensor2__INTTYPE_BASE, CYDEV_PICU_INTTYPE_PICU0_BASE
.set Sensor2__LCD_COM_SEG, CYREG_PRT0_LCD_COM_SEG
.set Sensor2__LCD_EN, CYREG_PRT0_LCD_EN
.set Sensor2__MASK, 0x04
.set Sensor2__PORT, 0
.set Sensor2__PRT, CYREG_PRT0_PRT
.set Sensor2__PRTDSI__CAPS_SEL, CYREG_PRT0_CAPS_SEL
.set Sensor2__PRTDSI__DBL_SYNC_IN, CYREG_PRT0_DBL_SYNC_IN
.set Sensor2__PRTDSI__OE_SEL0, CYREG_PRT0_OE_SEL0
.set Sensor2__PRTDSI__OE_SEL1, CYREG_PRT0_OE_SEL1
.set Sensor2__PRTDSI__OUT_SEL0, CYREG_PRT0_OUT_SEL0
.set Sensor2__PRTDSI__OUT_SEL1, CYREG_PRT0_OUT_SEL1
.set Sensor2__PRTDSI__SYNC_OUT, CYREG_PRT0_SYNC_OUT
.set Sensor2__PS, CYREG_PRT0_PS
.set Sensor2__SHIFT, 2
.set Sensor2__SLW, CYREG_PRT0_SLW

/* Sensor3 */
.set Sensor3__0__INTTYPE, CYREG_PICU0_INTTYPE3
.set Sensor3__0__MASK, 0x08
.set Sensor3__0__PC, CYREG_PRT0_PC3
.set Sensor3__0__PORT, 0
.set Sensor3__0__SHIFT, 3
.set Sensor3__AG, CYREG_PRT0_AG
.set Sensor3__AMUX, CYREG_PRT0_AMUX
.set Sensor3__BIE, CYREG_PRT0_BIE
.set Sensor3__BIT_MASK, CYREG_PRT0_BIT_MASK
.set Sensor3__BYP, CYREG_PRT0_BYP
.set Sensor3__CTL, CYREG_PRT0_CTL
.set Sensor3__DM0, CYREG_PRT0_DM0
.set Sensor3__DM1, CYREG_PRT0_DM1
.set Sensor3__DM2, CYREG_PRT0_DM2
.set Sensor3__DR, CYREG_PRT0_DR
.set Sensor3__INP_DIS, CYREG_PRT0_INP_DIS
.set Sensor3__INTTYPE_BASE, CYDEV_PICU_INTTYPE_PICU0_BASE
.set Sensor3__LCD_COM_SEG, CYREG_PRT0_LCD_COM_SEG
.set Sensor3__LCD_EN, CYREG_PRT0_LCD_EN
.set Sensor3__MASK, 0x08
.set Sensor3__PORT, 0
.set Sensor3__PRT, CYREG_PRT0_PRT
.set Sensor3__PRTDSI__CAPS_SEL, CYREG_PRT0_CAPS_SEL
.set Sensor3__PRTDSI__DBL_SYNC_IN, CYREG_PRT0_DBL_SYNC_IN
.set Sensor3__PRTDSI__OE_SEL0, CYREG_PRT0_OE_SEL0
.set Sensor3__PRTDSI__OE_SEL1, CYREG_PRT0_OE_SEL1
.set Sensor3__PRTDSI__OUT_SEL0, CYREG_PRT0_OUT_SEL0
.set Sensor3__PRTDSI__OUT_SEL1, CYREG_PRT0_OUT_SEL1
.set Sensor3__PRTDSI__SYNC_OUT, CYREG_PRT0_SYNC_OUT
.set Sensor3__PS, CYREG_PRT0_PS
.set Sensor3__SHIFT, 3
.set Sensor3__SLW, CYREG_PRT0_SLW

/* Miscellaneous */
.set BCLK__BUS_CLK__HZ, 24000000
.set BCLK__BUS_CLK__KHZ, 24000
.set BCLK__BUS_CLK__MHZ, 24
.set CYDEV_CHIP_DIE_LEOPARD, 1
.set CYDEV_CHIP_DIE_PSOC4A, 16
.set CYDEV_CHIP_DIE_PSOC5LP, 2
.set CYDEV_CHIP_DIE_PSOC5TM, 3
.set CYDEV_CHIP_DIE_TMA4, 4
.set CYDEV_CHIP_DIE_UNKNOWN, 0
.set CYDEV_CHIP_FAMILY_FM0P, 5
.set CYDEV_CHIP_FAMILY_FM3, 6
.set CYDEV_CHIP_FAMILY_FM4, 7
.set CYDEV_CHIP_FAMILY_PSOC3, 1
.set CYDEV_CHIP_FAMILY_PSOC4, 2
.set CYDEV_CHIP_FAMILY_PSOC5, 3
.set CYDEV_CHIP_FAMILY_PSOC6, 4
.set CYDEV_CHIP_FAMILY_UNKNOWN, 0
.set CYDEV_CHIP_FAMILY_USED, CYDEV_CHIP_FAMILY_PSOC5
.set CYDEV_CHIP_JTAG_ID, 0x2E15A069
.set CYDEV_CHIP_MEMBER_3A, 1
.set CYDEV_CHIP_MEMBER_4A, 16
.set CYDEV_CHIP_MEMBER_4D, 12
.set CYDEV_CHIP_MEMBER_4E, 6
.set CYDEV_CHIP_MEMBER_4F, 17
.set CYDEV_CHIP_MEMBER_4G, 4
.set CYDEV_CHIP_MEMBER_4H, 15
.set CYDEV_CHIP_MEMBER_4I, 21
.set CYDEV_CHIP_MEMBER_4J, 13
.set CYDEV_CHIP_MEMBER_4K, 14
.set CYDEV_CHIP_MEMBER_4L, 20
.set CYDEV_CHIP_MEMBER_4M, 19
.set CYDEV_CHIP_MEMBER_4N, 9
.set CYDEV_CHIP_MEMBER_4O, 7
.set CYDEV_CHIP_MEMBER_4P, 18
.set CYDEV_CHIP_MEMBER_4Q, 11
.set CYDEV_CHIP_MEMBER_4R, 8
.set CYDEV_CHIP_MEMBER_4S, 10
.set CYDEV_CHIP_MEMBER_4U, 5
.set CYDEV_CHIP_MEMBER_5A, 3
.set CYDEV_CHIP_MEMBER_5B, 2
.set CYDEV_CHIP_MEMBER_6A, 22
.set CYDEV_CHIP_MEMBER_FM3, 26
.set CYDEV_CHIP_MEMBER_FM4, 27
.set CYDEV_CHIP_MEMBER_PDL_FM0P_TYPE1, 23
.set CYDEV_CHIP_MEMBER_PDL_FM0P_TYPE2, 24
.set CYDEV_CHIP_MEMBER_PDL_FM0P_TYPE3, 25
.set CYDEV_CHIP_MEMBER_UNKNOWN, 0
.set CYDEV_CHIP_MEMBER_USED, CYDEV_CHIP_MEMBER_5B
.set CYDEV_CHIP_DIE_EXPECT, CYDEV_CHIP_MEMBER_USED
.set CYDEV_CHIP_DIE_ACTUAL, CYDEV_CHIP_DIE_EXPECT
.set CYDEV_CHIP_REV_LEOPARD_ES1, 0
.set CYDEV_CHIP_REV_LEOPARD_ES2, 1
.set CYDEV_CHIP_REV_LEOPARD_ES3, 3
.set CYDEV_CHIP_REV_LEOPARD_PRODUCTION, 3
.set CYDEV_CHIP_REV_PSOC4A_ES0, 17
.set CYDEV_CHIP_REV_PSOC4A_PRODUCTION, 17
.set CYDEV_CHIP_REV_PSOC5LP_ES0, 0
.set CYDEV_CHIP_REV_PSOC5LP_PRODUCTION, 0
.set CYDEV_CHIP_REV_PSOC5TM_ES0, 0
.set CYDEV_CHIP_REV_PSOC5TM_ES1, 1
.set CYDEV_CHIP_REV_PSOC5TM_PRODUCTION, 1
.set CYDEV_CHIP_REV_TMA4_ES, 17
.set CYDEV_CHIP_REV_TMA4_ES2, 33
.set CYDEV_CHIP_REV_TMA4_PRODUCTION, 17
.set CYDEV_CHIP_REVISION_3A_ES1, 0
.set CYDEV_CHIP_REVISION_3A_ES2, 1
.set CYDEV_CHIP_REVISION_3A_ES3, 3
.set CYDEV_CHIP_REVISION_3A_PRODUCTION, 3
.set CYDEV_CHIP_REVISION_4A_ES0, 17
.set CYDEV_CHIP_REVISION_4A_PRODUCTION, 17
.set CYDEV_CHIP_REVISION_4D_PRODUCTION, 0
.set CYDEV_CHIP_REVISION_4E_PRODUCTION, 0
.set CYDEV_CHIP_REVISION_4F_PRODUCTION, 0
.set CYDEV_CHIP_REVISION_4F_PRODUCTION_256DMA, 0
.set CYDEV_CHIP_REVISION_4F_PRODUCTION_256K, 0
.set CYDEV_CHIP_REVISION_4G_ES, 17
.set CYDEV_CHIP_REVISION_4G_ES2, 33
.set CYDEV_CHIP_REVISION_4G_PRODUCTION, 17
.set CYDEV_CHIP_REVISION_4H_PRODUCTION, 0
.set CYDEV_CHIP_REVISION_4I_PRODUCTION, 0
.set CYDEV_CHIP_REVISION_4J_PRODUCTION, 0
.set CYDEV_CHIP_REVISION_4K_PRODUCTION, 0
.set CYDEV_CHIP_REVISION_4L_PRODUCTION, 0
.set CYDEV_CHIP_REVISION_4M_PRODUCTION, 0
.set CYDEV_CHIP_REVISION_4N_PRODUCTION, 0
.set CYDEV_CHIP_REVISION_4O_PRODUCTION, 0
.set CYDEV_CHIP_REVISION_4P_PRODUCTION, 0
.set CYDEV_CHIP_REVISION_4Q_PRODUCTION, 0
.set CYDEV_CHIP_REVISION_4R_PRODUCTION, 0
.set CYDEV_CHIP_REVISION_4S_PRODUCTION, 0
.set CYDEV_CHIP_REVISION_4U_PRODUCTION, 0
.set CYDEV_CHIP_REVISION_5A_ES0, 0
.set CYDEV_CHIP_REVISION_5A_ES1, 1
.set CYDEV_CHIP_REVISION_5A_PRODUCTION, 1
.set CYDEV_CHIP_REVISION_5B_ES0, 0
.set CYDEV_CHIP_REVISION_5B_PRODUCTION, 0
.set CYDEV_CHIP_REVISION_6A_NO_UDB, 0
.set CYDEV_CHIP_REVISION_6A_PRODUCTION, 0
.set CYDEV_CHIP_REVISION_FM3_PRODUCTION, 0
.set CYDEV_CHIP_REVISION_FM4_PRODUCTION, 0
.set CYDEV_CHIP_REVISION_PDL_FM0P_TYPE1_PRODUCTION, 0
.set CYDEV_CHIP_REVISION_PDL_FM0P_TYPE2_PRODUCTION, 0
.set CYDEV_CHIP_REVISION_PDL_FM0P_TYPE3_PRODUCTION, 0
.set CYDEV_CHIP_REVISION_USED, CYDEV_CHIP_REVISION_5B_PRODUCTION
.set CYDEV_CHIP_REV_EXPECT, CYDEV_CHIP_REVISION_USED
.set CYDEV_CONFIG_FASTBOOT_ENABLED, 1
.set CYDEV_CONFIG_UNUSED_IO_AllowButWarn, 0
.set CYDEV_CONFIG_UNUSED_IO, CYDEV_CONFIG_UNUSED_IO_AllowButWarn
.set CYDEV_CONFIG_UNUSED_IO_AllowWithInfo, 1
.set CYDEV_CONFIG_UNUSED_IO_Disallowed, 2
.set CYDEV_CONFIGURATION_COMPRESSED, 1
.set CYDEV_CONFIGURATION_DMA, 0
.set CYDEV_CONFIGURATION_ECC, 1
.set CYDEV_CONFIGURATION_IMOENABLED, CYDEV_CONFIG_FASTBOOT_ENABLED
.set CYDEV_CONFIGURATION_MODE_COMPRESSED, 0
.set CYDEV_CONFIGURATION_MODE, CYDEV_CONFIGURATION_MODE_COMPRESSED
.set CYDEV_CONFIGURATION_MODE_DMA, 2
.set CYDEV_CONFIGURATION_MODE_UNCOMPRESSED, 1
.set CYDEV_DEBUG_ENABLE_MASK, 0x20
.set CYDEV_DEBUG_ENABLE_REGISTER, CYREG_MLOGIC_DEBUG
.set CYDEV_DEBUGGING_DPS_Disable, 3
.set CYDEV_DEBUGGING_DPS_JTAG_4, 1
.set CYDEV_DEBUGGING_DPS_JTAG_5, 0
.set CYDEV_DEBUGGING_DPS_SWD, 2
.set CYDEV_DEBUGGING_DPS_SWD_SWV, 6
.set CYDEV_DEBUGGING_DPS, CYDEV_DEBUGGING_DPS_SWD_SWV
.set CYDEV_DEBUGGING_ENABLE, 1
.set CYDEV_DEBUGGING_XRES, 0
.set CYDEV_DMA_CHANNELS_AVAILABLE, 24
.set CYDEV_ECC_ENABLE, 0
.set CYDEV_HEAP_SIZE, 0x80
.set CYDEV_INSTRUCT_CACHE_ENABLED, 1
.set CYDEV_INTR_RISING, 0x00000001
.set CYDEV_IS_EXPORTING_CODE, 0
.set CYDEV_IS_IMPORTING_CODE, 0
.set CYDEV_PROJ_TYPE, 0
.set CYDEV_PROJ_TYPE_BOOTLOADER, 1
.set CYDEV_PROJ_TYPE_LAUNCHER, 5
.set CYDEV_PROJ_TYPE_LOADABLE, 2
.set CYDEV_PROJ_TYPE_LOADABLEANDBOOTLOADER, 4
.set CYDEV_PROJ_TYPE_MULTIAPPBOOTLOADER, 3
.set CYDEV_PROJ_TYPE_STANDARD, 0
.set CYDEV_PROTECTION_ENABLE, 0
.set CYDEV_STACK_SIZE, 0x0800
.set CYDEV_USE_BUNDLED_CMSIS, 1
.set CYDEV_VARIABLE_VDDA, 0
.set CYDEV_VDDA_MV, 5000
.set CYDEV_VDDD_MV, 5000
.set CYDEV_VDDIO0_MV, 5000
.set CYDEV_VDDIO1_MV, 5000
.set CYDEV_VDDIO2_MV, 5000
.set CYDEV_VDDIO3_MV, 5000
.set CYDEV_VIO0_MV, 5000
.set CYDEV_VIO1_MV, 5000
.set CYDEV_VIO2_MV, 5000
.set CYDEV_VIO3_MV, 5000
.set CYIPBLOCK_ARM_CM3_VERSION, 0
.set CYIPBLOCK_P3_ANAIF_VERSION, 0
.set CYIPBLOCK_P3_CAPSENSE_VERSION, 0
.set CYIPBLOCK_P3_COMP_VERSION, 0
.set CYIPBLOCK_P3_DMA_VERSION, 0
.set CYIPBLOCK_P3_DRQ_VERSION, 0
.set CYIPBLOCK_P3_EMIF_VERSION, 0
.set CYIPBLOCK_P3_I2C_VERSION, 0
.set CYIPBLOCK_P3_LCD_VERSION, 0
.set CYIPBLOCK_P3_LPF_VERSION, 0
.set CYIPBLOCK_P3_PM_VERSION, 0
.set CYIPBLOCK_P3_TIMER_VERSION, 0
.set CYIPBLOCK_P3_USB_VERSION, 0
.set CYIPBLOCK_P3_VIDAC_VERSION, 0
.set CYIPBLOCK_P3_VREF_VERSION, 0
.set CYIPBLOCK_S8_GPIO_VERSION, 0
.set CYIPBLOCK_S8_IRQ_VERSION, 0
.set CYIPBLOCK_S8_SAR_VERSION, 0
.set CYIPBLOCK_S8_SIO_VERSION, 0
.set CYIPBLOCK_S8_UDB_VERSION, 0
.set DMA_CHANNELS_USED__MASK0, 0x00000003
.set CYDEV_BOOTLOADER_ENABLE, 0
.endif
